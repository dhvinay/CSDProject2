VERSION "HIPBNYYYYYYYYYYYYYYYYYYYYYYYYYYYNNNNNNNNNN/4/%%%/4/'%**4NNN///"

NS_ :

BS_:

BU_: ecuDASH ecuCHS ecuNT01 ecuMFA ecuDIAGNOSE ecuVD03 ecuZE ecuHVAC ecuLCP ecuCHS2 ecuACM

BO_ 1565 msgVD03: 8 ecuVD03
 SG_ ServiceType M : 23|9@1+ (1,0) [0|0] "" Vector__XXX
 SG_ SendInfoTcrr m415 : 32|8@1+ (1,0) [0|0] "" Vector__XXX
 SG_ RecieverNodeNumber : 0|4@1+ (1,0) [0|0] "" Vector__XXX
 SG_ RecieverBusNumber : 4|4@1+ (1,0) [0|0] "" Vector__XXX
 SG_ PlausibilityCheck m359 : 35|1@1+ (1,0) [0|0] "" Vector__XXX
 SG_ LowerHysteresis m405 : 48|8@1+ (1,0) [0|0] "" Vector__XXX
 SG_ DataIndex m359M : 8|15@1+ (1,0) [0|0] "" Vector__XXX
 SG_ ErrorId m359 : 32|3@1+ (1,0) [0|0] "" Vector__XXX
 SG_ CanError m359 : 36|1@1+ (1,0) [0|0] "" Vector__XXX
 SG_ CalErrorState m359 : 37|1@1+ (1,0) [0|0] "" Vector__XXX
 SG_ BlockSize m399 : 32|16@1+ (1,0) [0|0] "bytes" Vector__XXX
 SG_ RequestType m399 : 55|1@1+ (1,0) [0|0] "" Vector__XXX
 SG_ DataByte1 m430 : 32|8@1+ (1,0) [0|0] "" Vector__XXX
 SG_ DataByte2 m430 : 40|8@1+ (1,0) [0|0] "" Vector__XXX
 SG_ DataByte3 m430 : 48|8@1+ (1,0) [0|0] "" Vector__XXX
 SG_ DataByte4 m430 : 56|8@1+ (1,0) [0|0] "" Vector__XXX
 SG_ CRC_ChecksumOrBlockSizeError m398 : 32|16@1+ (1,0) [0|0] "" Vector__XXX
 SG_ ControlType m398 : 48|8@1+ (1,0) [0|0] "" Vector__XXX
 SG_ ControlOrErrorCode m398 : 56|8@1+ (1,0) [0|0] "" Vector__XXX
 SG_ GD_ID_TELEMETRY_GSM_GPRS_ECN0_R m6750 : 40|16@1- (0.1,0) [-50|50] "" Vector__XXX
 SG_ GD_ID_TELEMETRY_GSM_GPRS_BER_R m6751 : 40|16@1+ (1,0) [0|99] "" Vector__XXX
 SG_ GD_ID_TELEMETRY_GSM_GPRS_LAC_R m6752 : 40|16@1+ (1,0) [0|65535] "" Vector__XXX
 SG_ GD_ID_TELEMETRY_GSM_GPRS_CELLID_HIGH_R m6753 : 40|16@1+ (1,0) [0|65535] "" Vector__XXX
 SG_ GD_ID_TELEMETRY_GSM_GPRS_CELLID_LOW_R m6754 : 40|16@1+ (1,0) [0|65535] "" Vector__XXX
 SG_ GD_ID_TELEMETRY_GSM_GPRS_QUALITY_RSCP_R m6755 : 40|16@1- (1,0) [-113|-51] "dBm" Vector__XXX
 SG_ GD_ID_TELEMETRY_OWN_BT_CHANNEL_R m6756 : 40|16@1+ (1,0) [0|9] "" Vector__XXX
 SG_ GD_ID_TELEMETRY_GSM_GPRS_SIGNAL_QUALITY_R m6757 : 40|16@1+ (1,0) [0|200] "dB" Vector__XXX
 SG_ GD_ID_TELEMETRY_VARIODOC_STATE_R m6758 : 40|16@1+ (1,0) [0|11] "" Vector__XXX
 SG_ GD_ID_TELEMETRY_VARIODOC_CONFIG_IS_VALID_RW m6759 : 40|16@1+ (1,0) [0|1] "" Vector__XXX
 SG_ GD_ID_TELEMETRY_VARIODOC_SERVER_PORT_RW m6760 : 40|16@1+ (1,0) [0|9999] "" Vector__XXX
 SG_ GD_ID_TELEMETRY_LAPTOP_BT_CHANNEL_RW m6761 : 40|16@1+ (1,0) [0|9] "" Vector__XXX
 SG_ GD_ID_TELEMETRY_RADIO_TYPE_RW m6762 : 40|16@1+ (1,0) [0|9999] "" Vector__XXX
 SG_ GD_ID_TELEMETRY_GSM_GPRS_MCC_R m6763 : 40|16@1+ (1,0) [0|65535] "" Vector__XXX
 SG_ GD_ID_TELEMETRY_GSM_GPRS_MNC_R m6764 : 40|16@1+ (1,0) [0|65535] "" Vector__XXX
 SG_ GD_ID_TELEMETRY_GSM_GPRS_ALLOWED_ROAMING_RW_Status m6765 : 39|1@1+ (1,0) [0|0] "1/0" Vector__XXX
 SG_ GD_ID_TELEMETRY_GSM_GPRS_ALLOWED_ROAMING_RW m6765 : 40|16@1+ (1,0) [0|65535] "" Vector__XXX
 SG_ GD_ID_TELEMETRY_GSM_GPRS_MODE_R m6766 : 40|16@1+ (1,0) [0|1] "" Vector__XXX
 SG_ GD_ID_TELEMETRY_GSM_STATUS_R m6767 : 40|16@1+ (1,0) [0|1] "" Vector__XXX
 SG_ GD_ID_TELEMETRY_GSM_CONFIG_IS_VALID_R m6768 : 40|16@1+ (1,0) [0|1] "" Vector__XXX
 SG_ GD_ID_TELEMETRY_GSM_GPRS_REDIAL_R m6769 : 40|16@1+ (1,0) [0|1] "" Vector__XXX
 SG_ GD_ID_TELEMETRY_GSM_GPRS_INTERN_EXTERN_ANTENNA_R m6770 : 40|16@1+ (1,0) [0|1] "" Vector__XXX
 SG_ GD_ID_TELEMETRY_GSM_GPRS_ROAMING_STATUS_R m6771 : 40|16@1+ (1,0) [0|3] "" Vector__XXX
 SG_ GD_ID_TELEMETRY_USED_NETWORK_PROVIDER_BLKR m6772 : 40|16@1+ (1,0) [0|65535] "" Vector__XXX
 SG_ GD_ID_TELEMETRY_PACKETDATATYPE_R m6773 : 40|16@1+ (1,0) [0|8] "" Vector__XXX
 SG_ GD_ID_TELEMETRY_SIGNALQUALITY_R m6774 : 40|16@1+ (1,0) [0|5] "" Vector__XXX
 SG_ GD_ID_TELEMETRY_GPRS_STATE_R m6775 : 40|16@1+ (1,0) [0|10] "" Vector__XXX
 SG_ GD_ID_TELEMETRY_GPRS_CONFIG_IS_VALID_RW m6776 : 40|16@1+ (1,0) [0|1] "" Vector__XXX
 SG_ GD_ID_TELEMETRY_CELLULAR_MODEM_TYPE_R m6777 : 40|16@1+ (1,0) [0|3] "" Vector__XXX
 SG_ GD_ID_TELEMETRY_CDMA2000_IMEI_BLKR m6778 : 40|16@1+ (1,0) [0|65535] "" Vector__XXX
 SG_ GD_ID_TELEMETRY_CDMA2000_ESN_BLKR m6779 : 40|16@1+ (1,0) [0|65535] "" Vector__XXX
 SG_ GD_ID_TELEMETRY_CDMA2000_MSL_BLKRW m6780 : 40|16@1+ (1,0) [0|65535] "" Vector__XXX
 SG_ GD_ID_TELEMETRY_CDMA2000_MDN_BLKRW m6781 : 40|16@1+ (1,0) [0|65535] "" Vector__XXX
 SG_ GD_ID_TELEMETRY_CDMA2000_MSID_BLKRW m6782 : 40|16@1+ (1,0) [0|65535] "" Vector__XXX
 SG_ GD_ID_TELEMETRY_STATUS_PIN_PUK_R m6786 : 40|16@1+ (1,0) [0|65535] "" Vector__XXX
 SG_ GD_ID_TELEMETRY_STATUS_DIAL_INTERNET_R m6787 : 40|16@1+ (1,0) [0|65535] "" Vector__XXX
 SG_ GD_ID_TELEMETRY_DATA_RATE_DOWN_R m6806 : 40|16@1+ (0.01,0) [0|32767] "kBit_per_s" Vector__XXX
 SG_ GD_ID_TELEMETRY_DATA_RATE_UP_R m6807 : 40|16@1+ (0.01,0) [0|32767] "kBit_per_s" Vector__XXX
 SG_ GD_ID_TELEMETRY_DEBUG_RW m6808 : 40|16@1+ (1,0) [0|4] "" Vector__XXX
 SG_ GD_ID_TELEMETRY_EMAIL_COMMAND_R m6816 : 40|16@1+ (1,0) [0|3] "" Vector__XXX
 SG_ GD_ID_TELEMETRY_EMAIL_STATUS_R m6817 : 40|16@1+ (1,0) [0|5] "" Vector__XXX
 SG_ GD_ID_TELEMETRY_OWN_BT_ADDRESS_BLKR m6856 : 40|16@1+ (1,0) [0|65535] "" Vector__XXX
 SG_ GD_ID_TELEMETRY_GSM_GPRS_PIN_BLKRW m6857 : 40|16@1+ (1,0) [0|65535] "" Vector__XXX
 SG_ GD_ID_TELEMETRY_GSM_GPRS_PUK_BLKW m6858 : 40|16@1+ (1,0) [0|65535] "" Vector__XXX
 SG_ GD_ID_TELEMETRY_GPRS_PROVIDER_BLKRW m6859 : 40|16@1+ (1,0) [0|65535] "" Vector__XXX
 SG_ GD_ID_TELEMETRY_GPRS_DIAL_BLKRW m6860 : 40|16@1+ (1,0) [0|65535] "" Vector__XXX
 SG_ GD_ID_TELEMETRY_GPRS_USER_BLKRW m6861 : 40|16@1+ (1,0) [0|65535] "" Vector__XXX
 SG_ GD_ID_TELEMETRY_GPRS_PASSWORD_BLKRW m6862 : 40|16@1+ (1,0) [0|65535] "" Vector__XXX
 SG_ GD_ID_TELEMETRY_VARIODOC_SERVER_URL_BLKRW m6863 : 40|16@1+ (1,0) [0|65535] "" Vector__XXX
 SG_ GD_ID_TELEMETRY_LAPTOP_BT_ADDRESS_BLKRW m6864 : 40|16@1+ (1,0) [0|65535] "" Vector__XXX
 SG_ GD_ID_TELEMETRY_GSM_DIAL_BLKRW m6867 : 40|16@1+ (1,0) [0|65535] "" Vector__XXX
 SG_ GD_ID_TELEMETRY_EMAIL_ADDRESS_BLKRW m6880 : 40|16@1+ (1,0) [0|65535] "" Vector__XXX
 SG_ GD_ID_TELEMETRY_EMAIL_TEXT_BLKRW m6881 : 40|16@1+ (1,0) [0|65535] "" Vector__XXX
 SG_ GD_ID_TELEMETRY_VIN_INTERNAL_BLKRW m6882 : 40|16@1+ (1,0) [0|65535] "" Vector__XXX
 SG_ GD_ID_TELEMETRY_ERROR_ACKNOWLEDGE_W_Status m7150 : 39|1@1+ (1,0) [0|0] "1/0" Vector__XXX
 SG_ GD_ID_TELEMETRY_ERROR_ACKNOWLEDGE_W m7150 : 40|16@1+ (1,0) [0|255] "" Vector__XXX
 SG_ GD_ID_TELEMETRY_LifeMessage m7167 : 40|16@1+ (1,0) [0|65535] "ms" Vector__XXX

 SG_ GD_ID_CEAG_FIELD_HEADLAND_WIDTH_RW m16384 : 40|16@1+ (1,0) [0|9999] "cm" Vector__XXX
 SG_ GD_ID_CEAG_FIELD_HEADLAND_DISTANCE_RW m16385 : 40|16@1+ (1,0) [0|5000] "cm" Vector__XXX
 SG_ GD_ID_CEAG_IMPLEMENT_PATHTOPATHDISTANCE_RW m16400 : 40|16@1+ (1,0) [10|9999] "cm" Vector__XXX
 SG_ GD_ID_CEAG_IMPLEMENT_LINKAGETYPE_RW m16402 : 40|16@1+ (1,0) [0|65000] "" Vector__XXX
 SG_ GD_ID_CEAG_IMPLEMENT_LINKAGEFRONT_RW m16403 : 40|16@1+ (1,0) [0|999] "cm" Vector__XXX
 SG_ GD_ID_CEAG_IMPLEMENT_LINKAGEREAR_RW m16404 : 40|16@1+ (1,0) [0|999] "cm" Vector__XXX
 SG_ GD_ID_CEAG_IMPLEMENT_MINIMUMRADIUS_RW m16405 : 40|16@1+ (1,0) [100|9999] "cm" Vector__XXX
 SG_ GD_ID_CEAG_IMPLEMENT_OFFSET_SETOFFSET_RW m16406 : 40|16@1- (1,0) [-1000|9999] "cm" Vector__XXX
 SG_ GD_ID_CEAG_IMPLEMENT_OFFSET_SETWORKINGWIDTH_RW m16407 : 40|16@1+ (1,0) [10|9999] "cm" Vector__XXX
 SG_ GD_ID_CEAG_IMPLEMENT_OFFSET_STATUS_RW m16408 : 40|16@1+ (1,0) [0|0] "" Vector__XXX
 SG_ GD_ID_CEAG_COMMUNICATION_COMMAND_W m16416 : 40|16@1+ (1,0) [0|0] "" Vector__XXX
 SG_ GD_ID_CEAG_COMMUNICATION_COMMAND_STATUS_R m16417 : 40|16@1+ (1,0) [0|0] "" Vector__XXX
 SG_ GD_ID_CEAG_PATH_DATA_BLKRW m16432 : 40|16@1+ (1,0) [0|0] "" Vector__XXX
 SG_ GD_ID_CEAG_PATH_AB_ANGLE_RW m16435 : 40|16@1+ (1,0) [0|3600] "0.1 deg" Vector__XXX
 SG_ GD_ID_CEAG_PATH_AB_DISTANCE_R m16436 : 40|16@1+ (1,0) [0|50] "m" Vector__XXX
 SG_ GD_ID_CEAG_PATH_PIVOT_CENTERPOINT_ACCURACY_R m16439 : 40|16@1+ (1,0) [0|9999] "cm" Vector__XXX
 SG_ GD_ID_CEAG_PATH_SEGMENT_ACTUAL_R m16441 : 40|16@1+ (1,0) [0|99] "" Vector__XXX
 SG_ GD_ID_CEAG_PATH_NUMBER_ACTUAL_R m16442 : 40|16@1- (1,0) [-9999|9999] "" Vector__XXX
 SG_ GD_ID_CEAG_PATH_LP_SLOPE_RW_Status m16443 : 39|1@1+ (1,0) [0|0] "1/0" Vector__XXX
 SG_ GD_ID_CEAG_PATH_LP_SLOPE_RW m16443 : 40|16@1+ (1,0) [0|0] "" Vector__XXX
 SG_ GD_ID_CEAG_PATH_DATA_ACKNOWLEDGE_R_Status m16444 : 39|1@1+ (1,0) [0|0] "1/0" Vector__XXX
 SG_ GD_ID_CEAG_PATH_DATA_ACKNOWLEDGE_R m16444 : 40|16@1+ (1,0) [0|65536] "" Vector__XXX
 SG_ GD_ID_CEAG_NUDGEOFFSET_MANUAL_RW m16448 : 40|16@1+ (1,0) [0|999] "cm" Vector__XXX
 SG_ GD_ID_CEAG_NUDGEOFFSET_TOTAL_R_Status m16449 : 39|1@1+ (1,0) [0|0] "1/0" Vector__XXX
 SG_ GD_ID_CEAG_NUDGEOFFSET_TOTAL_R m16449 : 40|16@1+ (1,0) [0|65000] "cm" Vector__XXX
 SG_ GD_ID_CEAG_OFFSET_NORTH m16450 : 40|16@1- (1,0) [-9999|9999] "cm" Vector__XXX
 SG_ GD_ID_CEAG_OFFSET_EAST m16451 : 40|16@1- (1,0) [-9999|9999] "cm" Vector__XXX
 SG_ GD_ID_CEAG_AUTOTURN_SETTINGS_RW m16464 : 40|16@1+ (1,0) [0|0] "" Vector__XXX
 SG_ GD_ID_CEAG_AUTOTURN_DIMENSIONS_R m16465 : 40|16@1+ (1,0) [0|0] "" Vector__XXX
 SG_ GD_ID_CEAG_AUTOTURN_STATUS_R m16466 : 40|16@1+ (1,0) [0|0] "" Vector__XXX
 SG_ GD_ID_CEAG_STATUSPAGE_POSITION_GNSS_R_Status m16471 : 39|1@1+ (1,0) [0|0] "1/0" Vector__XXX
 SG_ GD_ID_CEAG_STATUSPAGE_POSITION_GNSS_R m16471 : 40|16@1+ (1,0) [0|0] "" Vector__XXX
 SG_ GD_ID_CEAG_STATUSPAGE_CORRECTION_R_Status m16472 : 39|1@1+ (1,0) [0|0] "1/0" Vector__XXX
 SG_ GD_ID_CEAG_STATUSPAGE_CORRECTION_R m16472 : 40|16@1+ (1,0) [0|0] "" Vector__XXX
 SG_ GD_ID_CEAG_STATUSPAGE_INERTIAL_R_Status m16473 : 39|1@1+ (1,0) [0|0] "1/0" Vector__XXX
 SG_ GD_ID_CEAG_STATUSPAGE_INERTIAL_R m16473 : 40|16@1+ (1,0) [0|0] "" Vector__XXX
 SG_ GD_ID_CEAG_STATUSPAGE_STEERING_SUBSYSTEM_R_Status m16474 : 39|1@1+ (1,0) [0|0] "1/0" Vector__XXX
 SG_ GD_ID_CEAG_STATUSPAGE_STEERING_SUBSYSTEM_R m16474 : 40|16@1+ (1,0) [0|0] "" Vector__XXX
 SG_ GD_ID_CEAG_STATUSPAGE_XTRK_R_Status m16475 : 39|1@1+ (1,0) [0|0] "1/0" Vector__XXX
 SG_ GD_ID_CEAG_STATUSPAGE_XTRK_R m16475 : 40|16@1+ (1,0) [0|0] "" Vector__XXX
 SG_ GD_ID_CEAG_STATUSPAGE_HEADINGTOWAYLINE_R_Status m16476 : 39|1@1+ (1,0) [0|0] "1/0" Vector__XXX
 SG_ GD_ID_CEAG_STATUSPAGE_HEADINGTOWAYLINE_R m16476 : 40|16@1+ (1,0) [0|0] "" Vector__XXX
 SG_ GD_ID_CEAG_STATUSPAGE_VELOCITY_R_Status m16477 : 39|1@1+ (1,0) [0|0] "1/0" Vector__XXX
 SG_ GD_ID_CEAG_STATUSPAGE_VELOCITY_R m16477 : 40|16@1+ (1,0) [0|0] "" Vector__XXX
 SG_ GD_ID_CEAG_STATUSPAGE_CALIBRATION_R_Status m16478 : 39|1@1+ (1,0) [0|0] "1/0" Vector__XXX
 SG_ GD_ID_CEAG_STATUSPAGE_CALIBRATION_R m16478 : 40|16@1+ (1,0) [0|0] "" Vector__XXX
 SG_ GD_ID_CEAG_STATUSPAGE_SYSTEM_R_Status m16479 : 39|1@1+ (1,0) [0|0] "1/0" Vector__XXX
 SG_ GD_ID_CEAG_STATUSPAGE_SYSTEM_R m16479 : 40|16@1+ (1,0) [0|0] "" Vector__XXX
 SG_ GD_ID_CEAG_STATUS_XTRK_R_Status m16480 : 39|1@1+ (1,0) [0|0] "1/0" Vector__XXX
 SG_ GD_ID_CEAG_STATUS_XTRK_R m16480 : 40|16@1+ (1,0) [0|9999] "cm" Vector__XXX
 SG_ GD_ID_CEAG_STATUS_HEADING_R m16481 : 40|16@1+ (1,0) [0|36000] "0.01 deg" Vector__XXX
 SG_ GD_ID_CEAG_STATUS_STEERING_R m16482 : 40|16@1+ (1,0) [0|0] "" Vector__XXX
 SG_ GD_ID_CEAG_STEERING_SENSITIVITY_LINEACQUISITION_RW m16483 : 40|16@1+ (1,0) [20|60] "%" Vector__XXX
 SG_ GD_ID_CEAG_STEERING_SENSITIVITY_ONLINE_RW m16484 : 40|16@1+ (1,0) [0|1000] "0.1%" Vector__XXX
 SG_ GD_ID_CEAG_SYSTEM_STANDBYTIME_RW m16485 : 40|16@1+ (1,0) [0|3000] "min" Vector__XXX
 SG_ GD_ID_CEAG_SYSTEM_POWERSUPPLY_INPUT_R m16486 : 40|16@1+ (1,0) [0|5000] "0.01V" Vector__XXX
 SG_ GD_ID_CEAG_SYSTEM_POWERSUPPLY_OUTPUT_R m16487 : 40|16@1+ (1,0) [0|5000] "0.01V" Vector__XXX
 SG_ GD_ID_CEAG_SYSTEM_ALTITUDE_GEOIDAL_SEPARATION_R m16488 : 40|16@1- (1,0) [-32768|32767] "cm" Vector__XXX
 SG_ GD_ID_CEAG_STEERING_DISENGAGE_REASON_R m16489 : 40|16@1+ (1,0) [0|0] "" Vector__XXX
 SG_ GD_ID_CEAG_GNSS_GPS_SATVISIBLE_R m16496 : 40|16@1+ (1,0) [0|30] "" Vector__XXX
 SG_ GD_ID_CEAG_GNSS_GPS_SATUSED_R m16497 : 40|16@1+ (1,0) [0|30] "" Vector__XXX
 SG_ GD_ID_CEAG_GNSS_GLONASS_SATVISIBLE_R m16498 : 40|16@1+ (1,0) [0|30] "" Vector__XXX
 SG_ GD_ID_CEAG_GNSS_GLONASS_SATUSED_R m16499 : 40|16@1+ (1,0) [0|30] "" Vector__XXX
 SG_ GD_ID_CEAG_GNSS_GALILEO_SATVISIBLE_R m16500 : 40|16@1+ (1,0) [0|30] "" Vector__XXX
 SG_ GD_ID_CEAG_GNSS_GALILEO_SATUSED_R m16501 : 40|16@1+ (1,0) [0|30] "" Vector__XXX
 SG_ GD_ID_CEAG_GNSS_VALIDPOSITION_R_Status m16503 : 39|1@1+ (1,0) [0|0] "1/0" Vector__XXX
 SG_ GD_ID_CEAG_GNSS_VALIDPOSITION_R m16503 : 40|16@1+ (1,0) [0|0] "" Vector__XXX
 SG_ GD_ID_CEAG_GNSS_POSITION_ACTUAL_BLKR m16504 : 40|16@1+ (1,0) [0|0] "" Vector__XXX
 SG_ GD_ID_CEAG_GNSS_DOP_R m16505 : 40|16@1+ (1,0) [0|0] "" Vector__XXX
 SG_ GD_ID_CEAG_GNSS_TIME_HOURMINUTE_R m16506 : 40|16@1+ (1,0) [0|0] "h/min" Vector__XXX
 SG_ GD_ID_CEAG_GNSS_TIME_SECOND_R m16507 : 40|16@1+ (1,0) [0|59] "s" Vector__XXX
 SG_ GD_ID_CEAG_GNSS_ANTENNA_INSTALLATION_RW_Status m16508 : 39|1@1+ (1,0) [0|0] "1/0" Vector__XXX
 SG_ GD_ID_CEAG_GNSS_ANTENNA_INSTALLATION_RW m16508 : 40|16@1+ (1,0) [0|0] "" Vector__XXX
 SG_ GD_ID_CEAG_GNSS_VELOCITY_R m16509 : 40|16@1+ (0.01,0) [0|9990] "km/h" Vector__XXX
 SG_ GD_ID_CEAG_GNSS_DISTANCE_R m16510 : 40|16@1+ (1,0) [0|10000] "mm" Vector__XXX
 SG_ GD_ID_CEAG_CORRECTIONSIGNAL_RTKNETWORK_ROAMING_RW_Status m16519 : 39|1@1+ (1,0) [0|0] "1/0" Vector__XXX
 SG_ GD_ID_CEAG_CORRECTIONSIGNAL_RTKNETWORK_ROAMING_RW m16519 : 40|16@1+ (1,0) [0|0] "" Vector__XXX
 SG_ GD_ID_CEAG_CORRECTIONSIGNAL_RTK_DUHF2_CHANNELSPACING_RW m16520 : 40|16@1+ (1,0) [0|0] "" Vector__XXX
 SG_ GD_ID_CEAG_CORRECTIONSIGNAL_RTK_DUHF2_PROTOCOL_RW m16521 : 40|16@1+ (1,0) [0|0] "" Vector__XXX
 SG_ GD_ID_CEAG_CORRECTIONSIGNAL_RTK_DUHF2_ERRORCORRECTION_RW m16522 : 40|16@1+ (1,0) [0|0] "" Vector__XXX
 SG_ GD_ID_CEAG_CORRECTIONSIGNAL_RTK_FH915_CHANNEL_RW m16523 : 40|16@1+ (1,0) [1|10] "" Vector__XXX
 SG_ GD_ID_CEAG_CORRECTIONSIGNAL_RTK_FH915_LOCATION_RW m16524 : 40|16@1+ (1,0) [0|0] "" Vector__XXX
 SG_ GD_ID_CEAG_CORRECTIONSIGNAL_RTK_FH915_NETWORKID_RW m16525 : 40|16@1+ (1,0) [0|255] "" Vector__XXX
 SG_ GD_ID_CEAG_CORRECTIONSIGNAL_OMNISTAR_FREQUENCY_HIGH_RW m16526 : 40|16@1+ (1,0) [0|9999] "MHz" Vector__XXX
 SG_ GD_ID_CEAG_CORRECTIONSIGNAL_OMNISTAR_FREQUENCY_LOW_RW m16527 : 40|16@1+ (1,0) [0|9999] "MHz" Vector__XXX
 SG_ GD_ID_CEAG_CORRECTIONSIGNAL_TYPE_SELECTED_RW m16528 : 40|16@1+ (1,0) [0|0] "" Vector__XXX
 SG_ GD_ID_CEAG_CORRECTIONSIGNAL_OMNISTAR_BAUDRATE_RW m16529 : 40|16@1+ (1,0) [0|0] "" Vector__XXX
 SG_ GD_ID_CEAG_CORRECTIONSIGNAL_VBS_EXPIRYDATE_DAYMONTH_R m16530 : 40|16@1+ (1,0) [0|0] "day/month" Vector__XXX
 SG_ GD_ID_CEAG_CORRECTIONSIGNAL_BARGRAPH_R m16531 : 40|16@1+ (1,0) [0|5] "" Vector__XXX
 SG_ GD_ID_CEAG_CORRECTIONSIGNAL_VBS_EXPIRYDATE_YEAR_R m16532 : 40|16@1+ (1,0) [2000|2100] "year" Vector__XXX
 SG_ GD_ID_CEAG_CORRECTIONSIGNAL_HP_XP_EXPIRYDATE_DAYMONTH_R m16533 : 40|16@1+ (1,0) [0|0] "day/month" Vector__XXX
 SG_ GD_ID_CEAG_CORRECTIONSIGNAL_HP_XP_EXPIRYDATE_YEAR_R m16535 : 40|16@1+ (1,0) [2000|2100] "year" Vector__XXX
 SG_ GD_ID_CEAG_CORRECTIONSIGNAL_STATUS_R_Status m16536 : 39|1@1+ (1,0) [0|0] "1/0" Vector__XXX
 SG_ GD_ID_CEAG_CORRECTIONSIGNAL_STATUS_R m16536 : 40|16@1+ (1,0) [0|0] "" Vector__XXX
 SG_ GD_ID_CEAG_CORRECTIONSIGNAL_OMNISTAR_SERIALNUMBER_HIGH_R m16537 : 40|16@1+ (1,0) [0|999] "" Vector__XXX
 SG_ GD_ID_CEAG_CORRECTIONSIGNAL_OMNISTAR_SERIALNUMBER_LOW_R m16538 : 40|16@1+ (1,0) [0|999] "" Vector__XXX
 SG_ GD_ID_CEAG_CORRECTIONSIGNAL_RTK_AGCO_CHANNEL_RW m16539 : 40|16@1- (1,0) [-32768|32767] "" Vector__XXX
 SG_ GD_ID_CEAG_CORRECTIONSIGNAL_RTK_AGCO_FREQUENCY_HIGH_R m16540 : 40|16@1+ (1,0) [100|999] "MHz" Vector__XXX
 SG_ GD_ID_CEAG_CORRECTIONSIGNAL_RTK_AGCO_FREQUENCY_LOW_R m16541 : 40|16@1+ (1,0) [0|9999] "MHz" Vector__XXX
 SG_ GD_ID_CEAG_CORRECTIONSIGNAL_RTK_AGCO_RADIOTYPE_R m16542 : 40|16@1+ (1,0) [0|0] "" Vector__XXX
 SG_ GD_ID_CEAG_CORRECTIONSIGNAL_RTK_EXTERNAL_SERIALINTERFACE_RW m16543 : 40|16@1+ (1,0) [0|0] "" Vector__XXX
 SG_ GD_ID_CEAG_CORRECTIONSIGNAL_RTK_RADIOINSTALLATION_RW_Status m16544 : 39|1@1+ (1,0) [0|0] "1/0" Vector__XXX
 SG_ GD_ID_CEAG_CORRECTIONSIGNAL_RTK_RADIOINSTALLATION_RW m16544 : 40|16@1+ (1,0) [0|0] "" Vector__XXX
 SG_ GD_ID_CEAG_CORRECTIONSIGNAL_RTK_AGCO_CORRECTIONFORMAT_RW m16545 : 40|16@1+ (1,0) [0|0] "" Vector__XXX
 SG_ GD_ID_CEAG_CORRECTIONSIGNAL_RTK_EXTERNAL_CORRECTIONFORMAT_RW m16546 : 40|16@1+ (1,0) [0|0] "" Vector__XXX
 SG_ GD_ID_CEAG_CORRECTIONSIGNAL_RTK_GPS_SATVISIBLE_R m16547 : 40|16@1+ (1,0) [0|30] "" Vector__XXX
 SG_ GD_ID_CEAG_CORRECTIONSIGNAL_RTK_GPS_SATUSED_R m16548 : 40|16@1+ (1,0) [0|30] "" Vector__XXX
 SG_ GD_ID_CEAG_CORRECTIONSIGNAL_RTK_GLONASS_SATVISIBLE_R m16549 : 40|16@1+ (1,0) [0|30] "" Vector__XXX
 SG_ GD_ID_CEAG_CORRECTIONSIGNAL_RTK_GLONASS_SATUSED_R m16550 : 40|16@1+ (1,0) [0|30] "" Vector__XXX
 SG_ GD_ID_CEAG_CORRECTIONSIGNAL_RTK_GALILEO_SATVISIBLE_R m16551 : 40|16@1+ (1,0) [0|30] "" Vector__XXX
 SG_ GD_ID_CEAG_CORRECTIONSIGNAL_RTK_GALILEO_SATUSED_R m16552 : 40|16@1+ (1,0) [0|30] "" Vector__XXX
 SG_ GD_ID_CEAG_CORRECTIONSIGNAL_RTK_RADIO_CONFIGURABLE_R m16553 : 40|16@1+ (1,0) [0|1] "" Vector__XXX
 SG_ GD_ID_CEAG_CORRECTIONSIGNAL_RTK_BASELINE_R m16554 : 40|16@1+ (1,0) [0|50000] "m" Vector__XXX
 SG_ GD_ID_CEAG_CORRECTIONSIGNAL_SIGNALLAG_R m16555 : 40|16@1+ (1,0) [0|999] "s" Vector__XXX
 SG_ GD_ID_CEAG_CORRECTIONSIGNAL_FALLBACK_RW_Status m16556 : 39|1@1+ (1,0) [0|0] "1/0" Vector__XXX
 SG_ GD_ID_CEAG_CORRECTIONSIGNAL_FALLBACK_RW m16556 : 40|16@1+ (1,0) [0|0] "" Vector__XXX
 SG_ GD_ID_CEAG_CORRECTIONSIGNAL_ACCURACY_GNSSANTENNA_R m16557 : 40|16@1+ (1,0) [0|9999] "cm" Vector__XXX
 SG_ GD_ID_CEAG_CORRECTIONSIGNAL_ACCURACY_VEHICLEREFERENCEPOINT_R m16558 : 40|16@1+ (1,0) [0|9999] "cm" Vector__XXX
 SG_ GD_ID_CEAG_CORRECTIONSIGNAL_AUTHORISATIONLEVEL_R m16559 : 40|16@1+ (1,0) [0|0] "" Vector__XXX
 SG_ GD_ID_CEAG_CORRECTIONSIGNAL_RTKNETWORK_GSM_NUMBER_BLKRW m16560 : 40|16@1+ (1,0) [0|0] "" Vector__XXX
 SG_ GD_ID_CEAG_CORRECTIONSIGNAL_RTKNETWORK_GSM_PIN_BLKRW m16561 : 40|16@1+ (1,0) [0|0] "" Vector__XXX
 SG_ GD_ID_CEAG_CORRECTIONSIGNAL_RTKNETWORK_CORRECTIONFORMAT_RW_Status m16562 : 39|1@1+ (1,0) [0|0] "1/0" Vector__XXX
 SG_ GD_ID_CEAG_CORRECTIONSIGNAL_RTKNETWORK_CORRECTIONFORMAT_RW m16562 : 40|16@1+ (1,0) [0|0] "" Vector__XXX
 SG_ GD_ID_CEAG_CORRECTIONSIGNAL_RTKNETWORK_GPRS_ACCESSPOINT_BLKRW m16563 : 40|16@1+ (1,0) [0|0] "" Vector__XXX
 SG_ GD_ID_CEAG_CORRECTIONSIGNAL_RTKNETWORK_GPRS_IPADDRESS_BLKRW m16564 : 40|16@1+ (1,0) [0|0] "" Vector__XXX
 SG_ GD_ID_CEAG_CORRECTIONSIGNAL_RTKNETWORK_GPRS_PORT_BLKRW m16565 : 40|16@1+ (1,0) [0|0] "" Vector__XXX
 SG_ GD_ID_CEAG_CORRECTIONSIGNAL_RTKNETWORK_GPRS_MOUNTPOINT_BLKRW m16566 : 40|16@1+ (1,0) [0|0] "" Vector__XXX
 SG_ GD_ID_CEAG_CORRECTIONSIGNAL_RTKNETWORK_GPRS_USERNAME_CONNECTIONPOVIDER_BLKRW m16567 : 40|16@1+ (1,0) [0|0] "" Vector__XXX
 SG_ GD_ID_CEAG_CORRECTIONSIGNAL_RTKNETWORK_GPRS_PASSWORD_CONNECTIONPROVIDER_BLKRW m16568 : 40|16@1+ (1,0) [0|0] "" Vector__XXX
 SG_ GD_ID_CEAG_CORRECTIONSIGNAL_RTKNETWORK_NMEA_DATA_RW m16569 : 40|16@1+ (1,0) [0|0] "" Vector__XXX
 SG_ GD_ID_CEAG_CORRECTIONSIGNAL_TYPE_ACTUAL_R m16570 : 40|16@1+ (1,0) [0|0] "" Vector__XXX
 SG_ GD_ID_CEAG_CORRECTIONSIGNAL_RTKNETWORK_GPRS_USERNAME_SIGNALPROVIDER_BLKRW m16571 : 40|16@1+ (1,0) [0|0] "" Vector__XXX
 SG_ GD_ID_CEAG_CORRECTIONSIGNAL_RTKNETWORK_GPRS_PASSWORD_SIGNALPROVIDER_BLKRW m16572 : 40|16@1+ (1,0) [0|0] "" Vector__XXX
 SG_ GD_ID_CEAG_CORRECTIONSIGNAL_RTKNETWORK_GSM_GPRS_CONNECTION_RW_Status m16573 : 39|1@1+ (1,0) [0|0] "1/0" Vector__XXX
 SG_ GD_ID_CEAG_CORRECTIONSIGNAL_RTKNETWORK_GSM_GPRS_CONNECTION_RW m16573 : 40|16@1+ (1,0) [0|0] "" Vector__XXX
 SG_ GD_ID_CEAG_CORRECTIONSIGNAL_RTKNETWORK_GPRS_PIN_BLKRW m16574 : 40|16@1+ (1,0) [0|0] "" Vector__XXX
 SG_ GD_ID_CEAG_CORRECTIONSIGNAL_RTKNETWORK_MODE_RW_Status m16575 : 39|1@1+ (1,0) [0|0] "1/0" Vector__XXX
 SG_ GD_ID_CEAG_CORRECTIONSIGNAL_RTKNETWORK_MODE_RW m16575 : 40|16@1+ (1,0) [0|0] "" Vector__XXX
 SG_ GD_ID_CEAG_NMEA_SERIALINTERFACE_RW m16576 : 40|16@1+ (1,0) [0|0] "" Vector__XXX
 SG_ GD_ID_CEAG_NMEA_DATA_1_RW m16579 : 40|16@1+ (1,0) [0|0] "" Vector__XXX
 SG_ GD_ID_CEAG_NMEA_DATA_2_RW m16580 : 40|16@1+ (1,0) [0|0] "" Vector__XXX
 SG_ GD_ID_CEAG_NMEA_DATA_3_RW m16581 : 40|16@1+ (1,0) [0|0] "" Vector__XXX
 SG_ GD_ID_CEAG_NMEA_DATA_4_RW m16582 : 40|16@1+ (1,0) [0|0] "" Vector__XXX
 SG_ GD_ID_CEAG_NMEA_DATA_5_RW m16583 : 40|16@1+ (1,0) [0|0] "" Vector__XXX
 SG_ GD_ID_CEAG_NMEA_OUTPUT_RW m16584 : 40|16@1+ (1,0) [0|0] "" Vector__XXX
 SG_ GD_ID_CEAG_SENSOR_IMU_ROLL_R_Status m16606 : 39|1@1+ (1,0) [0|0] "1/0" Vector__XXX
 SG_ GD_ID_CEAG_SENSOR_IMU_ROLL_R m16606 : 40|16@1+ (1,0) [0|4500] "0.01 deg" Vector__XXX
 SG_ GD_ID_CEAG_SENSOR_IMU_PITCH_R_Status m16607 : 39|1@1+ (1,0) [0|0] "1/0" Vector__XXX
 SG_ GD_ID_CEAG_SENSOR_IMU_PITCH_R m16607 : 40|16@1+ (1,0) [0|4500] "0.01 deg" Vector__XXX
 SG_ GD_ID_CEAG_SENSOR_IMU_YAW_R_Status m16608 : 39|1@1+ (1,0) [0|0] "1/0" Vector__XXX
 SG_ GD_ID_CEAG_SENSOR_IMU_YAW_R m16608 : 40|16@1+ (1,0) [0|18000] "0.01 deg" Vector__XXX
 SG_ GD_ID_CEAG_SENSOR_IMU_MOUNTINGBIAS_R_Status m16609 : 39|1@1+ (1,0) [0|0] "1/0" Vector__XXX
 SG_ GD_ID_CEAG_SENSOR_IMU_MOUNTINGBIAS_R m16609 : 40|16@1+ (1,0) [0|3000] "0.01 deg" Vector__XXX
 SG_ GD_ID_CEAG_SENSOR_IMU_DHEADING_R m16610 : 40|16@1- (1,0) [-18000|18000] "0.01 deg/s" Vector__XXX
 SG_ GD_ID_CEAG_SENSOR_IMU_WARMING_TIME_R_Status m16611 : 39|1@1+ (1,0) [0|0] "1/0" Vector__XXX
 SG_ GD_ID_CEAG_SENSOR_IMU_WARMING_TIME_R m16611 : 40|16@1+ (1,0) [0|3600] "s" Vector__XXX
 SG_ GD_ID_CEAG_SENSOR_IMU_CALIBRATION_TIME_R_Status m16612 : 39|1@1+ (1,0) [0|0] "1/0" Vector__XXX
 SG_ GD_ID_CEAG_SENSOR_IMU_CALIBRATION_TIME_R m16612 : 40|16@1+ (1,0) [0|255] "s" Vector__XXX
 SG_ GD_ID_CEAG_ID_FA_KALIB_IMU_SET_R m16613 : 40|16@1+ (1,0) [0|65535] "" Vector__XXX
 SG_ GD_ID_CEAG_ID_FA_KALIB_IMU_GET_W m16614 : 40|16@1+ (1,0) [0|65535] "" Vector__XXX
 SG_ GD_ID_CEAG_ID_GNSS_ANTENNA_TYPE_R m16639 : 40|16@1+ (1,0) [0|65535] "" Vector__XXX
 SG_ GD_ID_CEAG_ID_GNSS_ANTENNA_MODEL_BLKR m16640 : 40|16@1+ (1,0) [0|0] "" Vector__XXX
 SG_ GD_ID_CEAG_ID_GNSS_ANTENNA_PSN_BLKR m16641 : 40|16@1+ (1,0) [0|0] "" Vector__XXX
 SG_ GD_ID_CEAG_ID_GNSS_ANTENNA_HWVERSION_BLKR m16642 : 40|16@1+ (1,0) [0|0] "" Vector__XXX
 SG_ GD_ID_CEAG_ID_GNSS_ANTENNA_SWVERSION_BLKR m16643 : 40|16@1+ (1,0) [0|0] "" Vector__XXX
 SG_ GD_ID_CEAG_ID_GNSS_ANTENNA_BOOTVERSION_BLKR m16644 : 40|16@1+ (1,0) [0|0] "" Vector__XXX
 SG_ GD_ID_CEAG_ID_GNSS_ANTENNA_COMPILE_DATE_BLKR m16645 : 40|16@1+ (1,0) [0|0] "" Vector__XXX
 SG_ GD_ID_CEAG_ID_GNSS_ANTENNA_AUTHCODE_BLKW m16646 : 40|16@1+ (1,0) [0|0] "" Vector__XXX
 SG_ GD_ID_CEAG_ID_CORRECTIONSIGNAL_NTRIP_DELAY_R m16650 : 40|16@1+ (1,0) [0|9999] "s" Vector__XXX
 SG_ GD_ID_CEAG_ErrorManagement_Status m16878 : 39|1@1+ (1,0) [0|0] "1/0" Vector__XXX
 SG_ GD_ID_CEAG_ErrorManagement m16878 : 40|16@1+ (1,0) [0|255] "" Vector__XXX
 SG_ GD_ID_CEAG_LifeMessage m16895 : 40|16@1+ (1,0) [0|65535] "ms" Vector__XXX

BO_ 1567 msgZE: 8 ecuZE
 SG_ ServiceType M : 23|9@1+ (1,0) [0|0] "" Vector__XXX

BA_DEF_ BO_  "VFrameFormat" ENUM  "StandardCAN","ExtendedCAN","reserved","J1939PG";
BA_DEF_DEF_  "VFrameFormat" "J1939PG";
BA_ "VFrameFormat" BO_ 1567 0;
VAL_ 1565 GD_ID_TELEMETRY_VARIODOC_STATE_R 0 "undef" 1 "waiting" 2 "busy" 3 "error_init" 4 "error_sim" 5 "error_pin" 6 "error_puk" 7 "no_net" 8 "error_connect" 9 "ok_connect" 10 "ok_ip_up" 11 "ok_doc_ip_up"  ;
VAL_ 1565 GD_ID_TELEMETRY_VARIODOC_CONFIG_IS_VALID_RW 0 "don't start dialing" 1 "start dialing"  ;
VAL_ 1565 GD_ID_TELEMETRY_GSM_GPRS_MODE_R 0 "GSM" 1 "GPRS"  ;
VAL_ 1565 GD_ID_TELEMETRY_GSM_STATUS_R 0 "undef" 1 "waiting" 2 "busy" 3 "error_init" 4 "error_sim" 5 "error_pin" 6 "error_puk" 7 "no_net" 8 "error_connect" 9 "ok_dialed"  ;
VAL_ 1565 GD_ID_TELEMETRY_GSM_CONFIG_IS_VALID_R 0 "don't start dialing" 1 "start dialing"  ;
VAL_ 1565 GD_ID_TELEMETRY_GSM_GPRS_REDIAL_R 0 "do nothing" 1 "redial"  ;
VAL_ 1565 GD_ID_TELEMETRY_GSM_GPRS_INTERN_EXTERN_ANTENNA_R 0 "internal antenna" 1 "external antenna"  ;
VAL_ 1565 GD_ID_TELEMETRY_GSM_GPRS_ROAMING_STATUS_R 0 "Status Not Available" 1 "ME camped on home network" 2 "ME roaming on home network" 3 "ME roaming on other network"  ;
VAL_ 1565 GD_ID_TELEMETRY_PACKETDATATYPE_R 0 "None" 1 "GPRS" 2 "EDGE" 3 "WCDMA" 4 "HSDPA" 5 "HSUPA" 6 "HSPA" 7 "CDMA2000 EV-DO" 8 "CDMA2000 1xRTT"  ;
VAL_ 1565 GD_ID_TELEMETRY_SIGNALQUALITY_R 0 "0 bars (no signal)" 1 "1 bar" 2 "2 bars" 3 "3 bars" 4 "4 bars" 5 "5 bars"  ;
VAL_ 1565 GD_ID_TELEMETRY_GPRS_STATE_R 0 "undef" 1 "waiting" 2 "busy" 3 "error_init" 4 "error_sim" 5 "error_pin" 6 "error_puk" 7 "no_net" 8 "error_connect" 9 "ok_connect" 10 "ok_ip_up"  ;
VAL_ 1565 GD_ID_TELEMETRY_GPRS_CONFIG_IS_VALID_RW 0 "don't start dialing" 1 "start dialing"  ;
VAL_ 1565 GD_ID_TELEMETRY_CELLULAR_MODEM_TYPE_R 0 "invalid" 1 "EES3 (VD02 with EDGE modem)" 2 "PHS8 (VD03 with HSPA+ modem)" 3 "PVS8 (VD03 with CDMA2000 modem)"  ;
VAL_ 1565 GD_ID_TELEMETRY_DEBUG_RW 0 "Undefind Error" 1 "VarioDoc Data successfully sent from terminal" 2 "VarioDoc Data successfully received by the terminal" 3 "VarioDoc Data received on terminal, data is not yet exchanged in DB" 4 "VarioDoc Data received on terminal, data is exchanged in DB"  ;
VAL_ 1565 GD_ID_TELEMETRY_EMAIL_COMMAND_R 0 "Not Enabled" 1 "Ready" 2 "Email Send" 3 "Email Abort"  ;
VAL_ 1565 GD_ID_TELEMETRY_EMAIL_STATUS_R 0 "not enabled" 1 "writing files" 2 "waiting for text address" 3 "transmission started" 4 "transmission finished" 5 "transmission failed"  ;
VAL_ 1565 GD_ID_TELEMETRY_GSM_GPRS_ALLOWED_ROAMING_RW_Status 0 "Not Allowed Roaming" 1 "Allowed Roaming"  ;
VAL_ 1565 PlausibilityCheck 1 "ERROR - Plausibility" 0 "No Plausibility Error" ;
VAL_ 1565 ErrorId 6 "ERROR - Unspecified" 5 "Short to VBatt/Line Interrupt" 4 "Short to Ground/Line Interrupt" 3 "Line Interruption" 2 "Short Circuit to VBatt" 1 "Short Circuit to Ground" 0 "No Directly Diagnosable Error" ;
VAL_ 1565 CanError 1 "ERROR - GD CAN Communication" 0 "No GD CAN Communication Error" ;
VAL_ 1565 CalErrorState 1 "ERROR - Calibration" 0 "No Calibration Error" ;
VAL_ 1565 LowerHysteresis 255 "VALUE NOT PERMITTED" 254 "VALUE NOT PERMITTED" 253 "VALUE NOT PERMITTED" 252 "VALUE NOT PERMITTED" 251 "VALUE NOT PERMITTED" 250 "VALUE NOT PERMITTED" 249 "VALUE NOT PERMITTED" 248 "VALUE NOT PERMITTED" 247 "VALUE NOT PERMITTED" 246 "VALUE NOT PERMITTED" 245 "VALUE NOT PERMITTED" 244 "VALUE NOT PERMITTED" 243 "VALUE NOT PERMITTED" 242 "VALUE NOT PERMITTED" 241 "VALUE NOT PERMITTED" 240 "VALUE NOT PERMITTED" 239 "VALUE NOT PERMITTED" 238 "VALUE NOT PERMITTED" 237 "VALUE NOT PERMITTED" 236 "VALUE NOT PERMITTED" 235 "VALUE NOT PERMITTED" 234 "VALUE NOT PERMITTED" 233 "VALUE NOT PERMITTED" 232 "VALUE NOT PERMITTED" 231 "VALUE NOT PERMITTED" 230 "VALUE NOT PERMITTED" 229 "VALUE NOT PERMITTED" 228 "VALUE NOT PERMITTED" 227 "VALUE NOT PERMITTED" 226 "VALUE NOT PERMITTED" 225 "VALUE NOT PERMITTED" 224 "VALUE NOT PERMITTED" 223 "VALUE NOT PERMITTED" 222 "VALUE NOT PERMITTED" 221 "VALUE NOT PERMITTED" 220 "VALUE NOT PERMITTED" 219 "VALUE NOT PERMITTED" 218 "VALUE NOT PERMITTED" 217 "VALUE NOT PERMITTED" 216 "VALUE NOT PERMITTED" 215 "VALUE NOT PERMITTED" 214 "VALUE NOT PERMITTED" 213 "VALUE NOT PERMITTED" 212 "VALUE NOT PERMITTED" 211 "VALUE NOT PERMITTED" 210 "VALUE NOT PERMITTED" 209 "VALUE NOT PERMITTED" 208 "VALUE NOT PERMITTED" 207 "VALUE NOT PERMITTED" 206 "VALUE NOT PERMITTED" 205 "VALUE NOT PERMITTED" 204 "VALUE NOT PERMITTED" 203 "VALUE NOT PERMITTED" 202 "VALUE NOT PERMITTED" 201 "VALUE NOT PERMITTED" 200 "100 %" 199 "99 %" 198 "98 %" 197 "97 %" 196 "96 %" 195 "95 %" 194 "94 %" 193 "93 %" 192 "92 %" 191 "91 %" 190 "90 %" 189 "89 %" 188 "88 %" 187 "87 %" 186 "86 %" 185 "85 %" 184 "84 %" 183 "83 %" 182 "82 %" 181 "81 %" 180 "80 %" 179 "79 %" 178 "78 %" 177 "77 %" 176 "76 %" 175 "75 %" 174 "74 %" 173 "73 %" 172 "72 %" 171 "71 %" 170 "70 %" 169 "69 %" 168 "68 %" 167 "67 %" 166 "66 %" 165 "65 %" 164 "64 %" 163 "63 %" 162 "62 %" 161 "61 %" 160 "60 %" 159 "59 %" 158 "58 %" 157 "57 %" 156 "56 %" 155 "55 %" 154 "54 %" 153 "53 %" 152 "52 %" 151 "51 %" 150 "50 %" 149 "49 %" 148 "48 %" 147 "47 %" 146 "46 %" 145 "45 %" 144 "44 %" 143 "43 %" 142 "42 %" 141 "41 %" 140 "40 %" 139 "39 %" 138 "38 %" 137 "37 %" 136 "36 %" 135 "35 %" 134 "34 %" 133 "33 %" 132 "32 %" 131 "31 %" 130 "30 %" 129 "29 %" 128 "28 %" 127 "27 %" 126 "26 %" 125 "25 %" 124 "24 %" 123 "23 %" 122 "22 %" 121 "21 %" 120 "20 %" 119 "19 %" 118 "18 %" 117 "17 %" 116 "16 %" 115 "15 %" 114 "14 %" 113 "13 %" 112 "12 %" 111 "11 %" 110 "10 %" 109 "VALUE NOT PERMITTED" 108 "VALUE NOT PERMITTED" 107 "VALUE NOT PERMITTED" 106 "VALUE NOT PERMITTED" 105 "VALUE NOT PERMITTED" 104 "VALUE NOT PERMITTED" 103 "VALUE NOT PERMITTED" 102 "VALUE NOT PERMITTED" 101 "VALUE NOT PERMITTED" 100 "VALUE NOT PERMITTED" 99 "9.9 %" 98 "9.8 %" 97 "9.7 %" 96 "9.6 %" 95 "9.5 %" 94 "9.4 %" 93 "9.3 %" 92 "9.2 %" 91 "9.1 %" 90 "  9 %" 89 "8.9 %" 88 "8.8 %" 87 "8.7 %" 86 "8.6 %" 85 "8.5 %" 84 "8.4 %" 83 "8.3 %" 82 "8.2 %" 81 "8.1 %" 80 "  8 %" 79 "7.9 %" 78 "7.8 %" 77 "7.7 %" 76 "7.6 %" 75 "7.5 %" 74 "7.4 %" 73 "7.3 %" 72 "7.2 %" 71 "7.1 %" 70 "  7 %" 69 "6.9 %" 68 "6.8%" 67 "6.7 %" 66 "6.6 %" 65 "6.5 %" 64 "6.4 %" 63 "6.3 %" 62 "6.2 %" 61 "6.1 %" 60 "  6 %" 59 "5.9 %" 58 "5.8 %" 57 "5.7 %" 56 "5.6 %" 55 "5.5 %" 54 "5.4 %" 53 "5.3 %" 52 "5.2 %" 51 "5.1 %" 50 "  5 %" 49 "4.9 %" 48 "4.8 %" 47 "4.7 %" 46 "4.6 %" 45 "4.5 %" 44 "4.4 %" 43 "4.3 %" 42 "4.2 %" 41 "4.1 %" 40 "  4 %" 39 "3.9 %" 38 "3.8 %" 37 "3.7 %" 36 "3.6 %" 35 "3.5 %" 34 "3.4 %" 33 "3.3 %" 32 "3.2 %" 31 "3.1 %" 30 "  3 %" 29 "2.9 %" 28 "2.8 %" 27 "2.7 %" 26 "2.6 %" 25 "2.5 %" 24 "2.4 %" 23 "2.3 %" 22 "2.2 %" 21 "2.1 %" 20 "  2 %" 19 "1.9 %" 18 "1.8 %" 17 "1.7 %" 16 "1.6 %" 15 "1.5 %" 14 "1.4 %" 13 "1.3 %" 12 "1.2 %" 11 "1.1 %" 10 "  1 %" 9 "0.9 %" 8 "0.8 %" 7 "0.7 %" 6 "0.6 %" 5 "0.5 %" 4 "0.4 %" 3 "0.3 %" 2 "0.2 %" 1 "0.1 %" 0 "  0 %" ;
VAL_ 1565 SendInfoTcrr 255 "Every  32s" 254 "Every  32s" 253 "Every  32s" 252 "Every  32s" 251 "Every  32s" 250 "Every  32s" 249 "Every  32s" 248 "Every  32s" 247 "Every  32s" 246 "Every  32s" 245 "Every  32s" 244 "Every  32s" 243 "Every  32s" 242 "Every  32s" 241 "Every  32s" 240 "Every  32s" 239 "Every  32s" 238 "Every  32s" 237 "Every  32s" 236 "Every  32s" 235 "Every  32s" 234 "Every  32s" 233 "Every  32s" 232 "Every  32s" 231 "Every  32s" 230 "Every  32s" 229 "Every  32s" 228 "Every  32s" 227 "Every  32s" 226 "Every  32s" 225 "Every  32s" 224 "Every  32s" 223 "Every  32s" 222 "Every  32s" 221 "Every  32s" 220 "Every  32s" 219 "Every  32s" 218 "Every  32s" 217 "Every  32s" 216 "Every  32s" 215 "Every  32s" 214 "Every  32s" 213 "Every  32s" 212 "Every  32s" 211 "Every  32s" 210 "Every  32s" 209 "Every  32s" 208 "Every  32s" 207 "Every  32s" 206 "Every  32s" 205 "Every  32s" 204 "Every  32s" 203 "Every  32s" 202 "Every  32s" 201 "Every  32s" 200 "Every  32s" 199 "Every  32s" 198 "Every  32s" 197 "Every  32s" 196 "Every  32s" 195 "Every  32s" 194 "Every  32s" 193 "Every  32s" 192 "Every  32s" 191 "Every  32s" 190 "Every  32s" 189 "Every  32s" 188 "Every  32s" 187 "Every  32s" 186 "Every  32s" 185 "Every  32s" 184 "Every  32s" 183 "Every  32s" 182 "Every  32s" 181 "Every  32s" 180 "Every  32s" 179 "Every  32s" 178 "Every  32s" 177 "Every  32s" 176 "Every  32s" 175 "Every  32s" 174 "Every  32s" 173 "Every  32s" 172 "Every  32s" 171 "Every  32s" 170 "Every  32s" 169 "Every  32s" 168 "Every  32s" 167 "Every  32s" 166 "Every  32s" 165 "Every  32s" 164 "Every  32s" 163 "Every  32s" 162 "Every  32s" 161 "Every  32s" 160 "Every  32s" 159 "Every  32s" 158 "Every  32s" 157 "Every  32s" 156 "Every  32s" 155 "Every  32s" 154 "Every  32s" 153 "Every  32s" 152 "Every  32s" 151 "Every  32s" 150 "Every  32s" 149 "Every  32s" 148 "Every  32s" 147 "Every  32s" 146 "Every  32s" 145 "Every  32s" 144 "Every  32s" 143 "Every  32s" 142 "Every  32s" 141 "Every  32s" 140 "Every  32s" 139 "Every  32s" 138 "Every  32s" 137 "Every  32s" 136 "Every  32s" 135 "Every  32s" 134 "Every  32s" 133 "Every  32s" 132 "Every  32s" 131 "Every  31s" 130 "Every  30s" 129 "Every  29s" 128 "Every  28s" 127 "Every  27s" 126 "Every  26s" 125 "Every  25s" 124 "Every  24s" 123 "Every  23s" 122 "Every  22s" 121 "Every  21s" 120 "Every  20s" 119 "Every  19s" 118 "Every  18s" 117 "Every  17s" 116 "Every  16s" 115 "Every  15s" 114 "Every  14s" 113 "Every  13s" 112 "Every  12s" 111 "Every  11s" 110 "Every  10s" 109 "Every   9s" 108 "Every   8s" 107 "Every   7s" 106 "Every   6s" 105 "Every   5s" 104 "Every   4s" 103 "Every   3s" 102 "Every   2s" 101 "Every   1s" 100 "Every1000ms" 99 "Every 990ms" 98 "Every 980ms" 97 "Every 970ms" 96 "Every 960ms" 95 "Every 950ms" 94 "Every 940ms" 93 "Every 930ms" 92 "Every 920ms" 91 "Every 910ms" 90 "Every 900ms" 89 "Every 890ms" 88 "Every 880ms" 87 "Every 870ms" 86 "Every 860ms" 85 "Every 850ms" 84 "Every 840ms" 83 "Every 830ms" 82 "Every 820ms" 81 "Every 810ms" 80 "Every 800ms" 79 "Every 790ms" 78 "Every 780ms" 77 "Every 770ms" 76 "Every 760ms" 75 "Every 750ms" 74 "Every 740ms" 73 "Every 730ms" 72 "Every 720ms" 71 "Every 710ms" 70 "Every 700ms" 69 "Every 690ms" 68 "Every 680ms" 67 "Every 670ms" 66 "Every 660ms" 65 "Every 650ms" 64 "Every 640ms" 63 "Every 630ms" 62 "Every 620ms" 61 "Every 610ms" 60 "Every 600ms" 59 "Every 590ms" 58 "Every 580ms" 57 "Every 570ms" 56 "Every 560ms" 55 "Every 550ms" 54 "Every 540ms" 53 "Every 530ms" 52 "Every 520ms" 51 "Every 510ms" 50 "Every 500ms" 49 "Every 490ms" 48 "Every 480ms" 47 "Every 470ms" 46 "Every 460ms" 45 "Every 450ms" 44 "Every 440ms" 43 "Every 430ms" 42 "Every 420ms" 41 "Every 410ms" 40 "Every 400ms" 39 "Every 390ms" 38 "Every 380ms" 37 "Every 370ms" 36 "Every 360ms" 35 "Every 350ms" 34 "Every 340ms" 33 "Every 330ms" 32 "Every 320ms" 31 "Every 310ms" 30 "Every 300ms" 29 "Every 290ms" 28 "Every 280ms" 27 "Every 270ms" 26 "Every 260ms" 25 "Every 250ms" 24 "Every 240ms" 23 "Every 230ms" 22 "Every 220ms" 21 "Every 210ms" 20 "Every 200ms" 19 "Every 190ms" 18 "Every 180ms" 17 "Every 170ms" 16 "Every 160ms" 15 "Every 1 50ms" 14 "Every 140ms" 13 "Every 130ms" 12 "Every 120ms" 11 "Every 110ms" 10 "Every 100ms" 9 "Every  90ms" 8 "Every  80ms" 7 "Every  70ms" 6 "Every  60ms" 5 "Every  50ms" 4 "Every  40ms" 3 "Every  30ms" 2 "Every  20ms" 1 "Every  10ms" 0 "Every   5ms";VAL_ 1565 SendInfoEcrr 255 "Wait Time = 25.5s" 254 "Wait Time = 25.4s" 253 "Wait Time = 25.3s" 252 "Wait Time = 25.2s" 251 "Wait Time = 25.1s" 250 "Wait Time =   25s" 249 "Wait Time = 24.9s" 248 "Wait Time = 24.8s" 247 "Wait Time = 24.7s" 246 "Wait Time = 24.6s" 245 "Wait Time = 24.5s" 244 "Wait Time = 24.4s" 243 "Wait Time = 24.3s" 242 "Wait Time = 24.2s" 241 "Wait Time = 24.1s" 240 "Wait Time =   24s" 239 "Wait Time = 23.9s" 238 "Wait Time = 23.8s" 237 "Wait Time = 23.7s" 236 "Wait Time = 23.6s" 235 "Wait Time = 23.5s" 234 "Wait Time = 23.4s" 233 "Wait Time = 23.3s" 232 "Wait Time = 23.2s" 231 "Wait Time = 23.1s" 230 "Wait Time =   23s" 229 "Wait Time = 22.9s" 228 "Wait Time = 22.8s" 227 "Wait Time = 22.7s" 226 "Wait Time = 22.6s" 225 "Wait Time = 22.5s" 224 "Wait Time = 22.4s" 223 "Wait Time = 22.3s" 222 "Wait Time = 22.2s" 221 "Wait Time = 22.1s" 220 "Wait Time =   22s" 219 "Wait Time = 21.9s" 218 "Wait Time = 21.8s" 217 "Wait Time = 21.7s" 216 "Wait Time = 21.6s" 215 "Wait Time = 21.5s" 214 "Wait Time = 21.4s" 213 "Wait Time = 21.3s" 212 "Wait Time = 21.2s" 211 "Wait Time = 21.1s" 210 "Wait Time =   21s" 209 "Wait Time = 20.9s" 208 "Wait Time = 20.8s" 207 "Wait Time = 20.7s" 206 "Wait Time = 20.6s" 205 "Wait Time = 20.5s" 204 "Wait Time = 20.4s" 203 "Wait Time = 20.3s" 202 "Wait Time = 20.2s" 201 "Wait Time = 20.1s" 200 "Wait Time =   20s" 199 "Wait Time = 19.9s" 198 "Wait Time = 19.8s" 197 "Wait Time = 19.7s" 196 "Wait Time = 19.6s" 195 "Wait Time = 19.5s" 194 "Wait Time = 19.4s" 193 "Wait Time = 19.3s" 192 "Wait Time = 19.2s" 191 "Wait Time = 19.1s" 190 "Wait Time =   19s" 189 "Wait Time = 18.9s" 188 "Wait Time = 18.8s" 187 "Wait Time = 18.7s" 186 "Wait Time = 18.6s" 185 "Wait Time = 18.5s" 184 "Wait Time = 18.4s" 183 "Wait Time = 18.3s" 182 "Wait Time = 18.2s" 181 "Wait Time = 18.1s" 180 "Wait Time =   18s" 179 "Wait Time = 17.9s" 178 "Wait Time = 17.8s" 177 "Wait Time = 17.7s" 176 "Wait Time = 17.6s" 175 "Wait Time = 17.5s" 174 "Wait Time = 17.4s" 173 "Wait Time = 17.3s" 172 "Wait Time = 17.2s" 171 "Wait Time = 17.1s" 170 "Wait Time =   17s" 169 "Wait Time = 16.9s" 168 "Wait Time = 16.8s" 167 "Wait Time = 16.7s" 166 "Wait Time = 16.6s" 165 "Wait Time = 16.5s" 164 "Wait Time = 16.4s" 163 "Wait Time = 16.3s" 162 "Wait Time = 16.2s" 161 "Wait Time = 16.1s" 160 "Wait Time =   16s" 159 "Wait Time = 15.9s" 158 "Wait Time = 15.8s" 157 "Wait Time = 15.7s" 156 "Wait Time = 15.6s" 155 "Wait Time = 15.5s" 154 "Wait Time = 15.4s" 153 "Wait Time = 15.3s" 152 "Wait Time = 15.2s" 151 "Wait Time = 15.1s" 150 "Wait Time =   15s" 149 "Wait Time = 14.9s" 148 "Wait Time = 14.8s" 147 "Wait Time = 14.7s" 146 "Wait Time = 14.6s" 145 "Wait Time = 14.5s" 144 "Wait Time = 14.4s" 143 "Wait Time = 14.3s" 142 "Wait Time = 14.2s" 141 "Wait Time = 14.1s" 140 "Wait Time =   14s" 139 "Wait Time = 13.9s" 138 "Wait Time = 13.8s" 137 "Wait Time = 13.7s" 136 "Wait Time = 13.6s" 135 "Wait Time = 13.5s" 134 "Wait Time = 13.4s" 133 "Wait Time = 13.3s" 132 "Wait Time = 13.2s" 131 "Wait Time = 13.1s" 130 "Wait Time =   13s" 129 "Wait Time = 12.9s" 128 "Wait Time = 12.8s" 127 "Wait Time = 12.7s" 126 "Wait Time = 12.6s" 125 "Wait Time = 12.5s" 124 "Wait Time = 12.4s" 123 "Wait Time = 12.3s" 122 "Wait Time = 12.2s"121 "Wait Time = 12.1s" 120 "Wait Time =   12s" 119 "Wait Time = 11.9s" 118 "Wait Time = 11.8s" 117 "Wait Time = 11.7s" 116 "Wait Time = 11.6s" 115 "Wait Time = 11.5s" 114 "Wait Time = 11.4s" 113 "Wait Time = 11.3s" 112 "Wait Time = 11.2s" 111 "Wait Time = 11.1s" 110 "Wait Time =  11s" 109 "Wait Time = 10.9s" 108 "Wait Time = 10.8s" 107 "Wait Time = 10.7s" 106 "Wait Time = 10.6s" 105 "Wait Time = 10.5s" 104 "Wait Time = 10.4s" 103 "Wait Time = 10.3s" 102 "Wait Time = 10.2s" 101 "Wait Time = 10.1s" 100 "Wait Time =  10s" 99 "Wait Time = 9.9s" 98 "Wait Time = 9.8s" 97 "Wait Time = 9.7s" 96 "Wait Time = 9.6s" 95 "Wait Time = 9.5s" 94 "Wait Time = 9.4s" 93 "Wait Time = 9.3s" 92 "Wait Time = 9.2s" 91 "Wait Time = 9.1s" 90 "Wait Time =   9s" 89 "Wait Time = 8.9s" 88 "Wait Time = 8.8s" 87 "Wait Time = 8.7s" 86 "Wait Time = 8.6s" 85 "Wait Time = 8.5s" 84 "Wait Time = 8.4s" 83 "Wait Time = 8.3s" 82 "Wait Time = 8.2s" 81 "Wait Time = 8.1s" 80 "Wait Time =   8s" 79 "Wait Time = 7.9s" 78 "Wait Time = 7.8s" 77 "Wait Time = 7.7s" 76 "Wait Time = 7.6s" 75 "Wait Time = 7.5s" 74 "Wait Time = 7.4s" 73 "Wait Time = 7.3s" 72 "Wait Time = 7.2s" 71 "Wait Time = 7.1s" 70 "Wait Time =   7s" 69 "Wait Time = 6.9s" 68 "Wait Time = 6.8s" 67 "Wait Time = 6.7s" 66 "Wait Time = 6.6s" 65 "Wait Time = 6.5s" 64 "Wait Time = 6.4s" 63 "Wait Time = 6.3s" 62 "Wait Time = 6.2s" 61 "Wait Time = 6.1s" 60 "Wait Time =   6s" 59 "Wait Time = 5.9s" 58 "Wait Time = 5.8s" 57 "Wait Time = 5.7s" 56 "Wait Time = 5.6s" 55 "Wait Time = 5.5s" 54 "Wait Time = 5.4s" 53 "Wait Time = 5.3s" 52 "Wait Time = 5.2s" 51 "Wait Time = 5.1s" 50 "Wait Time =   5s" 49 "Wait Time = 4.9s" 48 "Wait Time = 4.8s" 47 "Wait Time = 4.7s" 46 "Wait Time = 4.6s" 45 "Wait Time = 4.5s" 44 "Wait Time = 4.4s" 43 "Wait Time = 4.3s" 42 "Wait Time = 4.2s" 41 "Wait Time = 4.1s" 40 "Wait Time =   4s" 39 "Wait Time = 3.9s" 38 "Wait Time = 3.8s" 37 "Wait Time = 3.7s" 36 "Wait Time = 3.6s" 35 "Wait Time = 3.5s" 34 "Wait Time = 3.4s" 33 "Wait Time = 3.3s" 32 "Wait Time = 3.2s" 31 "Wait Time = 3.1s" 30 "Wait Time =   3s" 29 "Wait Time = 2.9s" 28 "Wait Time = 2.8s" 27 "Wait Time = 2.7s" 26 "Wait Time = 2.6s" 25 "Wait Time = 2.5s" 24 "Wait Time = 2.4s" 23 "Wait Time = 2.3s" 22 "Wait Time = 2.2s" 21 "Wait Time = 2.1s" 20 "Wait Time =   2s" 19 "Wait Time = 1.9s" 18 "Wait Time = 1.8s" 17 "Wait Time = 1.7s" 16 "Wait Time = 1.6s" 15 "Wait Time = 1.5s" 14 "Wait Time = 1.4s" 13 "Wait Time = 1.3s" 12 "Wait Time = 1.2s" 11 "Wait Time = 1.1s" 10 "Wait Time =   1s" 9 "Wait Time = 900ms" 8 "Wait Time = 800ms" 7 "Wait Time = 700ms" 6 "Wait Time = 600ms" 5 "Wait Time = 500ms" 4 "Wait Time = 400ms" 3 "Wait Time = 300ms" 2 "Wait Time = 200ms" 1 "Wait Time = 100ms" 0 "On Change" ;VAL_ 1565 ServiceType 501 "System Alive" 481 "System Logon" 427 "Imm. Write once" 423 "Imm. Write once w handshake" 422 "Imm. Write Handshake" 415 "Request TCRR" 414 "Response TCRR" 407 "Request ECRR w handshake" 406 "Response ECRR w handshake" 405 "Request ECRR wo hs" 404 "Response ECRR wo hs" 395 "Request SRR wo hs" 394 "Response SRR wo hs" 391 "Request srr w hs" 390 "Response srr w hs" 385 "Abort " 359 "Handshake srr w hs" 375 "Handshake ECRR w handshake" 511 "System Logoff" 509 "Broadcast Message" 399 "Block Transfer Request" 430 "Block Transfer Read Data" 431 "Block Transfer Write Data" 398 "Block Transfer Control/Acknowledge";VAL_ 1565 RequestType 0 "Read" 1 "Write"  ;VAL_ 1565 ControlType 44 "Read Control Message" 172 "Write Control Message" 45 "Read Acknowledge Message" ;VAL_ 1565 ControlOrErrorCode 0 "TRANSER_COMPLETED" 1 "TRANSFER_PARTIAL_COMPLETED" 2 "TRANSFER_ABORTED" 3 "TRANSFER_TIMEOUT" 4 "TRANFER_REPEAT_DATA" 6 "TRANSFER_WRONG_LENGTH" ;VAL_ 1565 RecieverNodeNumber 0 "Dash" 1 "AGCO Connectivity Module" 2 "NT01" 3 "MFA" 4 "Chassis Two" 5 "Chassis" 6 "HVAC" 7 "Light Control Panel" 8 "NOT ASSIGNED" 9 "NOT ASSIGNED" 10 "NOT ASSIGNED" 11 "NOT ASSIGNED" 12 "Diagnostics" 13 "VarioDoc" 14 "NOT ASSIGNED" 15 "Central Electric" ;
VAL_ 1565 RecieverBusNumber 0 "NOT ASSIGNED" 1 "Main GD Bus" 2 "NOT ASSIGNED" 3 "NOT ASSIGNED" 4 "NOT ASSIGNED" 5 "NOT ASSIGNED" 6 "NOT ASSIGNED" 7 "NOT ASSIGNED" 8 "NOT ASSIGNED" 9 "NOT ASSIGNED" 10 "NOT ASSIGNED" 11 "NOT ASSIGNED" 12 "NOT ASSIGNED" 13 "NOT ASSIGNED" 14 "NOT ASSIGNED" 15 "Global" ;
VAL_ 1565 GD_ID_CEAG_STATUS_STEERING_R 0 "not valid" 1 "OFF" 2 "Preactivated" 3 "Activated" 4 "Activation not Possible" 5 "Error"  ;
VAL_ 1565 GD_ID_CEAG_ID_GNSS_ANTENNA_TYPE_R 0 "Unknown" 1 "NovAtel Smart6-L" 2 "Trimble AG-382"  ;
VAL_ 1565 DataIndex 1 "GD_ID_DASH_HAZARDS_LIGHT_Status" 1 "GD_ID_DASH_HAZARDS_LIGHT" 2 "GD_ID_DASH_BLINKER_TRAILER_1_Status" 2 "GD_ID_DASH_BLINKER_TRAILER_1" 3 "GD_ID_DASH_BLINKER_TRAILER_2_Status" 3 "GD_ID_DASH_BLINKER_TRAILER_2" 4 "GD_ID_DASH_BLINKER_LEFT_Status" 4 "GD_ID_DASH_BLINKER_LEFT" 5 "GD_ID_DASH_BLINKER_RIGHT_Status" 5 "GD_ID_DASH_BLINKER_RIGHT" 6 "GD_ID_DASH_HIGH_BEAM_LIGHT_Status" 6 "GD_ID_DASH_HIGH_BEAM_LIGHT" 7 "GD_ID_DASH_FORWARD_DRIVE_DIRECTION_ARROW" 8 "GD_ID_DASH_REVERSE_DRIVE_DIRECTION_ARROW" 10 "GD_ID_DASH_CRUISE_CONTROL_LIGHT_Status" 10 "GD_ID_DASH_CRUISE_CONTROL_LIGHT" 11 "GD_ID_DASH_4WD_LIGHT_Status" 11 "GD_ID_DASH_4WD_LIGHT" 12 "GD_ID_DASH_DIFFERENTIAL_LOCK_LIGHT_Status" 12 "GD_ID_DASH_DIFFERENTIAL_LOCK_LIGHT" 13 "GD_ID_DASH_BRAKE_PAD_WEAR_LIGHT_Status" 13 "GD_ID_DASH_BRAKE_PAD_WEAR_LIGHT" 14 "GD_ID_DASH_HYDRAULIC_OIL_TEMP" 15 "GD_ID_DASH_AIR_FILTER_POLUTION_Status" 15 "GD_ID_DASH_AIR_FILTER_POLUTION" 16 "GD_ID_DASH_BRAKE_FLUID_LEVEL_LIGHT_Status" 16 "GD_ID_DASH_BRAKE_FLUID_LEVEL_LIGHT" 17 "GD_ID_DASH_ENGINE_OIL_PRESSURE_Status" 17 "GD_ID_DASH_ENGINE_OIL_PRESSURE" 18 "GD_ID_DASH_CHARGE_AIR_TEMPERATURE" 19 "GD_ID_DASH_ENGINE_COOLANT_TEMPERATURE_BAR_GRAPH" 20 "GD_ID_DASH_FUEL_LEVEL_BAR_GRAPH" 21 "GD_ID_DASH_AIR_PRESSURE_LEVEL_1_BAR_GRAPH" 22 "GD_ID_DASH_AIR_PRESSURE_LEVEL_2" 23 "GD_ID_DASH_DEF_LEVEL_BAR_GRAPH" 24 "GD_ID_DASH_ENGINE_SPEED" 25 "GD_ID_DASH_FRONT_PTO_SPEED" 26 "GD_ID_DASH_REAR_PTO_SPEED" 27 "GD_ID_DASH_THEORETICAL_VEHICLE_SPEED" 28 "GD_ID_DASH_ACTUAL_VEHICLE_SPEED" 29 "GD_ID_DASH_REAR_PTO_STATUS_Status" 29 "GD_ID_DASH_REAR_PTO_STATUS" 30 "GD_ID_DASH_REAR_PTO_POSITION" 31 "GD_ID_DASH_BUTTON_PRESSED_ENTER_Status" 31 "GD_ID_DASH_BUTTON_PRESSED_ENTER" 32 "GD_ID_DASH_BUTTON_PRESSED_ESC_Status" 32 "GD_ID_DASH_BUTTON_PRESSED_ESC" 33 "GD_ID_DASH_BUTTON_PRESSED_CURSOR_UP_Status" 33 "GD_ID_DASH_BUTTON_PRESSED_CURSOR_UP" 34 "GD_ID_DASH_BUTTON_PRESSED_CURSOR_DOWN_Status" 34 "GD_ID_DASH_BUTTON_PRESSED_CURSOR_DOWN" 37 "GD_ID_DASH_COLD_START_LIGHT_Status" 37 "GD_ID_DASH_COLD_START_LIGHT" 38 "GD_ID_DASH_SHOW_ENGINE_SPEED_SYMBOL_Status" 38 "GD_ID_DASH_SHOW_ENGINE_SPEED_SYMBOL" 39 "GD_ID_DASH_SHOW_FRONT_PTO_SPEED_SYMBOL_Status" 39 "GD_ID_DASH_SHOW_FRONT_PTO_SPEED_SYMBOL" 40 "GD_ID_DASH_SHOW_REAR_PTO_SPEED_SYMBOL_Status" 40 "GD_ID_DASH_SHOW_REAR_PTO_SPEED_SYMBOL" 41 "GD_ID_DASH_SHOW_ACTUAL_SPEED_SYMBOL_Status" 41 "GD_ID_DASH_SHOW_ACTUAL_SPEED_SYMBOL" 42 "GD_ID_DASH_SHOW_CRUISE_CONTROL_SPEED_SYMBOL_Status" 42 "GD_ID_DASH_SHOW_CRUISE_CONTROL_SPEED_SYMBOL" 43 "GD_ID_DASH_SHOW_KMPH_SYMBOL_Status" 43 "GD_ID_DASH_SHOW_KMPH_SYMBOL" 44 "GD_ID_DASH_SHOW_MPH_SYMBOL_Status" 44 "GD_ID_DASH_SHOW_MPH_SYMBOL" 45 "GD_ID_DASH_BACKLIGHT_INTENSITY" 46 "GD_ID_DASH_OPERATING_HOURS_Status" 46 "GD_ID_DASH_OPERATING_HOURS" 47 "GD_ID_DASH_TIME_MINUTES_AND_HOURS" 48 "GD_ID_DASH_TIME_SECONDS" 49 "GD_ID_DASH_BOARD_SUPPLY_VOLTAGE" 50 "GD_ID_DASH_TRANSMISSION_NEUTRAL_STATUS_Status" 50 "GD_ID_DASH_TRANSMISSION_NEUTRAL_STATUS" 51 "GD_ID_DASH_FILTER_CONTAMINATION_Status" 51 "GD_ID_DASH_FILTER_CONTAMINATION" 52 "GD_ID_DASH_SPARE_OUTPUT_1" 53 "GD_ID_DASH_SPARE_OUTPUT_2" 54 "GD_ID_DASH_ABS_TRAILER_LIGHT_Status" 54 "GD_ID_DASH_ABS_TRAILER_LIGHT" 55 "GD_ID_DASH_TRAILER_BRAKE_LIGHT_Status" 55 "GD_ID_DASH_TRAILER_BRAKE_LIGHT" 56 "GD_ID_DASH_REAR_FOG_LIGHT_Status" 56 "GD_ID_DASH_REAR_FOG_LIGHT" 58 "GD_ID_DASH_BUZZER_UNDERTONE_Status" 58 "GD_ID_DASH_BUZZER_UNDERTONE" 59 "GD_ID_DASH_BUZZER_LOUD_Status" 59 "GD_ID_DASH_BUZZER_LOUD" 60 "GD_ID_DASH_ABS_TRACTOR_LIGHT_Status" 60 "GD_ID_DASH_ABS_TRACTOR_LIGHT" 61 "GD_ID_DASH_SPARE_LIGHT_2_Status" 61 "GD_ID_DASH_SPARE_LIGHT_2" 62 "GD_ID_DASH_ADVALUE_CHANNEL0_HYDRAULIC_LEVEL" 63 "GD_ID_DASH_ADVALUE_CHANNEL1_FUEL_LEVEL" 64 "GD_ID_DASH_ADVALUE_CHANNEL2_AIR_PRESSURE_2" 65 "GD_ID_DASH_ADVALUE_CHANNEL3_AIR_PRESSURE_1" 66 "GD_ID_DASH_ADVALUE_CHANNEL4_ENGINE_OIL_PRESSURE" 67 "GD_ID_DASH_ADVALUE_CHANNEL5_TRANSMISSION_TEMPERATURE" 68 "GD_ID_DASH_ADVALUE_CHANNEL6_ENGINE_TEMPERATURE" 69 "GD_ID_DASH_ADVALUE_CHANNEL7_HYDRAULIC_OIL_TEMPERATURE" 70 "GD_ID_DASH_DATE_YEAR" 71 "GD_ID_DASH_DATE_MONTH_DAY" 72 "GD_ID_DASH_LOCK_STATUS_Status" 72 "GD_ID_DASH_LOCK_STATUS" 494 "GD_ID_DASH_ERRORMANAGEMENT_Status" 494 "GD_ID_DASH_ERRORMANAGEMENT" 511 "GD_ID_DASH_LIFEMESSAGE" 512 "GD_ID_ES_MAX_ENGINE_SPEED" 518 "GD_ID_ES_ENG_A_RPM" 520 "GD_ID_ES_ENG_B_RPM" 522 "GD_ID_ES_CURRENT_SOURCE" 523 "GD_ID_ES_COMMANDED_RPM" 524 "GD_ID_ES_SELECTED_SOURCE" 1006 "GD_ID_ES_ErrorManagement_Status" 1006 "GD_ID_ES_ErrorManagement" 1023 "GD_ID_ES_LifeMessage" 2049 "GD_ID_DRIVE_AIR_PRESSURE" 2050 "GD_ID_DRIVE_HYDRAULICS_ENABLE_Status" 2050 "GD_ID_DRIVE_HYDRAULICS_ENABLE" 2051 "GD_ID_DRIVE_REQUEST_HYD_ENABLE_OFF_Status" 2051 "GD_ID_DRIVE_REQUEST_HYD_ENABLE_OFF" 2052 "GD_ID_DRIVE_BRAKE_PEDAL_POSITION_A" 2053 "GD_ID_DRIVE_BRAKE_PEDAL_POSITION_B" 2054 "GD_ID_DRIVE_BRAKE_PEDAL_POSITION" 2055 "GD_ID_DRIVE_HYD_MOT_RPM_FR" 2056 "GD_ID_DRIVE_HYD_MOT_RPM_RR" 2057 "GD_ID_DRIVE_HYD_MOT_RPM_RL" 2058 "GD_ID_DRIVE_HYD_MOT_RPM_FL" 2061 "GD_ID_DRIVE_FORWARD_SS_DEFAULT_SPEED" 2062 "GD_ID_DRIVE_REVERSE_SS_DEFAULT_SPEED" 2063 "GD_ID_DRIVE_WHEEL_BASED_MACHINE_SPEED" 2064 "GD_ID_DRIVE_DANFOSS_IN_SV_STATE_COMMANDED_Status" 2064 "GD_ID_DRIVE_DANFOSS_IN_SV_STATE_COMMANDED" 2065 "GD_ID_DRIVE_DANFOSS_OUT_SV_STATE_ACTUAL_Status" 2065 "GD_ID_DRIVE_DANFOSS_OUT_SV_STATE_ACTUAL" 2066 "GD_ID_DRIVE_DANFOSS_IN_SV_SPEED" 2067 "GD_ID_DRIVE_DANFOSS_OUT_DRIVE_MODE_ACTUAL_Status" 2067 "GD_ID_DRIVE_DANFOSS_OUT_DRIVE_MODE_ACTUAL" 2068 "GD_ID_DRIVE_DANFOSS_IN_DRIVE_MODE_COMMANDED_Status" 2068 "GD_ID_DRIVE_DANFOSS_IN_DRIVE_MODE_COMMANDED" 2069 "GD_ID_DRIVE_SV_1_Status" 2069 "GD_ID_DRIVE_SV_1" 2070 "GD_ID_DRIVE_SV_2_Status" 2070 "GD_ID_DRIVE_SV_2" 2071 "GD_ID_DRIVE_SV_STATE" 2072 "GD_ID_DRIVE_MAX_ENGINE_DROP" 2076 "GD_ID_DRIVE_CALIB_STATE_BRAKE_PEDAL_Status" 2076 "GD_ID_DRIVE_CALIB_STATE_BRAKE_PEDAL" 2077 "GD_ID_DRIVE_MAX_SV_SPEED" 2078 "GD_ID_DRIVE_PRESSURE_A" 2079 "GD_ID_DRIVE_PRESSURE_B" 2080 "GD_ID_DRIVE_CHARGE_PRESSURE" 2084 "GD_ID_DRIVE_DASH_DISPLAYED_ENGINE_SPEED" 2085 "GD_ID_DRIVE_FRONT_STEER_ANGLE" 2086 "GD_ID_DRIVE_DANFOSS_OUT_PARKBRK_REQUEST_Status" 2086 "GD_ID_DRIVE_DANFOSS_OUT_PARKBRK_REQUEST" 2087 "GD_ID_DRIVE_DANFOSS_OUT_CCO_VALVE_REQUEST_Status" 2087 "GD_ID_DRIVE_DANFOSS_OUT_CCO_VALVE_REQUEST" 2088 "GD_ID_DRIVE_CCO_VALVE_COMMAND_Status" 2088 "GD_ID_DRIVE_CCO_VALVE_COMMAND" 2092 "GD_ID_DRIVE_TIRE_RCI" 2094 "GD_ID_DRIVE_DASH_DISPLAYED_MACHINE_SPEED2" 2095 "GD_ID_DRIVE_CARGO_OVER_WEIGHT_Status" 2095 "GD_ID_DRIVE_CARGO_OVER_WEIGHT" 2096 "GD_ID_DRIVE_ROGATOR_MACHINE_CONFIGURATION" 2097 "GD_ID_DRIVE_TIRE_ROLLING_CIRCUMFERENCE" 2098 "GD_ID_DRIVE_BRAKE_LIGHT_COMMAND_Status" 2098 "GD_ID_DRIVE_BRAKE_LIGHT_COMMAND" 2099 "GD_ID_DRIVE_TARGET_MACHINE_SPEED" 2100 "GD_ID_DRIVE_MAX_MACHINE_SPEED" 2101 "GD_ID_DRIVE_EXPECTED_MACHINE_SPEED" 2111 "GD_ID_DRIVE_CALIB_BRAKE_PEDAL_START_Status" 2111 "GD_ID_DRIVE_CALIB_BRAKE_PEDAL_START" 2112 "GD_ID_DRIVE_CALIB_BRAKE_PEDAL_ACTIVE_Status" 2112 "GD_ID_DRIVE_CALIB_BRAKE_PEDAL_ACTIVE" 2113 "GD_ID_DRIVE_CALIB_BRAKE_PEDAL_DOWN_Status" 2113 "GD_ID_DRIVE_CALIB_BRAKE_PEDAL_DOWN" 2114 "GD_ID_DRIVE_CALIB_BRAKE_PEDAL_DOWN_RET_Status" 2114 "GD_ID_DRIVE_CALIB_BRAKE_PEDAL_DOWN_RET" 2115 "GD_ID_DRIVE_CALIB_BRAKE_PEDAL_UP_Status" 2115 "GD_ID_DRIVE_CALIB_BRAKE_PEDAL_UP" 2116 "GD_ID_DRIVE_CALIB_BRAKE_PEDAL_UP_RET_Status" 2116 "GD_ID_DRIVE_CALIB_BRAKE_PEDAL_UP_RET" 2117 "GD_ID_DRIVE_CALIB_BRAKE_PEDAL_ACCEPT_Status" 2117 "GD_ID_DRIVE_CALIB_BRAKE_PEDAL_ACCEPT" 2118 "GD_ID_DRIVE_CALIB_BRAKE_PEDAL_DECLINE_Status" 2118 "GD_ID_DRIVE_CALIB_BRAKE_PEDAL_DECLINE" 2119 "GD_ID_DRIVE_CALIB_BRAKE_PEDAL_PROCESSED_Status" 2119 "GD_ID_DRIVE_CALIB_BRAKE_PEDAL_PROCESSED" 2120 "GD_ID_DRIVE_CALIB_BRAKE_PEDAL_ERROR_Status" 2120 "GD_ID_DRIVE_CALIB_BRAKE_PEDAL_ERROR" 2121 "GD_ID_DRIVE_FIELD_STREET_STATE" 2122 "GD_ID_DRIVE_DTM_ENALBED_IN_MANUAL_Status" 2122 "GD_ID_DRIVE_DTM_ENALBED_IN_MANUAL" 2123 "GD_ID_DRIVE_STATE" 2124 "GD_ID_DRIVE_DTM_MIN_RPM" 2125 "GD_ID_DRIVE_DTM_MAX_RPM" 2126 "GD_ID_DRIVE_DRIVEPUMP_A_COMCURRENT" 2127 "GD_ID_DRIVE_DRIVEPUMP_B_COMCURRENT" 2128 "GD_ID_DRIVE_HYD_MOT_FR_COMCURRENT" 2129 "GD_ID_DRIVE_HYD_MOT_RR_COMCURRENT" 2130 "GD_ID_DRIVE_HYD_MOT_RL_COMCURRENT" 2131 "GD_ID_DRIVE_HYD_MOT_FL_COMCURRENT" 2133 "GD_ID_DRIVE_HYDRAULIC_OIl_TEMP" 2135 "GD_ID_DRIVE_FUEL_LEVEL" 2137 "GD_ID_DRIVE_PARKBRAKE_COMMAND_Status" 2137 "GD_ID_DRIVE_PARKBRAKE_COMMAND" 2138 "GD_ID_DRIVE_OPERATION_MODE" 2139 "GD_ID_DRIVE_DRIVEPUMP_A_FEEDBACK_CURRENT" 2140 "GD_ID_DRIVE_DRIVEPUMP_B_FEEDBACK_CURRENT" 2141 "GD_ID_DRIVE_HYD_MOT_FR_FEEDBACK_CURRENT" 2142 "GD_ID_DRIVE_HYD_MOT_RR_FEEDBACK_CURRENT" 2143 "GD_ID_DRIVE_HYD_MOT_RL_FEEDBACK_CURRENT" 2144 "GD_ID_DRIVE_HYD_MOT_FL_FEEDBACK_CURRENT" 2150 "GD_ID_DRIVE_RADAR_SPEED" 2175 "GD_ID_DRIVE_DASH_DISPLAYED_PARK_BRAKE_LED_Status" 2175 "GD_ID_DRIVE_DASH_DISPLAYED_PARK_BRAKE_LED" 2192 "GD_ID_DRIVE_CURRENT_GEAR" 2193 "GD_ID_DRIVE_SELECTED_GEAR" 2194 "GD_ID_DRIVE_DRIVE_PEDAL_POSITION" 2207 "GD_ID_DRIVE_DASH_DISPLAYED_MACHINE_SPEED1" 2258 "GD_ID_DRIVE_DTM_COMMANDED_RPM" 2300 "GD_ID_DRIVE_DISPLAY_UNITS_Status" 2300 "GD_ID_DRIVE_DISPLAY_UNITS" 2348 "GD_ID_DRIVE_RESET_DEFAULT_PROFILES_Status" 2348 "GD_ID_DRIVE_RESET_DEFAULT_PROFILES" 2349 "GD_ID_DRIVE_LEVER_ACCEL_PROFILE" 2350 "GD_ID_DRIVE_LEVER_DECEL_PROFILE" 2351 "GD_ID_DRIVE_PEDAL_ACCEL_PROFILE" 2352 "GD_ID_DRIVE_PEDAL_DECEL_PROFILE" 2353 "GD_ID_DRIVE_SV_ACCELDECEL_PROFILE" 2355 "GD_ID_DRIVE_SHUTTLE_ACCELDECEL_PROFILE" 2373 "GD_ID_DRIVE_DANFOSS_IN_OUTFAULTS" 2374 "GD_ID_ASC_RAMP_RL_DECTM" 2375 "GD_ID_ASC_PID_FL_KIUP_ASC" 2376 "GD_ID_ASC_PID_FL_KIDOWN_ASC" 2377 "GD_ID_ASC_PID_FL_KPUP_ASC" 2378 "GD_ID_ASC_PID_FL_KPDOWN_ASC" 2379 "GD_ID_ASC_PID_FL_KDUP_ASC" 2380 "GD_ID_ASC_PID_FL_IRED" 2381 "GD_ID_ASC_INCHING_INCHMODE" 2382 "GD_ID_ASC_INCHING_TVOLINCH" 2383 "GD_ID_ASC_REFSPDDISABLE_ABS_MINREFSPD_MMSEC" 2384 "GD_ID_ASC_REFSPDDISABLE_ASC_MINREFSPD_MMSEC" 2385 "GD_ID_ASC_REFSPDDISABLE_ABS_DECRAMP60K" 2386 "GD_ID_ASC_FFPROFILES_REVBRAKINGFRONT_Y4_PTC2" 2387 "GD_ID_ASC_FFPROFILES_REVBRAKINGFRONT_Y5_PTC2" 2388 "GD_ID_ASC_FFPROFILES_REVBRAKINGFRONT_Y6_PTC2" 2389 "GD_ID_ASC_FFPROFILES_FWDBRAKINGREAR_Y5_PTC2_LD" 2390 "GD_ID_ASC_FFPROFILES_FWDBRAKINGREAR_Y5_PTC2" 2391 "GD_ID_ASC_FFPROFILES_FWDBRAKINGREAR_Y6_PTC2_LD" 2392 "GD_ID_ASC_FFPROFILES_FWDBRAKINGREAR_Y6_PTC2" 2393 "GD_ID_ASC_CORE_ASC_MINTOLERANCE_PCT2" 2394 "GD_ID_ASC_PID_RL_KDUP_ASC" 2395 "GD_ID_ASC_PID_RL_KPUP_ASC" 2396 "GD_ID_ASC_PID_RL_KPDN_ASC" 2397 "GD_ID_ASC_PID_RL_KIUP_ASC" 2398 "GD_ID_ASC_PID_RL_KIDN_ASC" 2399 "GD_ID_ASC_PID_RL_IRED" 2400 "GD_ID_BRK_Y5" 2401 "GD_ID_ENGADJLD_FILTERTM_MS" 2402 "GD_ID_ENGADJLD_Y4" 2403 "GD_ID_MV_I_INT_I_GAIN" 2404 "GD_ID_MISC_PR_PERACT_Y3" 2405 "GD_ID_MISC_PR_PERACT_Y4" 2406 "GD_ID_MISC_PR_PERACT_Y5" 2407 "GD_ID_ASC_Core_ABS_Ang_Y1_ptc2" 2408 "GD_ID_ASC_Core_ABS_Ang_Y2_ptc2" 2409 "GD_ID_ASC_Core_ABS_Ang_Y3_ptc2" 2410 "GD_ID_ASC_Core_ABS_Ang_Y4_ptc2" 2411 "GD_ID_ASC_Core_ABS_Ang_Y5_ptc2" 2412 "GD_ID_ASC_Core_ABS_MinTolerance_pct2" 2413 "GD_ID_ASC_Core_ASC_Ang_Y1_ptc2" 2414 "GD_ID_ASC_Core_ASC_Ang_Y2_ptc2" 2415 "GD_ID_ASC_Core_ASC_Ang_Y3_ptc2" 2416 "GD_ID_ASC_Core_ASC_Ang_Y4_ptc2" 2417 "GD_ID_ASC_Core_ASC_Ang_Y5_ptc2" 2458 "GD_ID_DRIVE_PEDAL_CAL_COMMAND_Status" 2458 "GD_ID_DRIVE_PEDAL_CAL_COMMAND" 2459 "GD_ID_DRIVE_PEDAL_CAL_STATE_Status" 2459 "GD_ID_DRIVE_PEDAL_CAL_STATE" 2460 "GD_ID_DRIVE_BRAKE_PEDAL_CAL_COMMAND_Status" 2460 "GD_ID_DRIVE_BRAKE_PEDAL_CAL_COMMAND" 2461 "GD_ID_DRIVE_BRAKE_PEDAL_CAL_STATE_Status" 2461 "GD_ID_DRIVE_BRAKE_PEDAL_CAL_STATE" 2462 "GD_ID_DRIVE_WAS_CAL_COMMAND_Status" 2462 "GD_ID_DRIVE_WAS_CAL_COMMAND" 2463 "GD_ID_DRIVE_WAS_CAL_STATE_Status" 2463 "GD_ID_DRIVE_WAS_CAL_STATE" 2464 "GD_ID_DRIVE_HYDRO_CAL_COMMAND_Status" 2464 "GD_ID_DRIVE_HYDRO_CAL_COMMAND" 2465 "GD_ID_DRIVE_HYDRO_CAL_STATE_Status" 2465 "GD_ID_DRIVE_HYDRO_CAL_STATE" 2468 "GD_ID_DRIVE_WHEEL_SPEED_CALIBRATION_COMMAND_Status" 2468 "GD_ID_DRIVE_WHEEL_SPEED_CALIBRATION_COMMAND" 2469 "GD_ID_DRIVE_WHEEL_SPEED_CALIBRATION_STATE_Status" 2469 "GD_ID_DRIVE_WHEEL_SPEED_CALIBRATION_STATE" 2470 "GD_ID_DRIVE_WHEEL_SPEED_CALIBRATION_USER_DISTANCE_Status" 2470 "GD_ID_DRIVE_WHEEL_SPEED_CALIBRATION_USER_DISTANCE" 2471 "GD_ID_DRIVE_RADAR_CALIBRATION_COMMAND_Status" 2471 "GD_ID_DRIVE_RADAR_CALIBRATION_COMMAND" 2472 "GD_ID_DRIVE_RADAR_CALIBRATION_STATE_Status" 2472 "GD_ID_DRIVE_RADAR_CALIBRATION_STATE" 2473 "GD_ID_DRIVE_RADAR_CALIBRATION_USER_DISTANCE_Status" 2473 "GD_ID_DRIVE_RADAR_CALIBRATION_USER_DISTANCE" 2474 "GD_ID_DRIVE_COMBO_CALIBRATION_COMMAND_Status" 2474 "GD_ID_DRIVE_COMBO_CALIBRATION_COMMAND" 2475 "GD_ID_DRIVE_COMBO_CALIBRATION_STATE_Status" 2475 "GD_ID_DRIVE_COMBO_CALIBRATION_STATE" 2476 "GD_ID_DRIVE_COMBO_CALIBRATION_USER_DISTANCE_Status" 2476 "GD_ID_DRIVE_COMBO_CALIBRATION_USER_DISTANCE" 2498 "GD_ID_DRIVE_DRIVEPUMP_A_START_CAL_CURRENT_STORED" 2499 "GD_ID_DRIVE_DRIVEPUMP_A_END_CAL_CURRENT_STORED" 2500 "GD_ID_DRIVE_DRIVEPUMP_B_START_CAL_CURRENT_STORED" 2501 "GD_ID_DRIVE_DRIVEPUMP_B_END_CAL_CURRENT_STORED" 2502 "GD_ID_DRIVE_MOTOR_FL_START_CAL_CURRENT_STORED" 2503 "GD_ID_DRIVE_MOTOR_FL_END_CAL_CURRENT_STORED" 2504 "GD_ID_DRIVE_MOTOR_FR_START_CAL_CURRENT_STORED" 2505 "GD_ID_DRIVE_MOTOR_FR_END_CAL_CURRENT_STORED" 2506 "GD_ID_DRIVE_MOTOR_RL_START_CAL_CURRENT_STORED" 2507 "GD_ID_DRIVE_MOTOR_RL_END_CAL_CURRENT_STORED" 2508 "GD_ID_DRIVE_MOTOR_RR_START_CAL_CURRENT_STORED" 2509 "GD_ID_DRIVE_MOTOR_RR_END_CAL_CURRENT_STORED" 2510 "GD_ID_DRIVE_DRIVEPUMP_A_START_CAL_CURRENT_NEW" 2511 "GD_ID_DRIVE_DRIVEPUMP_A_END_CAL_CURRENT_NEW" 2512 "GD_ID_DRIVE_DRIVEPUMP_B_START_CAL_CURRENT_NEW" 2513 "GD_ID_DRIVE_DRIVEPUMP_B_END_CAL_CURRENT_NEW" 2514 "GD_ID_DRIVE_MOTOR_FL_START_CAL_CURRENT_NEW" 2515 "GD_ID_DRIVE_MOTOR_FL_END_CAL_CURRENT_NEW" 2516 "GD_ID_DRIVE_MOTOR_FR_START_CAL_CURRENT_NEW" 2517 "GD_ID_DRIVE_MOTOR_FR_END_CAL_CURRENT_NEW" 2518 "GD_ID_DRIVE_MOTOR_RL_START_CAL_CURRENT_NEW" 2519 "GD_ID_DRIVE_MOTOR_RL_END_CAL_CURRENT_NEW" 2520 "GD_ID_DRIVE_MOTOR_RR_START_CAL_CURRENT_NEW" 2521 "GD_ID_DRIVE_MOTOR_RR_END_CAL_CURRENT_NEW" 2523 "GD_ID_DRIVE_DANFOSS_CAL_REQUEST" 2525 "GD_ID_DRIVE_WHEEL_BASED_MACHINE_SPEED_KPH" 2526 "GD_ID_DRIVE_NORMALIZED_WHEEL_SPEED_FL" 2527 "GD_ID_DRIVE_NORMALIZED_WHEEL_SPEED_FR" 2528 "GD_ID_DRIVE_NORMALIZED_WHEEL_SPEED_RL" 2529 "GD_ID_DRIVE_NORMALIZED_WHEEL_SPEED_RR" 2530 "GD_ID_DRIVE_AIRBAG_DEFLATE_Status" 2530 "GD_ID_DRIVE_AIRBAG_DEFLATE" 2542 "GD_ID_DRIVE_ERRORMANAGEMENT_Status" 2542 "GD_ID_DRIVE_ERRORMANAGEMENT" 2559 "GD_ID_DRIVE_LIFEMESSAGE" 5632 "GD_ID_TI_VEHICLE_STARTUP_CONFIG" 5633 "GD_ID_TI_VEHICLE_SHUTDOWN_CONFIG" 5634 "GD_ID_TI_VEHICLE_STARTUP_COMMAND" 5635 "GD_ID_TI_VEHICLE_SHUTDOWN_COMMAND" 5636 "GD_ID_TI_VEHICLE_SHUTDOWN_TIME" 5640 "GD_ID_TI_TermSeqTst" 5643 "GD_ID_TI_BesitzeJoystickAuto" 5644 "GD_ID_TI_RezeptAuswahl" 5645 "GD_ID_TI_AnzeigeRezeptAlteAUTO" 5646 "GD_ID_TI_CLASSIC_MODE_ASSIGNMENT" 5647 "GD_ID_TI_RezeptAlteAutoKL15" 5648 "GD_ID_TI_ExtSollAlteAuto" 5649 "GD_ID_TI_IS_TEACHIN_MASTER_ENABLED" 5650 "GD_ID_TI_ExtSollTEACHIN" 5660 "GD_ID_TI_COMMUNICATING_SLAVE_1" 5661 "GD_ID_TI_COMMUNICATING_SLAVE_2" 5662 "GD_ID_TI_SLAVE_IN_ERROR_STATE_1" 5663 "GD_ID_TI_SLAVE_IN_ERROR_STATE_2" 5665 "GD_ID_TI_AUTOGUIDE_AVAILABLE" 5666 "GD_ID_TI_AUTOGUIDE_COMMAND" 5667 "GD_ID_TI_AUTOGUIDE_ENTER_SEQUENCE" 5668 "GD_ID_TI_AUTOGUIDE_ENTER_TRIGGER_DISTANCE" 5670 "GD_ID_TI_AUTOGUIDE_EXIT_SEQUENCE" 5671 "GD_ID_TI_AUTOGUIDE_EXIT_TRIGGER_DISTANCE" 5673 "GD_ID_TI_AUTOGUIDE_STATE" 5674 "GD_ID_TI_AG_LetzterZustand" 5887 "GD_ID_TI_NUMBER_OF_SEQ_STEPS" 5888 "GD_ID_TI_TRIGGER_VAL_SEQ_POS_1" 5889 "GD_ID_TI_TRIGGER_VAL_SEQ_POS_2" 5890 "GD_ID_TI_TRIGGER_VAL_SEQ_POS_3" 5891 "GD_ID_TI_TRIGGER_VAL_SEQ_POS_4" 5892 "GD_ID_TI_TRIGGER_VAL_SEQ_POS_5" 5893 "GD_ID_TI_TRIGGER_VAL_SEQ_POS_6" 5904 "GD_ID_TI_STEP_NUMBER_POS_1_2" 5905 "GD_ID_TI_STEP_NUMBER_POS_3_4" 5906 "GD_ID_TI_STEP_NUMBER_POS_5_6" 5978 "GD_ID_TI_EDIT_OFFLINE_DIRECTION_SELECTED" 5979 "GD_ID_TI_EDIT_OFFLINE_EXT_FUNCTION" 5980 "GD_ID_TI_EDIT_OFFLINE_EXT_TRIGGER" 5981 "GD_ID_TI_EDIT_OFFLINE_EXT_VALUE" 5984 "GD_ID_TI_EDIT_OFFLINE_DELETE" 5985 "GD_ID_TI_EDIT_OFFLINE_INSERT" 5986 "GD_ID_TI_EDIT_OFFLINE_MOVE_FORWARD" 5987 "GD_ID_TI_EDIT_OFFLINE_MOVE_BACKWARD" 5988 "GD_ID_TI_EditPotiFuncAendern" 5989 "GD_ID_TI_EditPotiTrigAendern" 5990 "GD_ID_TI_EditPotiTrigWertAendern" 6004 "GD_ID_TI_EDIT_OFFLINE_TRACTOR_CONFIG1" 6005 "GD_ID_TI_EDIT_OFFLINE_TRACTOR_CONFIG2" 6006 "GD_ID_TI_EDIT_OFFLINE_MODE_REQUEST" 6007 "GD_ID_TI_CURRENT_EDIT_STATE" 6008 "GD_ID_TI_EDIT_OFFLINE_SAVE_CHANGES_Status" 6008 "GD_ID_TI_EDIT_OFFLINE_SAVE_CHANGES" 6022 "GD_ID_TI_TRIGGER_FUNCTION_SYMBOL_CONFIG_POS_1" 6023 "GD_ID_TI_TRIGGER_FUNCTION_SYMBOL_CONFIG_POS_2" 6024 "GD_ID_TI_TRIGGER_FUNCTION_SYMBOL_CONFIG_POS_3" 6025 "GD_ID_TI_TRIGGER_FUNCTION_SYMBOL_CONFIG_POS_4" 6026 "GD_ID_TI_TRIGGER_FUNCTION_SYMBOL_CONFIG_POS_5" 6027 "GD_ID_TI_TRIGGER_FUNCTION_SYMBOL_CONFIG_POS_6" 6038 "GD_ID_TI_ConfigTrigDirekt" 6040 "GD_ID_TI_AktAnzConfigPfeil" 6042 "GD_ID_TI_TRIGGER_FUNCTION_SYMBOLS_POS_1" 6043 "GD_ID_TI_TRIGGER_FUNCTION_SYMBOLS_POS_2" 6044 "GD_ID_TI_TRIGGER_FUNCTION_SYMBOLS_POS_3" 6045 "GD_ID_TI_TRIGGER_FUNCTION_SYMBOLS_POS_4" 6046 "GD_ID_TI_TRIGGER_FUNCTION_SYMBOLS_POS_5" 6047 "GD_ID_TI_TRIGGER_FUNCTION_SYMBOLS_POS_6" 6062 "GD_ID_TI_CURRENT_STATE_SEQ_POS_1_2" 6063 "GD_ID_TI_CURRENT_STATE_SEQ_POS_3_4" 6064 "GD_ID_TI_CURRENT_STATE_SEQ_POS_5_6" 6070 "GD_ID_TI_DISPLAY_UP_AND_DOWN_SCROLL" 6082 "GD_ID_TI_PAUSE" 6084 "GD_ID_TI_CHANGE_DISPLAYED_SEQ" 6086 "GD_ID_TI_TRIGGER_CONFIGURATION" 6089 "GD_ID_TI_SCROLL_SEQUENCE" 6090 "GD_ID_TI_START_DIRECTION_OF_ALL_SEQ" 6091 "GD_ID_TI_SCROLL_SEQ_STEP" 6101 "GD_ID_TI_ISO_SCC_01_USED" 6131 "GD_ID_TI_SEQ_SELECTED" 6132 "GD_ID_TI_SubStateManInput" 6133 "GD_ID_TI_MASTER_IS_BUSY" 6134 "GD_ID_TI_MASTER_PAUSED_OR_STEP_MODE" 6139 "GD_ID_TI_MASTER_ACTIVATE" 6140 "GD_ID_TI_SUB_STATE" 6141 "GD_ID_TI_DISPLAYED_SEQ" 6142 "GD_ID_TI_MASTER_CURRENT_OR_TARGET_STATE" 6126 "GD_ID_TI_ErrorManagement_Status" 6126 "GD_ID_TI_ErrorManagement" 6143 "GD_ID_TI_LifeMessage" 10240 "GD_ID_CHS_INTERVAL_HOURS_1" 10241 "GD_ID_CHS_NEXT_DUE_1" 10242 "GD_ID_CHS_HOURS_LEFT_1" 10243 "GD_ID_CHS_INTERVAL_HOURS_2" 10244 "GD_ID_CHS_NEXT_DUE_2" 10245 "GD_ID_CHS_HOURS_LEFT_2" 10246 "GD_ID_CHS_INTERVAL_HOURS_3" 10247 "GD_ID_CHS_NEXT_DUE_3" 10248 "GD_ID_CHS_HOURS_LEFT_3" 10249 "GD_ID_CHS_INTERVAL_HOURS_4" 10250 "GD_ID_CHS_NEXT_DUE_4" 10251 "GD_ID_CHS_HOURS_LEFT_4" 10252 "GD_ID_CHS_INTERVAL_HOURS_5" 10253 "GD_ID_CHS_NEXT_DUE_5" 10254 "GD_ID_CHS_HOURS_LEFT_5" 10255 "GD_ID_CHS_INTERVAL_HOURS_6" 10256 "GD_ID_CHS_NEXT_DUE_6" 10257 "GD_ID_CHS_HOURS_LEFT_6" 10258 "GD_ID_CHS_INTERVAL_HOURS_7" 10259 "GD_ID_CHS_NEXT_DUE_7" 10260 "GD_ID_CHS_HOURS_LEFT_7" 10261 "GD_ID_CHS_INTERVAL_HOURS_8" 10262 "GD_ID_CHS_NEXT_DUE_8" 10263 "GD_ID_CHS_HOURS_LEFT_8" 10264 "GD_ID_CHS_INTERVAL_HOURS_9" 10265 "GD_ID_CHS_NEXT_DUE_9" 10266 "GD_ID_CHS_HOURS_LEFT_9" 10267 "GD_ID_CHS_INTERVAL_HOURS_10" 10268 "GD_ID_CHS_NEXT_DUE_10" 10269 "GD_ID_CHS_HOURS_LEFT_10" 10270 "GD_ID_CHS_HOURS_LEFT_OVERALL" 10271 "GD_ID_CHS_NEXT_DUE_OVERALL" 10272 "GD_ID_INFO_NUMBER_OF_COUNTERS" 10273 "GD_ID_INFO_COUNTER_ID_Status" 10273 "GD_ID_INFO_COUNTER_ID" 10274 "GD_ID_INFO_RESET_COUNTER" 10275 "GD_ID_INFO_START_COUNTER" 10276 "GD_ID_INFO_STOP_COUNTER" 10277 "GD_ID_INFO_JOB_TIME_SECONDS" 10278 "GD_ID_INFO_JOB_TIME_HOURS" 10279 "GD_ID_INFO_TIME_ON_ROAD_SECONDS" 10280 "GD_ID_INFO_TIME_ON_ROAD_HOURS" 10281 "GD_ID_INFO_FIELD_TIME_SECONDS" 10282 "GD_ID_INFO_FIELD_TIME_HOURS" 10283 "GD_ID_INFO_WORK_TIME_SECONDS" 10284 "GD_ID_INFO_WORK_TIME_HOURS" 10285 "GD_ID_INFO_FUEL_USED_MSB" 10286 "GD_ID_INFO_FUEL_USED_LSB" 10287 "GD_ID_INFO_DEF_USED_MSB" 10288 "GD_ID_INFO_DEF_USED_LSB" 10289 "GD_ID_INFO_AVG_FUEL_ECONOMY_TIME" 10290 "GD_ID_INFO_FUEL_USED_ROADING_MSB" 10291 "GD_ID_INFO_FUEL_USED_ROADING_LSB" 10292 "GD_ID_INFO_FUEL_USED_FIELD_MSB" 10293 "GD_ID_INFO_FUEL_USED_FIELD_LSB" 10294 "GD_ID_INFO_AVG_FUEL_ECONOMY_ROADING" 10295 "GD_ID_INFO_AVG_FUEL_ECONOMY_FIELD" 10296 "GD_ID_INFO_AVG_FUEL_ECONOMY_WORKING" 10297 "GD_ID_INFO_TOTAL_DISTANCE_TRAVELED_M" 10298 "GD_ID_INFO_TOTAL_DISTANCE_TRAVELED_KM" 10299 "GD_ID_INFO_TOTAL_DISTANCE_FIELD_M" 10300 "GD_ID_INFO_TOTAL_DISTANCE_FIELD_KM" 10301 "GD_ID_INFO_TOTAL_DISTANCE_ROAD_M" 10302 "GD_ID_INFO_TOTAL_DISTANCE_ROAD_KM" 10304 "GD_ID_INFO_AREA_TIME" 10306 "GD_ID_INFO_LAST_RESET_YEAR" 10307 "GD_ID_INFO_LAST_RESET_MONTH" 10308 "GD_ID_INFO_LAST_RESET_DATE" 10309 "GD_ID_INFO_LAST_RESET_HOUR" 10310 "GD_ID_INFO_LAST_RESET_MINUTE" 10311 "GD_ID_INFO_LAST_RESET_SECOND" 10312 "GD_ID_INFO_APPLIED_PER_ACRE" 10313 "GD_ID_VIN_Model_Year" 10314 "GD_ID_VIN_Machine_Type" 10315 "GD_ID_VIN_Sequence_LSB" 10316 "GD_ID_VIN_Sequence_MSB" 10317 "GD_ID_VIN_Check_Letter" 10318 "GD_ID_VIN_Plant_Code" 10319 "GD_ID_VIN_Option_Code" 10320 "GD_ID_VIN_WMI_1" 10321 "GD_ID_VIN_WMI_2" 10322 "GD_ID_VIN_Brand_Code" 10330 "GD_ID_CHS_Software_Project_part1" 10331 "GD_ID_CHS_Software_Project_part2" 10332 "GD_ID_CHS_Software_Project_part3" 10333 "GD_ID_CHS_Software_Project_part4" 10334 "GD_ID_CHS_Software_Version" 10335 "GD_ID_CHS_Software_Revision" 10340 "GD_ID_CHS_Build_Ecu_part1" 10341 "GD_ID_CHS_Build_Ecu_part2" 10342 "GD_ID_CHS_Build_Ecu_part3" 10343 "GD_ID_CHS_Build_Date_Day_Month" 10344 "GD_ID_CHS_Build_Date_Year" 10345 "GD_ID_CHS_Build_Time_Hrs_Min" 10346 "GD_ID_CHS_Build_Time_Seconds" 10347 "GD_ID_CHS_Build_Text" 10360 "GD_ID_INFO_INSTANT_FUEL_L_PER_HOUR" 10361 "GD_ID_INFO_INSTANT_FUEL_L_PER_ACRE" 10362 "GD_ID_INFO_AVG_FUEL_L_PER_HOUR" 10363 "GD_ID_INFO_AVG_FUEL_L_PER_ACRE" 10364 "GD_ID_INFO_AVG_FUEL_RESET_Status" 10364 "GD_ID_INFO_AVG_FUEL_RESET" 10365 "GD_ID_INFO_FUEL_USED_SUM1_MSB" 10366 "GD_ID_INFO_FUEL_USED_SUM1_LSB" 10367 "GD_ID_INFO_DEF_USED_SUM1_MSB" 10368 "GD_ID_INFO_DEF_USED_SUM1_LSB" 10369 "GD_ID_INFO_SUM1_RESET_Status" 10369 "GD_ID_INFO_SUM1_RESET" 10370 "GD_ID_INFO_FUEL_USED_SUM2_MSB" 10371 "GD_ID_INFO_FUEL_USED_SUM2_LSB" 10372 "GD_ID_INFO_DEF_USED_SUM2_MSB" 10373 "GD_ID_INFO_DEF_USED_SUM2_LSB" 10374 "GD_ID_INFO_SUM2_RESET_Status" 10374 "GD_ID_INFO_SUM2_RESET" 10375 "GD_ID_INFO_TOTAL_AREA_APPLIED_MSB" 10376 "GD_ID_INFO_TOTAL_AREA_APPLIED_LSB" 10377 "GD_ID_INFO_VOLUME_APPLIED_MSB" 10378 "GD_ID_INFO_VOLUME_APPLIED_LSB" 10734 "GD_ID_INFO_ErrorManagement_Status" 10734 "GD_ID_INFO_ErrorManagement" 10751 "GD_ID_INFO_LifeMessage" 12288 "GD_ID_SCT_ENABLE" 12289 "GD_ID_SCT_MODUL_OUT_STATUS" 12290 "GD_ID_SCT_MODUL_IN_STATUS" 12298 "GD_ID_SCT_STATUSDISPLAY_TERMINAL" 12303 "GD_ID_SCT_TURNING_OFF_REASON" 12304 "GD_ID_SCT_STATE" 12305 "GD_ID_SCT_VOTED_ACTIVE_CLASS_1" 12306 "GD_ID_SCT_VOTED_ACTIVE_CLASS_2" 12312 "GD_ID_SCT_SETPOINT_Status" 12312 "GD_ID_SCT_SETPOINT" 12313 "GD_ID_SCT_SETPOINT_FEELER_GUIDANCE_Status" 12313 "GD_ID_SCT_SETPOINT_FEELER_GUIDANCE" 12314 "GD_ID_SCT_SETPOINT_CURVATURE_Status" 12314 "GD_ID_SCT_SETPOINT_CURVATURE" 12315 "GD_ID_SCT_SETPOINT_CURVATURE_TIM_Status" 12315 "GD_ID_SCT_SETPOINT_CURVATURE_TIM" 12316 "GD_ID_SCT_SETPOINT_CURVATURE_FEELER_GUIDANCE_Status" 12316 "GD_ID_SCT_SETPOINT_CURVATURE_FEELER_GUIDANCE" 12320 "GD_ID_SCT_WAS_RAW_VALUE" 12321 "GD_ID_SCT_WAS_SCALED_VALUE" 12322 "GD_ID_SCT_WAS_SENSOR_ANGLE" 12323 "GD_ID_SCT_WAS_MEDIAN_ANGLE" 12324 "GD_ID_SCT_WAS_MEDIAN_ANGLE_MAX" 12325 "GD_ID_SCT_WAS_VIRTUAL_ANGLE" 12328 "GD_ID_SCT_WAS_MEDIAN_CURVATURE" 12329 "GD_ID_SCT_WAS_MEDIAN_CURVATURE_MAX" 12334 "GD_ID_SCT_WAS_CALIB_COMMAND" 12335 "GD_ID_SCT_WAS_CALIB_STATUS" 12336 "GD_ID_SCT_SWS_RAW_VALUE_Status" 12336 "GD_ID_SCT_SWS_RAW_VALUE" 12338 "GD_ID_SCT_SWS_LIMITED_ANGLE_Status" 12338 "GD_ID_SCT_SWS_LIMITED_ANGLE" 12339 "GD_ID_SCT_SWS_CONTINUED_ANGLE_Status" 12339 "GD_ID_SCT_SWS_CONTINUED_ANGLE" 12340 "GD_ID_SCT_SWS_ROTATIONAL_SPEED" 12352 "GD_ID_SCT_VALVE_SETPOINT" 12353 "GD_ID_SCT_VALVE_POSITION" 12366 "GD_ID_SCT_VALVE_CALIB_COMMAND" 12367 "GD_ID_SCT_VALVE_CALIB_STATUS" 12368 "GD_ID_SCT_PILOTVALVE_STATUS_Status" 12368 "GD_ID_SCT_PILOTVALVE_STATUS" 12388 "GD_ID_SCT_OLAY_STEER_FACTOR" 12416 "GD_ID_SCT_HEADLAND_CMD_Status" 12416 "GD_ID_SCT_HEADLAND_CMD" 12417 "GD_ID_SCT_3RDPARTY_READY_STATUS_Status" 12417 "GD_ID_SCT_3RDPARTY_READY_STATUS" 12418 "GD_ID_SCT_3RDPARTY_POSITION_STATUS_Status" 12418 "GD_ID_SCT_3RDPARTY_POSITION_STATUS" 12419 "GD_ID_SCT_3RDPARTY_CANCEL_REQUEST_Status" 12419 "GD_ID_SCT_3RDPARTY_CANCEL_REQUEST" 12420 "GD_ID_SCT_3RDPARTY_COMMAND_GUIDANCE_Status" 12420 "GD_ID_SCT_3RDPARTY_COMMAND_GUIDANCE" 12544 "GD_ID_SCT_TSD_MIN_SPEED_FORWARD" 12545 "GD_ID_SCT_TSD_MAX_SPEED_FORWARD" 12546 "GD_ID_SCT_TSD_MIN_MACHINE_RADIUS" 12547 "GD_ID_SCT_TSD_MAX_ACQUISITION_ANGLE" 12560 "GD_ID_SCT_GUIDANCE_CONFIGURATION_DATA_Status" 12560 "GD_ID_SCT_GUIDANCE_CONFIGURATION_DATA" 12568 "GD_ID_SCT_STEERING_MODE_Status" 12568 "GD_ID_SCT_STEERING_MODE" 12569 "GD_ID_SCT_SECONDARY_WAS_RAW_VALUE_Status" 12569 "GD_ID_SCT_SECONDARY_WAS_RAW_VALUE" 12570 "GD_ID_SCT_SECONDARY_WAS_SENSOR_ANGLE_Status" 12570 "GD_ID_SCT_SECONDARY_WAS_SENSOR_ANGLE" 12571 "GD_ID_SCT_SECONDARY_WAS_MEDIAN_ANGLE_Status" 12571 "GD_ID_SCT_SECONDARY_WAS_MEDIAN_ANGLE" 12572 "GD_ID_SCT_SECONDARY_WAS_MEDIAN_ANGLE_MAX_Status" 12572 "GD_ID_SCT_SECONDARY_WAS_MEDIAN_ANGLE_MAX" 12573 "GD_ID_SCT_ALS_X_OFFSET_Status" 12573 "GD_ID_SCT_ALS_X_OFFSET" 12574 "GD_ID_SCT_ALS_Y_OFFSET_Status" 12574 "GD_ID_SCT_ALS_Y_OFFSET" 12575 "GD_ID_SCT_ADDITIONAL_WORKING_HEIGHT" 12576 "GD_ID_SCT_VEHICLE_CURRENT_PAYLOAD_Status" 12576 "GD_ID_SCT_VEHICLE_CURRENT_PAYLOAD" 12598 "GD_ID_SCT_ISO_STATE" 12599 "GD_ID_SCT_VEHICLE_SPEED_Status" 12599 "GD_ID_SCT_VEHICLE_SPEED" 12600 "GD_ID_SCT_VEHICLE_MOVEMENT_Status" 12600 "GD_ID_SCT_VEHICLE_MOVEMENT" 12601 "GD_ID_SCT_PARKING_BRAKE_Status" 12601 "GD_ID_SCT_PARKING_BRAKE" 12608 "GD_ID_SCT_CONTROL_MSG_TERMINAL" 12609 "GD_ID_SCT_CONTROL_MSG_GUIDEANCE" 12610 "GD_ID_SCT_MODIFIED_REFERENCE_POINT_HEIGHT" 12611 "GD_ID_SCT_MODIFIED_GNSS_ANTENNA_X_OFFSET" 12612 "GD_ID_SCT_MODIFIED_GNSS_ANTENNA_Y_OFFSET" 12613 "GD_ID_SCT_MODIFIED_GNSS_ANTENNA_Z_OFFSET" 12614 "GD_ID_SCT_MODIFIED_TRACK_WIDTH" 12615 "GD_ID_SCT_MODIFIED_MOUNTING_ERROR_Y_OFFSET" 12736 "GD_ID_SCT_TRACTOR_SN_TYPE" 12737 "GD_ID_SCT_TRACTOR_SN_GROUP" 12738 "GD_ID_SCT_TRACTOR_SN_NUMBER" 12782 "GD_ID_SCT_ERROR_ACKNOWLEDGE_Status" 12782 "GD_ID_SCT_ERROR_ACKNOWLEDGE" 12784 "GD_ID_SCT_ACTIVATE_DIAGNOSTICS" 12788 "GD_ID_SCT_SAFETY_VERSION_Status" 12788 "GD_ID_SCT_SAFETY_VERSION" 12789 "GD_ID_SCT_LIB_SAFETY_VERSION" 12792 "GD_ID_SCT_RECIPE_ACCESS_SETPOINT" 12793 "GD_ID_SCT_TI_ACCESS_SETPOINT" 12794 "GD_ID_SCT_TI_ACCESS_STATE" 12795 "GD_ID_SCT_TI_ACCESS_STATE_KL15" 12797 "GD_ID_SCT_TI_SUB_STATE" 12782 "GD_ID_SCT_ErrorManagement_Status" 12782 "GD_ID_SCT_ErrorManagement" 12799 "GD_ID_SCT_LifeMessage" 12800 "GD_ID_Engine_Rpm" 12801 "GD_ID_Engine_Load" 12802 "GD_ID_Engine_Coolant_Temp_Status" 12802 "GD_ID_Engine_Coolant_Temp" 12803 "GD_ID_Engine_Air_Intake_Temp" 12804 "GD_ID_Engine_Battery_Power_Status" 12804 "GD_ID_Engine_Battery_Power" 12805 "GD_ID_Engine_Air_Intake_Pressure" 12806 "GD_ID_Engine_Oil_Pressure" 12807 "GD_ID_Engine_Rpm_Setpoint_Status" 12807 "GD_ID_Engine_Rpm_Setpoint" 12808 "GD_ID_Engine_Standing_Still_Status" 12808 "GD_ID_Engine_Standing_Still" 12809 "GD_ID_Engine_Oil_Pressure_Low_Status" 12809 "GD_ID_Engine_Oil_Pressure_Low" 12810 "GD_ID_Engine_Oil_Service_Interval_Status" 12810 "GD_ID_Engine_Oil_Service_Interval" 12811 "GD_ID_Engine_Hours" 12812 "GD_ID_Engine_Amber_Warning_Lamp_Status" 12812 "GD_ID_Engine_Amber_Warning_Lamp" 12813 "GD_ID_Engine_Red_Stop_Lamp_Status" 12813 "GD_ID_Engine_Red_Stop_Lamp" 12814 "GD_ID_Alt_Low_Idle" 12815 "GD_ID_Engine_Audible_Warning_Status" 12815 "GD_ID_Engine_Audible_Warning" 12816 "GD_ID_Ambient_Temp" 12817 "GD_ID_Ecu_Temp" 12820 "GD_ID_Fuel_Rate" 12821 "GD_ID_Trip_Fuel" 12822 "GD_ID_Trip_DEF" 12823 "GD_ID_DEF_Level" 12824 "GD_ID_Water_In_Fuel_Status" 12824 "GD_ID_Water_In_Fuel" 12825 "GD_ID_Engine_Malfunction_Lamp_Status" 12825 "GD_ID_Engine_Malfunction_Lamp" 12826 "GD_ID_DEF_Level_Warning_Status" 12826 "GD_ID_DEF_Level_Warning" 12827 "GD_ID_Engine_WaitToStart_Status" 12827 "GD_ID_Engine_WaitToStart" 12828 "GD_ID_Engine_Operating_State" 12829 "GD_ID_Engine_Start_Enable_Status" 12829 "GD_ID_Engine_Start_Enable" 12830 "GD_ID_Implement_Transport_State_Status" 12830 "GD_ID_Implement_Transport_State" 12831 "GD_ID_Implement_Work_State_Status" 12831 "GD_ID_Implement_Work_State" 12832 "GD_ID_Implement_Actual_Working_Width" 12833 "GD_ID_Implement_Actual_Flow" 12834 "GD_ID_Implement_ReadyForFieldWork_Status" 12834 "GD_ID_Implement_ReadyForFieldWork" 12840 "GD_ID_WheelBasedDistance_km" 12841 "GD_ID_WheelBasedDistance_m" 12842 "GD_ID_GroundBasedDistance_km" 12843 "GD_ID_GroundBasedDistance_m" 12844 "GD_ID_SelectedSpeedDistance_km" 12845 "GD_ID_SelectedSpeedDistance_m" 12846 "GD_ID_MachineSelectedSpeed" 12847 "GD_ID_WBZ_MACHINE_SELECTED_SOURCE" 12848 "GD_ID_WBZ_MAX_ENG_RPM" 12850 "GD_ID_Working_Time_SecMin_VD" 12851 "GD_ID_Working_Time_Hours_VD" 12852 "GD_ID_Worked_Area_Ha_VD" 12853 "GD_ID_Worked_Area_0001Ha_VD" 12854 "GD_ID_Used_Fuel_VD" 12855 "GD_ID_Remaining_Time_SecMin_VD" 12856 "GD_ID_Remaining_Time_Hours_VD" 12857 "GD_ID_Remaining_Area_Ha_VD" 12858 "GD_ID_Remaining_Area_0001Ha_VD" 12859 "GD_ID_Required_Fuel_VD" 12860 "GD_ID_Field_Size_Ha_VD" 12861 "GD_ID_Field_Size_0001Ha_VD" 12862 "GD_ID_Reset_VD_Status" 12862 "GD_ID_Reset_VD" 12870 "GD_Iso_IsoState_state_RW" 12871 "GD_ID_WBZ_TERMINAL_PAGE_SIZE" 12878 "GD_ID_WBZ_ENG_DEF_LVL_LAMP_Status" 12878 "GD_ID_WBZ_ENG_DEF_LVL_LAMP" 12879 "GD_ID_WBZ_ENG_DEF_MIL_LAMP_Status" 12879 "GD_ID_WBZ_ENG_DEF_MIL_LAMP" 12880 "GD_ID_IgnitionState_Status" 12880 "GD_ID_IgnitionState" 12881 "GD_ID_WBZ_ENG_FAN_RPM" 12882 "GD_ID_WBZ_ENG_FUEL_TEMP" 12883 "GD_ID_WBZ_ENG_AUXIO1_01" 12884 "GD_ID_WBZ_ENG_FAN_DUTY_CYCLE" 12885 "GD_ID_WBZ_DEF_TEMP" 12886 "GD_ID_WBZ_EXHAUST_TEMP" 12887 "GD_ID_WBZ_FUEL_PRESSURE" 12888 "GD_ID_WBZ_CURVATURE_SETPOINT" 12889 "GD_ID_WBZ_CURVATURE_ENABLE_Status" 12889 "GD_ID_WBZ_CURVATURE_ENABLE" 12890 "GD_ID_WBZ_ENG_START_CMD_Status" 12890 "GD_ID_WBZ_ENG_START_CMD" 12891 "GD_ID_WBZ_THIRD_PARTY_MANUS_Status" 12891 "GD_ID_WBZ_THIRD_PARTY_MANUS" 12892 "GD_ID_WBZ_NEW_LEADER_ACL_Status" 12892 "GD_ID_WBZ_NEW_LEADER_ACL" 12901 "GD_ID_WBZ_AUXIO1_01_FI02" 12902 "GD_ID_WBZ_AUXIO1_02_FI02" 12903 "GD_ID_WBZ_AUXIO1_03_FI02" 12904 "GD_ID_WBZ_AUXIO1_04_FI02" 12905 "GD_ID_WBZ_AUXIO1_05_FI02" 12906 "GD_ID_WBZ_AUXIO1_06_FI02" 12907 "GD_ID_WBZ_AUXIO1_07_FI02" 12908 "GD_ID_WBZ_AUXIO1_08_FI02" 12909 "GD_ID_WBZ_AUXIO1_09_FI02" 12910 "GD_ID_WBZ_AUXIO1_10_FI02" 12911 "GD_ID_WBZ_AUXIO1_11_FI02" 12912 "GD_ID_WBZ_AUXIO1_12_FI02" 12917 "GD_ID_WBZ_AUXIO2_17_FI02" 12918 "GD_ID_WBZ_AUXIO2_18_FI02" 12919 "GD_ID_WBZ_AUXIO1_01_FI00" 12920 "GD_ID_WBZ_AUXIO1_02_FI00" 12921 "GD_ID_WBZ_AUXIO1_03_FI00" 12922 "GD_ID_WBZ_AUXIO1_04_FI00" 12923 "GD_ID_WBZ_AUXIO1_05_FI00" 12924 "GD_ID_WBZ_AUXIO1_06_FI00" 12925 "GD_ID_WBZ_AUXIO1_07_FI00" 12926 "GD_ID_WBZ_AUXIO1_08_FI00" 12927 "GD_ID_WBZ_AUXIO1_09_FI00" 12928 "GD_ID_WBZ_AUXIO1_10_FI00" 12929 "GD_ID_WBZ_AUXIO1_11_FI00" 12930 "GD_ID_WBZ_AUXIO1_12_FI00" 12931 "GD_ID_WBZ_AUXIO1_13_FI00" 12932 "GD_ID_WBZ_AUXIO1_14_FI00" 12933 "GD_ID_WBZ_AUXIO1_15_FI00" 12934 "GD_ID_WBZ_AUXIO1_16_FI00" 12935 "GD_ID_WBZ_AUXIO1_CH2" 12936 "GD_ID_WBZ_AUXIO2_17_FI00" 12937 "GD_ID_WBZ_AUXIO2_18_FI00" 12940 "GD_ID_WBZ_AUXIO2_21_FI00" 12941 "GD_ID_WBZ_AUXIO2_22_FI00" 12945 "GD_ID_WBZ_AUXIO2_26_FI00" 12946 "GD_ID_WBZ_AUXIO2_27_FI00" 12947 "GD_ID_WBZ_AUXIO2_28_FI00" 12948 "GD_ID_WBZ_AUXIO2_29_FI00" 12949 "GD_ID_WBZ_AUXIO2_30_FI00" 12950 "GD_ID_WBZ_AUXIO2_31_FI00" 12951 "GD_ID_WBZ_AUXIO2_32_FI00" 12952 "GD_ID_WBZ_AUXIO1_01_FI01" 12953 "GD_ID_WBZ_AUXIO1_02_FI01" 12954 "GD_ID_WBZ_AUXIO1_03_FI01" 12955 "GD_ID_WBZ_AUXIO1_04_FI01" 12956 "GD_ID_WBZ_AUXIO1_05_FI01" 12957 "GD_ID_WBZ_AUXIO1_06_FI01" 12958 "GD_ID_WBZ_AUXIO1_07_FI01" 12959 "GD_ID_WBZ_AUXIO1_08_FI01" 12960 "GD_ID_WBZ_AUXIO1_09_FI01" 12961 "GD_ID_WBZ_AUXIO1_10_FI01" 12962 "GD_ID_WBZ_AUXIO1_11_FI01" 12963 "GD_ID_WBZ_AUXIO1_12_FI01" 12964 "GD_ID_WBZ_AUXIO1_13_FI01" 12965 "GD_ID_WBZ_AUXIO1_14_FI01" 12966 "GD_ID_WBZ_AUXIO1_15_FI01" 12967 "GD_ID_WBZ_AUXIO1_16_FI01" 12969 "GD_ID_WBZ_AUXIO2_17_FI01" 12970 "GD_ID_WBZ_AUXIO2_18_FI01" 12973 "GD_ID_WBZ_AUXIO2_21_FI01" 12974 "GD_ID_WBZ_AUXIO2_22_FI01" 12978 "GD_ID_WBZ_AUXIO2_26_FI01" 12979 "GD_ID_WBZ_AUXIO2_27_FI01" 12980 "GD_ID_WBZ_AUXIO2_28_FI01" 12981 "GD_ID_WBZ_AUXIO2_29_FI01" 12982 "GD_ID_WBZ_AUXIO2_30_FI01" 12983 "GD_ID_WBZ_AUXIO2_31_FI01" 12984 "GD_ID_WBZ_AUXIO2_32_FI01" 12985 "GD_ID_WBZ_AUXIO2_21_FI02" 12986 "GD_ID_WBZ_AUXIO2_22_FI02" 13000 "GD_ID_WBZ_TI_ACCESS" 13052 "GD_ID_Unknown_Engine_Error_Part1" 13053 "GD_ID_Unknown_Engine_Error_Part2" 13120 "GD_ID_WBZ_DPF_WARNING_LAMP_Status" 13120 "GD_ID_WBZ_DPF_WARNING_LAMP" 13121 "GD_ID_WBZ_DPF_HEST_LAMP_Status" 13121 "GD_ID_WBZ_DPF_HEST_LAMP" 13123 "GD_ID_WBZ_DPF_SOOT_ASH" 13124 "GD_ID_WBZ_DPF_HOURS_SINCE_REGEN" 13125 "GD_ID_WBZ_DPF_MINUTES_SINCE_REGEN" 13126 "GD_ID_WBZ_DPF_STATI" 13128 "GD_ID_WBZ_DPF_INHIBITED_STATI" 13129 "GD_ID_WBZ_DPF_CONTROL_REGEN" 13130 "GD_ID_WBZ_DPF_ENABLE_REGEN_Status" 13130 "GD_ID_WBZ_DPF_ENABLE_REGEN" 13294 "GD_ID_WBZ_ErrorManagement_Status" 13294 "GD_ID_WBZ_ErrorManagement" 13311 "GD_ID_WBZ_LifeMessage" 13376 "GD_ID_SystemBrigthness" 13440 "GD_ID_SystemBrightness_Errors" 13806 "GD_ID_SBL_ErrorManagement_Status" 13806 "GD_ID_SBL_ErrorManagement" 13823 "GD_ID_SBL_LifeMessage" 13824 "GD_ID_Current_Track_Width" 13825 "GD_ID_TA_Min_Track_Width" 13826 "GD_ID_Max_Track_Width" 13827 "GD_ID_Calib_State_Track_Width_Status" 13827 "GD_ID_Calib_State_Track_Width" 13828 "GD_ID_TA_Front_Axle_Width" 13829 "GD_ID_TA_Front_Track_Width" 13830 "GD_ID_TA_Rear_Axle_Width" 13831 "GD_ID_TA_Rear_Track_Width" 13832 "GD_ID_Track_Adjust_Errors_Status" 13832 "GD_ID_Track_Adjust_Errors" 13833 "GD_ID_TA_Calibration_Command" 13834 "GD_ID_TA_Calibration_State" 13835 "GD_ID_TA_MANUAL_IN_Status" 13835 "GD_ID_TA_MANUAL_IN" 13836 "GD_ID_TA_MANUAL_OUT_Status" 13836 "GD_ID_TA_MANUAL_OUT" 13839 "GD_ID_TA_Actual_Front_In_R_Status" 13839 "GD_ID_TA_Actual_Front_In_R" 13840 "GD_ID_TA_Actual_Front_Out_R_Status" 13840 "GD_ID_TA_Actual_Front_Out_R" 13841 "GD_ID_TA_Actual_Rear_In_R_Status" 13841 "GD_ID_TA_Actual_Rear_In_R" 13842 "GD_ID_TA_Actual_Rear_Out_R_Status" 13842 "GD_ID_TA_Actual_Rear_Out_R" 13843 "GD_ID_TA_Actual_Front_In_Status" 13843 "GD_ID_TA_Actual_Front_In" 13844 "GD_ID_TA_Actual_Front_Out_Status" 13844 "GD_ID_TA_Actual_Front_Out" 13845 "GD_ID_TA_Actual_Rear_In_Status" 13845 "GD_ID_TA_Actual_Rear_In" 13846 "GD_ID_TA_Actual_Rear_Out_Status" 13846 "GD_ID_TA_Actual_Rear_Out" 13847 "GD_ID_Track_Adjust_Equipped_Status" 13847 "GD_ID_Track_Adjust_Equipped" 13848 "GD_ID_TA_Min_Tire_Track_Width" 13849 "GD_ID_Current_Axle_Width" 13850 "GD_ID_TA_Operation_State_Status" 13850 "GD_ID_TA_Operation_State" 13851 "GD_ID_TA_In_Tolerance_Status" 13851 "GD_ID_TA_In_Tolerance" 13852 "GD_ID_TA_Auto_Enable_A_Status" 13852 "GD_ID_TA_Auto_Enable_A" 13853 "GD_ID_TA_Auto_Enable_B_Status" 13853 "GD_ID_TA_Auto_Enable_B" 13854 "GD_ID_TA_Auto_Enable_Dual_Status" 13854 "GD_ID_TA_Auto_Enable_Dual" 13855 "GD_ID_TA_Setpoint_A" 13856 "GD_ID_TA_Setpoint_B" 13857 "GD_ID_TA_Setpoint_Dual_Front" 13858 "GD_ID_TA_Setpoint_Dual_Rear" 13864 "GD_ID_TA_Equipped_Status" 13864 "GD_ID_TA_Equipped" 13874 "GD_ID_TA_FL_POSITION" 13875 "GD_ID_TA_FR_POSITION" 13876 "GD_ID_TA_RL_POSITION" 13877 "GD_ID_TA_RR_POSITION" 13878 "GD_ID_TA_Setpoint_A_Rear_Status" 13878 "GD_ID_TA_Setpoint_A_Rear" 13879 "GD_ID_TA_Setpoint_B_Rear_Status" 13879 "GD_ID_TA_Setpoint_B_Rear" 13880 "GD_ID_TA_TARGET_TRACKWIDTH_FL" 13881 "GD_ID_TA_TARGET_TRACKWIDTH_FR" 13882 "GD_ID_TA_TARGET_TRACKWIDTH_RL" 13883 "GD_ID_TA_TARGET_TRACKWIDTH_RR" 13884 "GD_ID_TA_ADDITIONAL_WIDTH_FL" 13885 "GD_ID_TA_ADDITIONAL_WIDTH_FR" 13886 "GD_ID_TA_ADDITIONAL_WIDTH_RL" 13887 "GD_ID_TA_ADDITIONAL_WIDTH_RR" 14318 "GD_ID_TA_ErrorManagement_Status" 14318 "GD_ID_TA_ErrorManagement" 14335 "GD_ID_TA_LifeMessage" 15360 "GD_ID_RG3_HYDRAULIC_LEVEL" 15361 "GD_ID_RG3_TURN_SCT_TO_OFF_Status" 15361 "GD_ID_RG3_TURN_SCT_TO_OFF" 15362 "GD_ID_RG3_HVAC_COMPRESSOR_Status" 15362 "GD_ID_RG3_HVAC_COMPRESSOR" 15363 "GD_ID_RG3_HVAC_INPUT_VOLTAGE" 15364 "GD_ID_RG3_FRONT_SYS_PUMP_COMMAND_Status" 15364 "GD_ID_RG3_FRONT_SYS_PUMP_COMMAND" 15365 "GD_ID_RG3_FRONT_SYS_PUMP_ACTUAL" 15366 "GD_ID_RG3_REAR_SYS_PUMP_COMMAND_Status" 15366 "GD_ID_RG3_REAR_SYS_PUMP_COMMAND" 15367 "GD_ID_RG3_REAR_SYS_PUMP_ACTUAL" 15460 "GD_ID_RG3_TI_ACCESS" 15860 "GD_ID_RG3_OPERATOR_PRESENCE_Status" 15860 "GD_ID_RG3_OPERATOR_PRESENCE" 15854 "GD_ID_RG3_ErrorManagement_Status" 15854 "GD_ID_RG3_ErrorManagement" 15871 "GD_ID_RG3_LifeMessage" 15872 "GD_ID_EMM_SIGNAL_LN00_ERROR_W_Status" 15872 "GD_ID_EMM_SIGNAL_LN00_ERROR_W" 15873 "GD_ID_EMM_SIGNAL_LN01_ERROR_W_Status" 15873 "GD_ID_EMM_SIGNAL_LN01_ERROR_W" 15874 "GD_ID_EMM_SIGNAL_LN02_ERROR_W_Status" 15874 "GD_ID_EMM_SIGNAL_LN02_ERROR_W" 15875 "GD_ID_EMM_SIGNAL_LN03_ERROR_W_Status" 15875 "GD_ID_EMM_SIGNAL_LN03_ERROR_W" 15876 "GD_ID_EMM_SIGNAL_LN04_ERROR_W_Status" 15876 "GD_ID_EMM_SIGNAL_LN04_ERROR_W" 15877 "GD_ID_EMM_SIGNAL_LN05_ERROR_W_Status" 15877 "GD_ID_EMM_SIGNAL_LN05_ERROR_W" 15878 "GD_ID_EMM_SIGNAL_LN06_ERROR_W_Status" 15878 "GD_ID_EMM_SIGNAL_LN06_ERROR_W" 15879 "GD_ID_EMM_SIGNAL_LN07_ERROR_W_Status" 15879 "GD_ID_EMM_SIGNAL_LN07_ERROR_W" 15880 "GD_ID_EMM_SIGNAL_LN08_ERROR_W_Status" 15880 "GD_ID_EMM_SIGNAL_LN08_ERROR_W" 15881 "GD_ID_EMM_SIGNAL_LN09_ERROR_W_Status" 15881 "GD_ID_EMM_SIGNAL_LN09_ERROR_W" 15882 "GD_ID_EMM_SIGNAL_LN10_ERROR_W_Status" 15882 "GD_ID_EMM_SIGNAL_LN10_ERROR_W" 15883 "GD_ID_EMM_SIGNAL_LN11_ERROR_W_Status" 15883 "GD_ID_EMM_SIGNAL_LN11_ERROR_W" 15884 "GD_ID_EMM_SIGNAL_LN12_ERROR_W_Status" 15884 "GD_ID_EMM_SIGNAL_LN12_ERROR_W" 15885 "GD_ID_EMM_SIGNAL_LN13_ERROR_W_Status" 15885 "GD_ID_EMM_SIGNAL_LN13_ERROR_W" 15886 "GD_ID_EMM_SIGNAL_LN14_ERROR_W_Status" 15886 "GD_ID_EMM_SIGNAL_LN14_ERROR_W" 15887 "GD_ID_EMM_SIGNAL_LN15_ERROR_W_Status" 15887 "GD_ID_EMM_SIGNAL_LN15_ERROR_W" 15888 "GD_ID_EMM_SIGNAL_LN16_ERROR_W_Status" 15888 "GD_ID_EMM_SIGNAL_LN16_ERROR_W" 15889 "GD_ID_EMM_SIGNAL_LN17_ERROR_W_Status" 15889 "GD_ID_EMM_SIGNAL_LN17_ERROR_W" 15890 "GD_ID_EMM_SIGNAL_LN18_ERROR_W_Status" 15890 "GD_ID_EMM_SIGNAL_LN18_ERROR_W" 15891 "GD_ID_EMM_SIGNAL_LN19_ERROR_W_Status" 15891 "GD_ID_EMM_SIGNAL_LN19_ERROR_W" 15892 "GD_ID_EMM_SIGNAL_LN20_ERROR_W_Status" 15892 "GD_ID_EMM_SIGNAL_LN20_ERROR_W" 15893 "GD_ID_EMM_SIGNAL_LN21_ERROR_W_Status" 15893 "GD_ID_EMM_SIGNAL_LN21_ERROR_W" 15894 "GD_ID_EMM_SIGNAL_LN22_ERROR_W_Status" 15894 "GD_ID_EMM_SIGNAL_LN22_ERROR_W" 15895 "GD_ID_EMM_SIGNAL_LN23_ERROR_W_Status" 15895 "GD_ID_EMM_SIGNAL_LN23_ERROR_W" 15896 "GD_ID_EMM_SIGNAL_LN24_ERROR_W_Status" 15896 "GD_ID_EMM_SIGNAL_LN24_ERROR_W" 15897 "GD_ID_EMM_SIGNAL_LN25_ERROR_W_Status" 15897 "GD_ID_EMM_SIGNAL_LN25_ERROR_W" 15898 "GD_ID_EMM_SIGNAL_LN26_ERROR_W_Status" 15898 "GD_ID_EMM_SIGNAL_LN26_ERROR_W" 15899 "GD_ID_EMM_SIGNAL_LN27_ERROR_W_Status" 15899 "GD_ID_EMM_SIGNAL_LN27_ERROR_W" 15900 "GD_ID_EMM_SIGNAL_LN28_ERROR_W_Status" 15900 "GD_ID_EMM_SIGNAL_LN28_ERROR_W" 15901 "GD_ID_EMM_SIGNAL_LN29_ERROR_W_Status" 15901 "GD_ID_EMM_SIGNAL_LN29_ERROR_W" 15902 "GD_ID_EMM_SIGNAL_LN30_ERROR_W_Status" 15902 "GD_ID_EMM_SIGNAL_LN30_ERROR_W" 15903 "GD_ID_EMM_SIGNAL_LN31_ERROR_W_Status" 15903 "GD_ID_EMM_SIGNAL_LN31_ERROR_W" 15904 "GD_ID_EMM_SIGNAL_LN32_ERROR_W_Status" 15904 "GD_ID_EMM_SIGNAL_LN32_ERROR_W" 15905 "GD_ID_EMM_SIGNAL_LN33_ERROR_W_Status" 15905 "GD_ID_EMM_SIGNAL_LN33_ERROR_W" 15906 "GD_ID_EMM_SIGNAL_LN34_ERROR_W_Status" 15906 "GD_ID_EMM_SIGNAL_LN34_ERROR_W" 15907 "GD_ID_EMM_SIGNAL_LN35_ERROR_W_Status" 15907 "GD_ID_EMM_SIGNAL_LN35_ERROR_W" 15908 "GD_ID_EMM_SIGNAL_LN36_ERROR_W_Status" 15908 "GD_ID_EMM_SIGNAL_LN36_ERROR_W" 15909 "GD_ID_EMM_SIGNAL_LN37_ERROR_W_Status" 15909 "GD_ID_EMM_SIGNAL_LN37_ERROR_W" 15910 "GD_ID_EMM_SIGNAL_LN38_ERROR_W_Status" 15910 "GD_ID_EMM_SIGNAL_LN38_ERROR_W" 15911 "GD_ID_EMM_SIGNAL_LN39_ERROR_W_Status" 15911 "GD_ID_EMM_SIGNAL_LN39_ERROR_W" 15912 "GD_ID_EMM_SIGNAL_LN40_ERROR_W_Status" 15912 "GD_ID_EMM_SIGNAL_LN40_ERROR_W" 15913 "GD_ID_EMM_SIGNAL_LN41_ERROR_W_Status" 15913 "GD_ID_EMM_SIGNAL_LN41_ERROR_W" 15914 "GD_ID_EMM_SIGNAL_LN42_ERROR_W_Status" 15914 "GD_ID_EMM_SIGNAL_LN42_ERROR_W" 15915 "GD_ID_EMM_SIGNAL_LN43_ERROR_W_Status" 15915 "GD_ID_EMM_SIGNAL_LN43_ERROR_W" 15916 "GD_ID_EMM_SIGNAL_LN44_ERROR_W_Status" 15916 "GD_ID_EMM_SIGNAL_LN44_ERROR_W" 15917 "GD_ID_EMM_SIGNAL_LN45_ERROR_W_Status" 15917 "GD_ID_EMM_SIGNAL_LN45_ERROR_W" 15918 "GD_ID_EMM_SIGNAL_LN46_ERROR_W_Status" 15918 "GD_ID_EMM_SIGNAL_LN46_ERROR_W" 15919 "GD_ID_EMM_SIGNAL_LN47_ERROR_W_Status" 15919 "GD_ID_EMM_SIGNAL_LN47_ERROR_W" 15920 "GD_ID_EMM_SIGNAL_LN48_ERROR_W_Status" 15920 "GD_ID_EMM_SIGNAL_LN48_ERROR_W" 15921 "GD_ID_EMM_SIGNAL_LN49_ERROR_W_Status" 15921 "GD_ID_EMM_SIGNAL_LN49_ERROR_W" 15922 "GD_ID_EMM_SIGNAL_LN50_ERROR_W_Status" 15922 "GD_ID_EMM_SIGNAL_LN50_ERROR_W" 15923 "GD_ID_EMM_SIGNAL_LN51_ERROR_W_Status" 15923 "GD_ID_EMM_SIGNAL_LN51_ERROR_W" 15924 "GD_ID_EMM_SIGNAL_LN52_ERROR_W_Status" 15924 "GD_ID_EMM_SIGNAL_LN52_ERROR_W" 15925 "GD_ID_EMM_SIGNAL_LN53_ERROR_W_Status" 15925 "GD_ID_EMM_SIGNAL_LN53_ERROR_W" 15926 "GD_ID_EMM_SIGNAL_LN54_ERROR_W_Status" 15926 "GD_ID_EMM_SIGNAL_LN54_ERROR_W" 15927 "GD_ID_EMM_SIGNAL_LN55_ERROR_W_Status" 15927 "GD_ID_EMM_SIGNAL_LN55_ERROR_W" 15928 "GD_ID_EMM_SIGNAL_LN56_ERROR_W_Status" 15928 "GD_ID_EMM_SIGNAL_LN56_ERROR_W" 15929 "GD_ID_EMM_SIGNAL_LN57_ERROR_W_Status" 15929 "GD_ID_EMM_SIGNAL_LN57_ERROR_W" 15930 "GD_ID_EMM_SIGNAL_LN58_ERROR_W_Status" 15930 "GD_ID_EMM_SIGNAL_LN58_ERROR_W" 15931 "GD_ID_EMM_SIGNAL_LN59_ERROR_W_Status" 15931 "GD_ID_EMM_SIGNAL_LN59_ERROR_W" 15932 "GD_ID_EMM_SIGNAL_LN60_ERROR_W_Status" 15932 "GD_ID_EMM_SIGNAL_LN60_ERROR_W" 15933 "GD_ID_EMM_SIGNAL_LN61_ERROR_W_Status" 15933 "GD_ID_EMM_SIGNAL_LN61_ERROR_W" 15934 "GD_ID_EMM_SIGNAL_LN62_ERROR_W_Status" 15934 "GD_ID_EMM_SIGNAL_LN62_ERROR_W" 15935 "GD_ID_EMM_SIGNAL_LN63_ERROR_W_Status" 15935 "GD_ID_EMM_SIGNAL_LN63_ERROR_W" 15938 "GD_ID_EMM_TERMINAL_TRANSFER_R_Status" 15938 "GD_ID_EMM_TERMINAL_TRANSFER_R" 15939 "GD_ID_EMM_ACM_TRANSFER_R_Status" 15939 "GD_ID_EMM_ACM_TRANSFER_R" 15970 "GD_ID_EMM_TERMINAL_ACKNOWLEDGE_W_Status" 15970 "GD_ID_EMM_TERMINAL_ACKNOWLEDGE_W" 16000 "GD_ID_EMM_REQUEST_ENVVAR_W" 16001 "GD_ID_EMM_ENV_VAR_VALUE1" 16002 "GD_ID_EMM_ENV_VAR_VALUE2" 16003 "GD_ID_EMM_ENV_VAR_VALUE3" 16004 "GD_ID_EMM_ENV_VAR_VALUE4" 16005 "GD_ID_EMM_ENV_VAR_VALUE5" 16006 "GD_ID_EMM_ENV_VAR_OPERATING_HOUR" 16007 "GD_ID_EMM_ENV_VAR_ERROR_COUNTER" 16008 "GD_ID_EMM_ENV_VAR_DATE1" 16009 "GD_ID_EMM_ENV_VAR_DATE2" 16010 "GD_ID_EMM_ENV_VAR_TIME1" 16011 "GD_ID_EMM_ENV_VAR_TIME2" 16012 "GD_ID_EMM_ENV_VAR_STATUS" 16127 "GD_ID_EMM_DEBUG_SET_RESET_ERROR" 16128 "GD_ID_EMM_STATUS_R" 16172 "GD_ID_EMM_ERR_LOG_DELETED_Status" 16172 "GD_ID_EMM_ERR_LOG_DELETED" 16222 "GD_ID_EMM_ERR_ACTIVE_Status" 16222 "GD_ID_EMM_ERR_ACTIVE" 16366 "GD_ID_EMM_ErrorManagement_Status" 16366 "GD_ID_EMM_ErrorManagement" 16383 "GD_ID_EMM_LifeMessage" 15854 "GD_ID_PICTO_ErrorManagement_Status" 15854 "GD_ID_PICTO_ErrorManagement" 15871 "GD_ID_PICTO_LifeMessage" 26113 "GD_ID_EFC_REQ_PWM_PCT" 26114 "GD_ID_EFC_TARGET_FAN_SPD" 26115 "GD_ID_EFC_COOLING_DEMAND" 26122 "GD_ID_EFC_USE_EC_Status" 26122 "GD_ID_EFC_USE_EC" 26123 "GD_ID_EFC_FACTOR_EC" 26124 "GD_ID_EFC_MAX_TEMP_EC" 26125 "GD_ID_EFC_MIN_TEMP_EC" 26126 "GD_ID_EFC_USE_EF_Status" 26126 "GD_ID_EFC_USE_EF" 26127 "GD_ID_EFC_FACTOR_EF" 26128 "GD_ID_EFC_MAX_TEMP_EF" 26129 "GD_ID_EFC_MIN_TEMP_EF" 26130 "GD_ID_EFC_USE_EM_Status" 26130 "GD_ID_EFC_USE_EM" 26131 "GD_ID_EFC_FACTOR_EM" 26132 "GD_ID_EFC_MAX_TEMP_EM" 26133 "GD_ID_EFC_MIN_TEMP_EM" 26134 "GD_ID_EFC_USE_HO_Status" 26134 "GD_ID_EFC_USE_HO" 26135 "GD_ID_EFC_FACTOR_HO" 26136 "GD_ID_EFC_MAX_TEMP_HO" 26137 "GD_ID_EFC_MIN_TEMP_HO" 26138 "GD_ID_EFC_USE_TO_Status" 26138 "GD_ID_EFC_USE_TO" 26139 "GD_ID_EFC_FACTOR_TO" 26140 "GD_ID_EFC_MAX_TEMP_TO" 26141 "GD_ID_EFC_MIN_TEMP_TO" 26142 "GD_ID_EFC_USE_AC_Status" 26142 "GD_ID_EFC_USE_AC" 26143 "GD_ID_EFC_FACTOR_AC" 26144 "GD_ID_EFC_PWM_OVERRIDE_Status" 26144 "GD_ID_EFC_PWM_OVERRIDE" 26145 "GD_ID_EFC_TARGET_SPD_OVERRIDE_Status" 26145 "GD_ID_EFC_TARGET_SPD_OVERRIDE" 26146 "GD_ID_EFC_TARGET_FAN_WING_ANGLE_Status" 26146 "GD_ID_EFC_TARGET_FAN_WING_ANGLE" 26147 "GD_ID_EFC_ACTUAL_FAN_WING_ANGLE" 26148 "GD_ID_EFC_TARGET_COOLANT_TEMP" 26149 "GD_ID_EFC_TARGET_MANIFOLD_TEMP" 26150 "GD_ID_EFC_COOLANT_I_GAIN" 26151 "GD_ID_EFC_COOLANT_P_A_GAIN" 26152 "GD_ID_EFC_COOLANT_P_B_GAIN" 26153 "GD_ID_EFC_COOLANT_P_C_GAIN" 26154 "GD_ID_EFC_MANIFOLD_I_GAIN" 26155 "GD_ID_EFC_MANIFOLD_P_A_GAIN" 26156 "GD_ID_EFC_MANIFOLD_P_B_GAIN" 26157 "GD_ID_EFC_MANIFOLD_P_C_GAIN" 26158 "GD_ID_EFC_INLET_VALVE_P_GAIN" 26159 "GD_ID_EFC_INLET_VALVE_I_TIME" 26160 "GD_ID_EFC_INLET_ACTIVATION_CYCLES" 26161 "GD_ID_EFC_INLET_GRADIENT_TRESHOLD" 26162 "GD_ID_EFC_INLET_MAX_ENERGIZE_TIME" 26163 "GD_ID_EFC_OUTLET_VALVE_P_GAIN" 26164 "GD_ID_EFC_OUTLET_VALVE_I_TIME" 26165 "GD_ID_EFC_OUTLET_ACTIVATION_CYCLES" 26166 "GD_ID_EFC_OUTLET_GRADIENT_TRESHOLD" 26167 "GD_ID_EFC_OUTLET_MAX_ENERGIZE_TIME" 26168 "GD_ID_EFC_STARTUP_STATE" 26169 "GD_ID_EFC_FAN_ANGLE_WINNER" 26170 "GD_ID_EFC_REVERSE_LOCK_REASONS" 26171 "GD_ID_EFC_ERROR_REASONS" 26172 "GD_ID_EFC_REVERSE_STATE_Status" 26172 "GD_ID_EFC_REVERSE_STATE" 26173 "GD_ID_EFC_REVERSIBLE_FAN_RPM" 26174 "GD_ID_EFC_INLET_PAUSE_TIME" 26175 "GD_ID_EFC_INLET_PAUSE_TIME_EXTENSION" 26176 "GD_ID_EFC_OUTLET_PAUSE_TIME" 26177 "GD_ID_EFC_OUTLET_PAUSE_TIME_EXTENSION" 26178 "GD_ID_EFC_START_MANUAL_REVERSING" 26179 "GD_ID_EFC_STOP_REVERSING" 26180 "GD_ID_EFC_ENABLE_AUTOMATIC_REVERSING" 26181 "GD_ID_EFC_BLOW_OUT_DURATION" 26182 "GD_ID_EFC_BLOW_OUT_PERIOD" 26183 "GD_ID_EFC_ANGLE_SENSOR_VOLTAGE" 26184 "GD_ID_EFC_BLOW_OUT_DURATION_MIN" 26185 "GD_ID_EFC_BLOW_OUT_DURATION_MAX" 26186 "GD_ID_EFC_BLOW_OUT_PERIOD_MIN" 26187 "GD_ID_EFC_BLOW_OUT_PERIOD_MAX" 26606 "GD_ID_EFC_ErrorManagement_Status" 26606 "GD_ID_EFC_ErrorManagement" 26623 "GD_ID_EFC_LifeMessage" 26624 "GD_ID_ECAD_LOGIC_STATE" 26625 "GD_ID_ECAD_VALVE_STATE" 26626 "GD_ID_ECAD_GOVENOR_VALVE_Status" 26626 "GD_ID_ECAD_GOVENOR_VALVE" 26627 "GD_ID_ECAD_REGEN_VALVE_Status" 26627 "GD_ID_ECAD_REGEN_VALVE" 26628 "GD_ID_ECAD_AIR_VOLUME" 26629 "GD_ID_ECAD_REGEN_VOLUME" 26630 "GD_ID_ECAD_REGEN_TARGET" 26631 "GD_ID_ECAD_COMPRESSOR_RPM" 26632 "GD_ID_ECAD_AIR_FLOW" 26633 "GD_ID_ECAD_REGEN_FLOW" 26634 "GD_ID_ECAD_REGEN_FLOW_SCALED" 26635 "GD_ID_ECAD_NET_FLOW" 26636 "GD_ID_ECAD_HEATER_Status" 26636 "GD_ID_ECAD_HEATER" 27118 "GD_ID_ECAD_ErrorManagement_Status" 27118 "GD_ID_ECAD_ErrorManagement" 27135 "GD_ID_ECAD_LifeMessage" 28161 "GD_ID_4WS_REQUESTED_MODE" 28162 "GD_ID_4WS_CURRENT_MODE" 28166 "GD_ID_4WS_JOG_LEFT_Status" 28166 "GD_ID_4WS_JOG_LEFT" 28167 "GD_ID_4WS_JOG_RIGHT_Status" 28167 "GD_ID_4WS_JOG_RIGHT" 28168 "GD_ID_4WS_JOG_CLEAR_Status" 28168 "GD_ID_4WS_JOG_CLEAR" 28169 "GD_ID_4WS_JOG_ANGLE_Status" 28169 "GD_ID_4WS_JOG_ANGLE" 28175 "GD_ID_4WS_UI_FRONT_ANGLE_Status" 28175 "GD_ID_4WS_UI_FRONT_ANGLE" 28176 "GD_ID_4WS_UI_REAR_ANGLE_Status" 28176 "GD_ID_4WS_UI_REAR_ANGLE" 28178 "GD_ID_4WS_MACHINE_REAR_ANGLE" 28179 "GD_ID_4WS_REAR_ANGLE_SETPOINT" 28180 "GD_ID_4WS_REAR_ANGLE_SENSOR_VALUE" 28183 "GD_ID_4WS_CURRENT_CONTROL_KP_Status" 28183 "GD_ID_4WS_CURRENT_CONTROL_KP" 28184 "GD_ID_4WS_CURRENT_CONTROL_KI_Status" 28184 "GD_ID_4WS_CURRENT_CONTROL_KI" 28185 "GD_ID_4WS_REAR_ANGLE_TARGET_Status" 28185 "GD_ID_4WS_REAR_ANGLE_TARGET" 28186 "GD_ID_4WS_LEFT_PWM_Status" 28186 "GD_ID_4WS_LEFT_PWM" 28187 "GD_ID_4WS_RIGHT_PWM_Status" 28187 "GD_ID_4WS_RIGHT_PWM" 28191 "GD_ID_4WS_RIGHT_VALVE_COIL_CURRENT" 28192 "GD_ID_4WS_LEFT_VALVE_COIL_CURRENT" 28193 "GD_ID_4WS_ANGLE_CONTROL_KP_Status" 28193 "GD_ID_4WS_ANGLE_CONTROL_KP" 28194 "GD_ID_4WS_ANGLE_CONTROL_KI_Status" 28194 "GD_ID_4WS_ANGLE_CONTROL_KI" 28195 "GD_ID_4WS_TARGET_CURRENT_Status" 28195 "GD_ID_4WS_TARGET_CURRENT" 28196 "GD_ID_4WS_CURRENT_CONTROL_KC_Status" 28196 "GD_ID_4WS_CURRENT_CONTROL_KC" 28201 "GD_ID_4WS_COMMAND_CURRENT_Status" 28201 "GD_ID_4WS_COMMAND_CURRENT" 28202 "GD_ID_4WS_ACTIVE_CURRENT_LOOP" 28203 "GD_ID_4WS_UNFILTERED_REAR_ANGLE_Status" 28203 "GD_ID_4WS_UNFILTERED_REAR_ANGLE" 28210 "GD_ID_4WS_START_CURRENT_CALIB_COMMAND" 28211 "GD_ID_4WS_START_CURRENT_CALIB_STATUS" 28260 "GD_ID_4WS_REAR_ANGLE_CALIB_COMMAND" 28261 "GD_ID_4WS_REAR_ANGLE_CALIB_STATUS" 28654 "GD_ID_4WS_ErrorManagement_Status" 28654 "GD_ID_4WS_ErrorManagement" 28671 "GD_ID_4WS_LifeMessage" 1024 "GD_ID_NT01_Date_Year" 1025 "GD_ID_NT01_Date_Month" 1026 "GD_ID_NT01_Date_Day" 1027 "GD_ID_NT01_Date_WeekDay" 1028 "GD_ID_NT01_Time_Hours" 1029 "GD_ID_NT01_Time_Minutes" 1030 "GD_ID_NT01_Time_Seconds" 1045 "GD_ID_NT01_MainBoardTemp" 1056 "GD_ID_NT01_LightSensor_Status" 1056 "GD_ID_NT01_LightSensor" 1281 "GD_ID_NT01_Software_Version" 1282 "GD_ID_NT01_Software_Revision" 1283 "GD_ID_NT01_Build_Date_Day_Month" 1284 "GD_ID_NT01_Build_Date_Year" 1285 "GD_ID_NT01_Build_Time_Hrs_Min" 1286 "GD_ID_NT01_Build_Time_Seconds" 1036 "GD_ID_Time_Seconds" 1037 "GD_ID_Time_Hours_Minutes" 1038 "GD_ID_Date_Month_Day" 1039 "GD_ID_Date_Year" 1518 "GD_ID_NT01_ErrorManagement_Status" 1518 "GD_ID_NT01_ErrorManagement" 1535 "GD_ID_NT01_LifeMessage" 1536 "GD_ID_MFA_A19_Status" 1536 "GD_ID_MFA_A19" 1544 "GD_ID_MFA_A11_Status" 1544 "GD_ID_MFA_A11" 1545 "GD_ID_MFA_A11_LED" 1546 "GD_ID_MFA_A12_Status" 1546 "GD_ID_MFA_A12" 1547 "GD_ID_MFA_A12_LED" 1548 "GD_ID_MFA_A13_Status" 1548 "GD_ID_MFA_A13" 1549 "GD_ID_MFA_A13_LED" 1550 "GD_ID_MFA_A14_Status" 1550 "GD_ID_MFA_A14" 1551 "GD_ID_MFA_A14_LED" 1562 "GD_ID_MFA_A1_Status" 1562 "GD_ID_MFA_A1" 1563 "GD_ID_MFA_A2_Status" 1563 "GD_ID_MFA_A2" 1568 "GD_ID_MFA_A10_Status" 1568 "GD_ID_MFA_A10" 1569 "GD_ID_MFA_A8_Status" 1569 "GD_ID_MFA_A8" 1570 "GD_ID_MFA_A7_Status" 1570 "GD_ID_MFA_A7" 1571 "GD_ID_MFA_A24_Status" 1571 "GD_ID_MFA_A24" 1572 "GD_ID_MFA_A9_Status" 1572 "GD_ID_MFA_A9" 1573 "GD_ID_MFA_A26_Status" 1573 "GD_ID_MFA_A26" 1574 "GD_ID_MFA_A17_Status" 1574 "GD_ID_MFA_A17" 1575 "GD_ID_MFA_A18_Status" 1575 "GD_ID_MFA_A18" 1576 "GD_ID_MFA_A15_Status" 1576 "GD_ID_MFA_A15" 1577 "GD_ID_MFA_A16_Status" 1577 "GD_ID_MFA_A16" 1578 "GD_ID_MFA_A3_Status" 1578 "GD_ID_MFA_A3" 1579 "GD_ID_MFA_A20_Status" 1579 "GD_ID_MFA_A20" 1580 "GD_ID_MFA_A5_Status" 1580 "GD_ID_MFA_A5" 1581 "GD_ID_MFA_A22_Status" 1581 "GD_ID_MFA_A22" 1582 "GD_ID_MFA_A4_Status" 1582 "GD_ID_MFA_A4" 1583 "GD_ID_MFA_A6_Status" 1583 "GD_ID_MFA_A6" 1584 "GD_ID_MFA_E1_Status" 1584 "GD_ID_MFA_E1" 1585 "GD_ID_MFA_E2_Status" 1585 "GD_ID_MFA_E2" 1586 "GD_ID_MFA_E3_Status" 1586 "GD_ID_MFA_E3" 1587 "GD_ID_MFA_E4_Status" 1587 "GD_ID_MFA_E4" 1590 "GD_ID_MFA_ZONE_D_ROCKER_1" 1591 "GD_ID_MFA_ZONE_D_LED_ROCKER_1" 1592 "GD_ID_MFA_ZONE_D_ROCKER_2" 1593 "GD_ID_MFA_ZONE_D_LED_ROCKER_2" 1594 "GD_ID_MFA_ZONE_D_ROCKER_3" 1595 "GD_ID_MFA_ZONE_D_LED_ROCKER_3" 1596 "GD_ID_MFA_ZONE_D_ROCKER_4" 1597 "GD_ID_MFA_ZONE_D_LED_ROCKER_4" 1598 "GD_ID_MFA_ZONE_D_ROCKER_5" 1599 "GD_ID_MFA_ZONE_D_LED_ROCKER_5" 1600 "GD_ID_MFA_B1_Status" 1600 "GD_ID_MFA_B1" 1601 "GD_ID_MFA_F1_Status" 1601 "GD_ID_MFA_F1" 1632 "GD_ID_MFA_C17_Status" 1632 "GD_ID_MFA_C17" 1633 "GD_ID_MFA_C17_LED" 1634 "GD_ID_MFA_C18_Status" 1634 "GD_ID_MFA_C18" 1635 "GD_ID_MFA_C18_LED" 1636 "GD_ID_MFA_C9_Status" 1636 "GD_ID_MFA_C9" 1637 "GD_ID_MFA_C9_LED" 1638 "GD_ID_MFA_C10_Status" 1638 "GD_ID_MFA_C10" 1639 "GD_ID_MFA_C10_LED" 1640 "GD_ID_MFA_C1_Status" 1640 "GD_ID_MFA_C1" 1641 "GD_ID_MFA_C1_LED" 1642 "GD_ID_MFA_C2_Status" 1642 "GD_ID_MFA_C2" 1643 "GD_ID_MFA_C2_LED" 1644 "GD_ID_MFA_ZONE_D_BUTTON_LEFT_INSIDE_Status" 1644 "GD_ID_MFA_ZONE_D_BUTTON_LEFT_INSIDE" 1645 "GD_ID_MFA_ZONE_D_LED_LEFT_INSIDE" 1646 "GD_ID_MFA_ZONE_D_BUTTON_LEFT_OUTSIDE_Status" 1646 "GD_ID_MFA_ZONE_D_BUTTON_LEFT_OUTSIDE" 1647 "GD_ID_MFA_ZONE_D_LED_LEFT_OUTSIDE" 1648 "GD_ID_MFA_C19_Status" 1648 "GD_ID_MFA_C19" 1649 "GD_ID_MFA_C19_LED" 1650 "GD_ID_MFA_C20_Status" 1650 "GD_ID_MFA_C20" 1651 "GD_ID_MFA_C20_LED" 1652 "GD_ID_MFA_C11_Status" 1652 "GD_ID_MFA_C11" 1653 "GD_ID_MFA_C11_LED" 1654 "GD_ID_MFA_C12_Status" 1654 "GD_ID_MFA_C12" 1655 "GD_ID_MFA_C12_LED" 1656 "GD_ID_MFA_C3_Status" 1656 "GD_ID_MFA_C3" 1657 "GD_ID_MFA_C3_LED" 1658 "GD_ID_MFA_C4_Status" 1658 "GD_ID_MFA_C4" 1659 "GD_ID_MFA_C4_LED" 1660 "GD_ID_MFA_ZONE_D_BUTTON_RIGHT_INSIDE_Status" 1660 "GD_ID_MFA_ZONE_D_BUTTON_RIGHT_INSIDE" 1661 "GD_ID_MFA_ZONE_D_LED_RIGHT_INSIDE" 1662 "GD_ID_MFA_ZONE_D_BUTTON_RIGHT_OUTSIDE_Status" 1662 "GD_ID_MFA_ZONE_D_BUTTON_RIGHT_OUTSIDE" 1663 "GD_ID_MFA_ZONE_D_LED_RIGHT_OUTSIDE" 1664 "GD_ID_MFA_C21_Status" 1664 "GD_ID_MFA_C21" 1665 "GD_ID_MFA_C21_LED" 1666 "GD_ID_MFA_C22_Status" 1666 "GD_ID_MFA_C22" 1667 "GD_ID_MFA_C22_LED" 1668 "GD_ID_MFA_C13_Status" 1668 "GD_ID_MFA_C13" 1669 "GD_ID_MFA_C13_LED" 1670 "GD_ID_MFA_C14_Status" 1670 "GD_ID_MFA_C14" 1671 "GD_ID_MFA_C14_LED" 1672 "GD_ID_MFA_C5_Status" 1672 "GD_ID_MFA_C5" 1673 "GD_ID_MFA_C5_LED" 1674 "GD_ID_MFA_C6_Status" 1674 "GD_ID_MFA_C6" 1675 "GD_ID_MFA_C6_LED" 1680 "GD_ID_MFA_C23_Status" 1680 "GD_ID_MFA_C23" 1681 "GD_ID_MFA_C23_LED" 1682 "GD_ID_MFA_C24_Status" 1682 "GD_ID_MFA_C24" 1683 "GD_ID_MFA_C24_LED" 1684 "GD_ID_MFA_C15_Status" 1684 "GD_ID_MFA_C15" 1685 "GD_ID_MFA_C15_LED" 1686 "GD_ID_MFA_C16_Status" 1686 "GD_ID_MFA_C16" 1687 "GD_ID_MFA_C16_LED" 1688 "GD_ID_MFA_C7_Status" 1688 "GD_ID_MFA_C7" 1689 "GD_ID_MFA_C7_LED" 1690 "GD_ID_MFA_C8_Status" 1690 "GD_ID_MFA_C8" 1691 "GD_ID_MFA_C8_LED" 1696 "GD_ID_MFA_FunctionLighting" 1697 "GD_ID_MFA_NightDesign" 1736 "GD_ID_MFA_Throttle_CalibCmd" 1737 "GD_ID_MFA_Throttle_CalibState" 1738 "GD_ID_MFA_UNKNOWN_Calibration_Cmd" 1739 "GD_ID_MFA_UNKNOWN_Calibration_Status" 1740 "GD_ID_LM1_CalibrationCommand" 1741 "GD_ID_LM1_CalibrationStatus" 1742 "GD_ID_MFA_Lever_CalibCmd" 1743 "GD_ID_MFA_Lever_CalibState" 1744 "GD_ID_LM3_CalibrationCommand" 1745 "GD_ID_LM3_CalibrationStatus" 1746 "GD_ID_LM4_CalibrationCommand" 1747 "GD_ID_LM4_CalibrationStatus" 2030 "GD_ID_MFA_ErrorManagement_Status" 2030 "GD_ID_MFA_ErrorManagement" 2032 "GD_ID_HwConfigMFA" 2033 "GD_ID_IdentificationModule" 2036 "GD_ID_MFA_SoftwareVersion" 2037 "GD_ID_SwVersionAJS" 2040 "GD_ID_SerialNumber1st" 2041 "GD_ID_SerialNumber2nd" 2047 "GD_ID_MFA_LifeMessage" 6638 "GD_ID_DIAGNOSE_ErrorManagement_Status" 6638 "GD_ID_DIAGNOSE_ErrorManagement" 6655 "GD_ID_DIAGNOSE_LifeMessage" 6750 "GD_ID_TELEMETRY_GSM_GPRS_ECN0_R" 6751 "GD_ID_TELEMETRY_GSM_GPRS_BER_R" 6752 "GD_ID_TELEMETRY_GSM_GPRS_LAC_R" 6753 "GD_ID_TELEMETRY_GSM_GPRS_CELLID_HIGH_R" 6754 "GD_ID_TELEMETRY_GSM_GPRS_CELLID_LOW_R" 6755 "GD_ID_TELEMETRY_GSM_GPRS_QUALITY_RSCP_R" 6756 "GD_ID_TELEMETRY_OWN_BT_CHANNEL_R" 6757 "GD_ID_TELEMETRY_GSM_GPRS_SIGNAL_QUALITY_R" 6758 "GD_ID_TELEMETRY_VARIODOC_STATE_R" 6759 "GD_ID_TELEMETRY_VARIODOC_CONFIG_IS_VALID_RW" 6760 "GD_ID_TELEMETRY_VARIODOC_SERVER_PORT_RW" 6761 "GD_ID_TELEMETRY_LAPTOP_BT_CHANNEL_RW" 6762 "GD_ID_TELEMETRY_RADIO_TYPE_RW" 6763 "GD_ID_TELEMETRY_GSM_GPRS_MCC_R" 6764 "GD_ID_TELEMETRY_GSM_GPRS_MNC_R" 6765 "GD_ID_TELEMETRY_GSM_GPRS_ALLOWED_ROAMING_RW_Status" 6765 "GD_ID_TELEMETRY_GSM_GPRS_ALLOWED_ROAMING_RW" 6766 "GD_ID_TELEMETRY_GSM_GPRS_MODE_R" 6767 "GD_ID_TELEMETRY_GSM_STATUS_R" 6768 "GD_ID_TELEMETRY_GSM_CONFIG_IS_VALID_R" 6769 "GD_ID_TELEMETRY_GSM_GPRS_REDIAL_R" 6770 "GD_ID_TELEMETRY_GSM_GPRS_INTERN_EXTERN_ANTENNA_R" 6771 "GD_ID_TELEMETRY_GSM_GPRS_ROAMING_STATUS_R" 6772 "GD_ID_TELEMETRY_USED_NETWORK_PROVIDER_BLKR" 6773 "GD_ID_TELEMETRY_PACKETDATATYPE_R" 6774 "GD_ID_TELEMETRY_SIGNALQUALITY_R" 6775 "GD_ID_TELEMETRY_GPRS_STATE_R" 6776 "GD_ID_TELEMETRY_GPRS_CONFIG_IS_VALID_RW" 6777 "GD_ID_TELEMETRY_CELLULAR_MODEM_TYPE_R" 6778 "GD_ID_TELEMETRY_CDMA2000_IMEI_BLKR" 6779 "GD_ID_TELEMETRY_CDMA2000_ESN_BLKR" 6780 "GD_ID_TELEMETRY_CDMA2000_MSL_BLKRW" 6781 "GD_ID_TELEMETRY_CDMA2000_MDN_BLKRW" 6782 "GD_ID_TELEMETRY_CDMA2000_MSID_BLKRW" 6786 "GD_ID_TELEMETRY_STATUS_PIN_PUK_R" 6787 "GD_ID_TELEMETRY_STATUS_DIAL_INTERNET_R" 6806 "GD_ID_TELEMETRY_DATA_RATE_DOWN_R" 6807 "GD_ID_TELEMETRY_DATA_RATE_UP_R" 6808 "GD_ID_TELEMETRY_DEBUG_RW" 6816 "GD_ID_TELEMETRY_EMAIL_COMMAND_R" 6817 "GD_ID_TELEMETRY_EMAIL_STATUS_R" 6856 "GD_ID_TELEMETRY_OWN_BT_ADDRESS_BLKR" 6857 "GD_ID_TELEMETRY_GSM_GPRS_PIN_BLKRW" 6858 "GD_ID_TELEMETRY_GSM_GPRS_PUK_BLKW" 6859 "GD_ID_TELEMETRY_GPRS_PROVIDER_BLKRW" 6860 "GD_ID_TELEMETRY_GPRS_DIAL_BLKRW" 6861 "GD_ID_TELEMETRY_GPRS_USER_BLKRW" 6862 "GD_ID_TELEMETRY_GPRS_PASSWORD_BLKRW" 6863 "GD_ID_TELEMETRY_VARIODOC_SERVER_URL_BLKRW" 6864 "GD_ID_TELEMETRY_LAPTOP_BT_ADDRESS_BLKRW" 6867 "GD_ID_TELEMETRY_GSM_DIAL_BLKRW" 6880 "GD_ID_TELEMETRY_EMAIL_ADDRESS_BLKRW" 6881 "GD_ID_TELEMETRY_EMAIL_TEXT_BLKRW" 6882 "GD_ID_TELEMETRY_VIN_INTERNAL_BLKRW" 7150 "GD_ID_TELEMETRY_ERROR_ACKNOWLEDGE_W_Status" 7150 "GD_ID_TELEMETRY_ERROR_ACKNOWLEDGE_W" 7167 "GD_ID_TELEMETRY_LifeMessage" 16384 "GD_ID_CEAG_FIELD_HEADLAND_WIDTH_RW" 16385 "GD_ID_CEAG_FIELD_HEADLAND_DISTANCE_RW" 16400 "GD_ID_CEAG_IMPLEMENT_PATHTOPATHDISTANCE_RW" 16402 "GD_ID_CEAG_IMPLEMENT_LINKAGETYPE_RW" 16403 "GD_ID_CEAG_IMPLEMENT_LINKAGEFRONT_RW" 16404 "GD_ID_CEAG_IMPLEMENT_LINKAGEREAR_RW" 16405 "GD_ID_CEAG_IMPLEMENT_MINIMUMRADIUS_RW" 16406 "GD_ID_CEAG_IMPLEMENT_OFFSET_SETOFFSET_RW" 16407 "GD_ID_CEAG_IMPLEMENT_OFFSET_SETWORKINGWIDTH_RW" 16408 "GD_ID_CEAG_IMPLEMENT_OFFSET_STATUS_RW" 16416 "GD_ID_CEAG_COMMUNICATION_COMMAND_W" 16417 "GD_ID_CEAG_COMMUNICATION_COMMAND_STATUS_R" 16432 "GD_ID_CEAG_PATH_DATA_BLKRW" 16435 "GD_ID_CEAG_PATH_AB_ANGLE_RW" 16436 "GD_ID_CEAG_PATH_AB_DISTANCE_R" 16439 "GD_ID_CEAG_PATH_PIVOT_CENTERPOINT_ACCURACY_R" 16441 "GD_ID_CEAG_PATH_SEGMENT_ACTUAL_R" 16442 "GD_ID_CEAG_PATH_NUMBER_ACTUAL_R" 16443 "GD_ID_CEAG_PATH_LP_SLOPE_RW_Status" 16443 "GD_ID_CEAG_PATH_LP_SLOPE_RW" 16444 "GD_ID_CEAG_PATH_DATA_ACKNOWLEDGE_R_Status" 16444 "GD_ID_CEAG_PATH_DATA_ACKNOWLEDGE_R" 16448 "GD_ID_CEAG_NUDGEOFFSET_MANUAL_RW" 16449 "GD_ID_CEAG_NUDGEOFFSET_TOTAL_R_Status" 16449 "GD_ID_CEAG_NUDGEOFFSET_TOTAL_R" 16450 "GD_ID_CEAG_OFFSET_NORTH" 16451 "GD_ID_CEAG_OFFSET_EAST" 16464 "GD_ID_CEAG_AUTOTURN_SETTINGS_RW" 16465 "GD_ID_CEAG_AUTOTURN_DIMENSIONS_R" 16466 "GD_ID_CEAG_AUTOTURN_STATUS_R" 16471 "GD_ID_CEAG_STATUSPAGE_POSITION_GNSS_R_Status" 16471 "GD_ID_CEAG_STATUSPAGE_POSITION_GNSS_R" 16472 "GD_ID_CEAG_STATUSPAGE_CORRECTION_R_Status" 16472 "GD_ID_CEAG_STATUSPAGE_CORRECTION_R" 16473 "GD_ID_CEAG_STATUSPAGE_INERTIAL_R_Status" 16473 "GD_ID_CEAG_STATUSPAGE_INERTIAL_R" 16474 "GD_ID_CEAG_STATUSPAGE_STEERING_SUBSYSTEM_R_Status" 16474 "GD_ID_CEAG_STATUSPAGE_STEERING_SUBSYSTEM_R" 16475 "GD_ID_CEAG_STATUSPAGE_XTRK_R_Status" 16475 "GD_ID_CEAG_STATUSPAGE_XTRK_R" 16476 "GD_ID_CEAG_STATUSPAGE_HEADINGTOWAYLINE_R_Status" 16476 "GD_ID_CEAG_STATUSPAGE_HEADINGTOWAYLINE_R" 16477 "GD_ID_CEAG_STATUSPAGE_VELOCITY_R_Status" 16477 "GD_ID_CEAG_STATUSPAGE_VELOCITY_R" 16478 "GD_ID_CEAG_STATUSPAGE_CALIBRATION_R_Status" 16478 "GD_ID_CEAG_STATUSPAGE_CALIBRATION_R" 16479 "GD_ID_CEAG_STATUSPAGE_SYSTEM_R_Status" 16479 "GD_ID_CEAG_STATUSPAGE_SYSTEM_R" 16480 "GD_ID_CEAG_STATUS_XTRK_R_Status" 16480 "GD_ID_CEAG_STATUS_XTRK_R" 16481 "GD_ID_CEAG_STATUS_HEADING_R" 16482 "GD_ID_CEAG_STATUS_STEERING_R" 16483 "GD_ID_CEAG_STEERING_SENSITIVITY_LINEACQUISITION_RW" 16484 "GD_ID_CEAG_STEERING_SENSITIVITY_ONLINE_RW" 16485 "GD_ID_CEAG_SYSTEM_STANDBYTIME_RW" 16486 "GD_ID_CEAG_SYSTEM_POWERSUPPLY_INPUT_R" 16487 "GD_ID_CEAG_SYSTEM_POWERSUPPLY_OUTPUT_R" 16488 "GD_ID_CEAG_SYSTEM_ALTITUDE_GEOIDAL_SEPARATION_R" 16489 "GD_ID_CEAG_STEERING_DISENGAGE_REASON_R" 16496 "GD_ID_CEAG_GNSS_GPS_SATVISIBLE_R" 16497 "GD_ID_CEAG_GNSS_GPS_SATUSED_R" 16498 "GD_ID_CEAG_GNSS_GLONASS_SATVISIBLE_R" 16499 "GD_ID_CEAG_GNSS_GLONASS_SATUSED_R" 16500 "GD_ID_CEAG_GNSS_GALILEO_SATVISIBLE_R" 16501 "GD_ID_CEAG_GNSS_GALILEO_SATUSED_R" 16503 "GD_ID_CEAG_GNSS_VALIDPOSITION_R_Status" 16503 "GD_ID_CEAG_GNSS_VALIDPOSITION_R" 16504 "GD_ID_CEAG_GNSS_POSITION_ACTUAL_BLKR" 16505 "GD_ID_CEAG_GNSS_DOP_R" 16506 "GD_ID_CEAG_GNSS_TIME_HOURMINUTE_R" 16507 "GD_ID_CEAG_GNSS_TIME_SECOND_R" 16508 "GD_ID_CEAG_GNSS_ANTENNA_INSTALLATION_RW_Status" 16508 "GD_ID_CEAG_GNSS_ANTENNA_INSTALLATION_RW" 16509 "GD_ID_CEAG_GNSS_VELOCITY_R" 16510 "GD_ID_CEAG_GNSS_DISTANCE_R" 16519 "GD_ID_CEAG_CORRECTIONSIGNAL_RTKNETWORK_ROAMING_RW_Status" 16519 "GD_ID_CEAG_CORRECTIONSIGNAL_RTKNETWORK_ROAMING_RW" 16520 "GD_ID_CEAG_CORRECTIONSIGNAL_RTK_DUHF2_CHANNELSPACING_RW" 16521 "GD_ID_CEAG_CORRECTIONSIGNAL_RTK_DUHF2_PROTOCOL_RW" 16522 "GD_ID_CEAG_CORRECTIONSIGNAL_RTK_DUHF2_ERRORCORRECTION_RW" 16523 "GD_ID_CEAG_CORRECTIONSIGNAL_RTK_FH915_CHANNEL_RW" 16524 "GD_ID_CEAG_CORRECTIONSIGNAL_RTK_FH915_LOCATION_RW" 16525 "GD_ID_CEAG_CORRECTIONSIGNAL_RTK_FH915_NETWORKID_RW" 16526 "GD_ID_CEAG_CORRECTIONSIGNAL_OMNISTAR_FREQUENCY_HIGH_RW" 16527 "GD_ID_CEAG_CORRECTIONSIGNAL_OMNISTAR_FREQUENCY_LOW_RW" 16528 "GD_ID_CEAG_CORRECTIONSIGNAL_TYPE_SELECTED_RW" 16529 "GD_ID_CEAG_CORRECTIONSIGNAL_OMNISTAR_BAUDRATE_RW" 16530 "GD_ID_CEAG_CORRECTIONSIGNAL_VBS_EXPIRYDATE_DAYMONTH_R" 16531 "GD_ID_CEAG_CORRECTIONSIGNAL_BARGRAPH_R" 16532 "GD_ID_CEAG_CORRECTIONSIGNAL_VBS_EXPIRYDATE_YEAR_R" 16533 "GD_ID_CEAG_CORRECTIONSIGNAL_HP_XP_EXPIRYDATE_DAYMONTH_R" 16535 "GD_ID_CEAG_CORRECTIONSIGNAL_HP_XP_EXPIRYDATE_YEAR_R" 16536 "GD_ID_CEAG_CORRECTIONSIGNAL_STATUS_R_Status" 16536 "GD_ID_CEAG_CORRECTIONSIGNAL_STATUS_R" 16537 "GD_ID_CEAG_CORRECTIONSIGNAL_OMNISTAR_SERIALNUMBER_HIGH_R" 16538 "GD_ID_CEAG_CORRECTIONSIGNAL_OMNISTAR_SERIALNUMBER_LOW_R" 16539 "GD_ID_CEAG_CORRECTIONSIGNAL_RTK_AGCO_CHANNEL_RW" 16540 "GD_ID_CEAG_CORRECTIONSIGNAL_RTK_AGCO_FREQUENCY_HIGH_R" 16541 "GD_ID_CEAG_CORRECTIONSIGNAL_RTK_AGCO_FREQUENCY_LOW_R" 16542 "GD_ID_CEAG_CORRECTIONSIGNAL_RTK_AGCO_RADIOTYPE_R" 16543 "GD_ID_CEAG_CORRECTIONSIGNAL_RTK_EXTERNAL_SERIALINTERFACE_RW" 16544 "GD_ID_CEAG_CORRECTIONSIGNAL_RTK_RADIOINSTALLATION_RW_Status" 16544 "GD_ID_CEAG_CORRECTIONSIGNAL_RTK_RADIOINSTALLATION_RW" 16545 "GD_ID_CEAG_CORRECTIONSIGNAL_RTK_AGCO_CORRECTIONFORMAT_RW" 16546 "GD_ID_CEAG_CORRECTIONSIGNAL_RTK_EXTERNAL_CORRECTIONFORMAT_RW" 16547 "GD_ID_CEAG_CORRECTIONSIGNAL_RTK_GPS_SATVISIBLE_R" 16548 "GD_ID_CEAG_CORRECTIONSIGNAL_RTK_GPS_SATUSED_R" 16549 "GD_ID_CEAG_CORRECTIONSIGNAL_RTK_GLONASS_SATVISIBLE_R" 16550 "GD_ID_CEAG_CORRECTIONSIGNAL_RTK_GLONASS_SATUSED_R" 16551 "GD_ID_CEAG_CORRECTIONSIGNAL_RTK_GALILEO_SATVISIBLE_R" 16552 "GD_ID_CEAG_CORRECTIONSIGNAL_RTK_GALILEO_SATUSED_R" 16553 "GD_ID_CEAG_CORRECTIONSIGNAL_RTK_RADIO_CONFIGURABLE_R" 16554 "GD_ID_CEAG_CORRECTIONSIGNAL_RTK_BASELINE_R" 16555 "GD_ID_CEAG_CORRECTIONSIGNAL_SIGNALLAG_R" 16556 "GD_ID_CEAG_CORRECTIONSIGNAL_FALLBACK_RW_Status" 16556 "GD_ID_CEAG_CORRECTIONSIGNAL_FALLBACK_RW" 16557 "GD_ID_CEAG_CORRECTIONSIGNAL_ACCURACY_GNSSANTENNA_R" 16558 "GD_ID_CEAG_CORRECTIONSIGNAL_ACCURACY_VEHICLEREFERENCEPOINT_R" 16559 "GD_ID_CEAG_CORRECTIONSIGNAL_AUTHORISATIONLEVEL_R" 16560 "GD_ID_CEAG_CORRECTIONSIGNAL_RTKNETWORK_GSM_NUMBER_BLKRW" 16561 "GD_ID_CEAG_CORRECTIONSIGNAL_RTKNETWORK_GSM_PIN_BLKRW" 16562 "GD_ID_CEAG_CORRECTIONSIGNAL_RTKNETWORK_CORRECTIONFORMAT_RW_Status" 16562 "GD_ID_CEAG_CORRECTIONSIGNAL_RTKNETWORK_CORRECTIONFORMAT_RW" 16563 "GD_ID_CEAG_CORRECTIONSIGNAL_RTKNETWORK_GPRS_ACCESSPOINT_BLKRW" 16564 "GD_ID_CEAG_CORRECTIONSIGNAL_RTKNETWORK_GPRS_IPADDRESS_BLKRW" 16565 "GD_ID_CEAG_CORRECTIONSIGNAL_RTKNETWORK_GPRS_PORT_BLKRW" 16566 "GD_ID_CEAG_CORRECTIONSIGNAL_RTKNETWORK_GPRS_MOUNTPOINT_BLKRW" 16567 "GD_ID_CEAG_CORRECTIONSIGNAL_RTKNETWORK_GPRS_USERNAME_CONNECTIONPOVIDER_BLKRW" 16568 "GD_ID_CEAG_CORRECTIONSIGNAL_RTKNETWORK_GPRS_PASSWORD_CONNECTIONPROVIDER_BLKRW" 16569 "GD_ID_CEAG_CORRECTIONSIGNAL_RTKNETWORK_NMEA_DATA_RW" 16570 "GD_ID_CEAG_CORRECTIONSIGNAL_TYPE_ACTUAL_R" 16571 "GD_ID_CEAG_CORRECTIONSIGNAL_RTKNETWORK_GPRS_USERNAME_SIGNALPROVIDER_BLKRW" 16572 "GD_ID_CEAG_CORRECTIONSIGNAL_RTKNETWORK_GPRS_PASSWORD_SIGNALPROVIDER_BLKRW" 16573 "GD_ID_CEAG_CORRECTIONSIGNAL_RTKNETWORK_GSM_GPRS_CONNECTION_RW_Status" 16573 "GD_ID_CEAG_CORRECTIONSIGNAL_RTKNETWORK_GSM_GPRS_CONNECTION_RW" 16574 "GD_ID_CEAG_CORRECTIONSIGNAL_RTKNETWORK_GPRS_PIN_BLKRW" 16575 "GD_ID_CEAG_CORRECTIONSIGNAL_RTKNETWORK_MODE_RW_Status" 16575 "GD_ID_CEAG_CORRECTIONSIGNAL_RTKNETWORK_MODE_RW" 16576 "GD_ID_CEAG_NMEA_SERIALINTERFACE_RW" 16579 "GD_ID_CEAG_NMEA_DATA_1_RW" 16580 "GD_ID_CEAG_NMEA_DATA_2_RW" 16581 "GD_ID_CEAG_NMEA_DATA_3_RW" 16582 "GD_ID_CEAG_NMEA_DATA_4_RW" 16583 "GD_ID_CEAG_NMEA_DATA_5_RW" 16584 "GD_ID_CEAG_NMEA_OUTPUT_RW" 16606 "GD_ID_CEAG_SENSOR_IMU_ROLL_R_Status" 16606 "GD_ID_CEAG_SENSOR_IMU_ROLL_R" 16607 "GD_ID_CEAG_SENSOR_IMU_PITCH_R_Status" 16607 "GD_ID_CEAG_SENSOR_IMU_PITCH_R" 16608 "GD_ID_CEAG_SENSOR_IMU_YAW_R_Status" 16608 "GD_ID_CEAG_SENSOR_IMU_YAW_R" 16609 "GD_ID_CEAG_SENSOR_IMU_MOUNTINGBIAS_R_Status" 16609 "GD_ID_CEAG_SENSOR_IMU_MOUNTINGBIAS_R" 16610 "GD_ID_CEAG_SENSOR_IMU_DHEADING_R" 16611 "GD_ID_CEAG_SENSOR_IMU_WARMING_TIME_R_Status" 16611 "GD_ID_CEAG_SENSOR_IMU_WARMING_TIME_R" 16612 "GD_ID_CEAG_SENSOR_IMU_CALIBRATION_TIME_R_Status" 16612 "GD_ID_CEAG_SENSOR_IMU_CALIBRATION_TIME_R" 16613 "GD_ID_CEAG_ID_FA_KALIB_IMU_SET_R" 16614 "GD_ID_CEAG_ID_FA_KALIB_IMU_GET_W" 16639 "GD_ID_CEAG_ID_GNSS_ANTENNA_TYPE_R" 16640 "GD_ID_CEAG_ID_GNSS_ANTENNA_MODEL_BLKR" 16641 "GD_ID_CEAG_ID_GNSS_ANTENNA_PSN_BLKR" 16642 "GD_ID_CEAG_ID_GNSS_ANTENNA_HWVERSION_BLKR" 16643 "GD_ID_CEAG_ID_GNSS_ANTENNA_SWVERSION_BLKR" 16644 "GD_ID_CEAG_ID_GNSS_ANTENNA_BOOTVERSION_BLKR" 16645 "GD_ID_CEAG_ID_GNSS_ANTENNA_COMPILE_DATE_BLKR" 16646 "GD_ID_CEAG_ID_GNSS_ANTENNA_AUTHCODE_BLKW" 16650 "GD_ID_CEAG_ID_CORRECTIONSIGNAL_NTRIP_DELAY_R" 16878 "GD_ID_CEAG_ErrorManagement_Status" 16878 "GD_ID_CEAG_ErrorManagement" 16895 "GD_ID_CEAG_LifeMessage" 7680 "GD_ID_ZEL_STATUS_Status" 7680 "GD_ID_ZEL_STATUS" 7681 "GD_ID_ZEL_SIM_DRZ_Status" 7681 "GD_ID_ZEL_SIM_DRZ" 7682 "GD_ID_ZEL_SIM_LENKWINKEL_Status" 7682 "GD_ID_ZEL_SIM_LENKWINKEL" 7683 "GD_ID_ZEL_SIM_HUBWERK_Status" 7683 "GD_ID_ZEL_SIM_HUBWERK" 7684 "GD_ID_ZEL_SIM_BREMSLICHT_Status" 7684 "GD_ID_ZEL_SIM_BREMSLICHT" 7685 "GD_ID_ZEL_SIM_ZENTRALSCHMIERUNG_Status" 7685 "GD_ID_ZEL_SIM_ZENTRALSCHMIERUNG" 7686 "GD_ID_ZEL_SIM_FAHRGECHWINDIGKEIT_Status" 7686 "GD_ID_ZEL_SIM_FAHRGECHWINDIGKEIT" 7687 "GD_ID_ZEL_HELLIGKEIT_SCM_Status" 7687 "GD_ID_ZEL_HELLIGKEIT_SCM" 7688 "GD_ID_ZEL_ANHAENGERBREMSE_TASTER_Status" 7688 "GD_ID_ZEL_ANHAENGERBREMSE_TASTER" 7689 "GD_ID_ZEL_ZUST_TAST_LENKTURM_Status" 7689 "GD_ID_ZEL_ZUST_TAST_LENKTURM" 7690 "GD_ID_ZEL_ZUST_KLEMME50_Status" 7690 "GD_ID_ZEL_ZUST_KLEMME50" 7691 "GD_ID_ZEL_DIMM_HINTERGRUNDBELEUCHTUNG_Status" 7691 "GD_ID_ZEL_DIMM_HINTERGRUNDBELEUCHTUNG" 7692 "GD_ID_ZEL_ZUST_LS_LICHTHUPE_Status" 7692 "GD_ID_ZEL_ZUST_LS_LICHTHUPE" 7693 "GD_ID_ZEL_ZUST_LS_FERNLICHT_Status" 7693 "GD_ID_ZEL_ZUST_LS_FERNLICHT" 7694 "GD_ID_ZEL_ZUST_LS_BLINKERRECHTS_Status" 7694 "GD_ID_ZEL_ZUST_LS_BLINKERRECHTS" 7695 "GD_ID_ZEL_ZUST_LS_BLINKERLINKS_Status" 7695 "GD_ID_ZEL_ZUST_LS_BLINKERLINKS" 7696 "GD_ID_ZEL_ZUST_LS_WISCHER_VORN_Status" 7696 "GD_ID_ZEL_ZUST_LS_WISCHER_VORN" 7697 "GD_ID_ZEL_ZUST_LS_WISCHER_INTERVALL_VORN_Status" 7697 "GD_ID_ZEL_ZUST_LS_WISCHER_INTERVALL_VORN" 7698 "GD_ID_ZEL_ZUST_LS_WASCHER_VORN_Status" 7698 "GD_ID_ZEL_ZUST_LS_WASCHER_VORN" 7699 "GD_ID_ZEL_FAHRLICHT_TASTER_Status" 7699 "GD_ID_ZEL_FAHRLICHT_TASTER" 7700 "GD_ID_ZEL_TOPLICHT_TASTER_Status" 7700 "GD_ID_ZEL_TOPLICHT_TASTER" 7701 "GD_ID_ZEL_AS_DACH_VORNE_TASTER_Status" 7701 "GD_ID_ZEL_AS_DACH_VORNE_TASTER" 7702 "GD_ID_ZEL_AS_DACH_HINTEN_TASTER_Status" 7702 "GD_ID_ZEL_AS_DACH_HINTEN_TASTER" 7703 "GD_ID_ZEL_AS_BLIPO_TASTER_Status" 7703 "GD_ID_ZEL_AS_BLIPO_TASTER" 7704 "GD_ID_ZEL_AS_HECK_TASTER_Status" 7704 "GD_ID_ZEL_AS_HECK_TASTER" 7705 "GD_ID_ZEL_AS_ALLES_AUS_TASTER_Status" 7705 "GD_ID_ZEL_AS_ALLES_AUS_TASTER" 7706 "GD_ID_ZEL_RUNDUMKENNLEUCHTE_TASTER_Status" 7706 "GD_ID_ZEL_RUNDUMKENNLEUCHTE_TASTER" 7707 "GD_ID_ZEL_WARNBLINKER_TASTER_Status" 7707 "GD_ID_ZEL_WARNBLINKER_TASTER" 7708 "GD_ID_ZEL_NEBELSCHLUSSLEUCHTE_TASTER_Status" 7708 "GD_ID_ZEL_NEBELSCHLUSSLEUCHTE_TASTER" 7709 "GD_ID_ZEL_HECKWASCHER_TASTER_Status" 7709 "GD_ID_ZEL_HECKWASCHER_TASTER" 7710 "GD_ID_ZEL_HECKWISCHER_TASTER_Status" 7710 "GD_ID_ZEL_HECKWISCHER_TASTER" 7711 "GD_ID_ZEL_HECKSCHEIBENHEIZUNG_TASTER_Status" 7711 "GD_ID_ZEL_HECKSCHEIBENHEIZUNG_TASTER" 7712 "GD_ID_ZEL_TEMPERATUR_PLUS_TASTER_Status" 7712 "GD_ID_ZEL_TEMPERATUR_PLUS_TASTER" 7713 "GD_ID_ZEL_TEMPERATUR_MINUS_TASTER_Status" 7713 "GD_ID_ZEL_TEMPERATUR_MINUS_TASTER" 7714 "GD_ID_ZEL_GEBLAESE_DRZ_PLUS_TASTER_Status" 7714 "GD_ID_ZEL_GEBLAESE_DRZ_PLUS_TASTER" 7715 "GD_ID_ZEL_GEBLAESE_DRZ_MINUS_TASTER_Status" 7715 "GD_ID_ZEL_GEBLAESE_DRZ_MINUS_TASTER" 7716 "GD_ID_ZEL_DEFROSTER_TASTER_Status" 7716 "GD_ID_ZEL_DEFROSTER_TASTER" 7717 "GD_ID_ZEL_LUFTVERTL_I_TASTER_Status" 7717 "GD_ID_ZEL_LUFTVERTL_I_TASTER" 7718 "GD_ID_ZEL_LUFTVERTL_II_TASTER_Status" 7718 "GD_ID_ZEL_LUFTVERTL_II_TASTER" 7719 "GD_ID_ZEL_LUFTVERTL_III_TASTER_Status" 7719 "GD_ID_ZEL_LUFTVERTL_III_TASTER" 7720 "GD_ID_ZEL_UMLUFT_TASTER_Status" 7720 "GD_ID_ZEL_UMLUFT_TASTER" 7721 "GD_ID_ZEL_KLIMA_TASTER_Status" 7721 "GD_ID_ZEL_KLIMA_TASTER" 7722 "GD_ID_ZEL_KLIMA_AUTO_TASTER_Status" 7722 "GD_ID_ZEL_KLIMA_AUTO_TASTER" 7723 "GD_ID_ZEL_ENTER_TASTER_Status" 7723 "GD_ID_ZEL_ENTER_TASTER" 7724 "GD_ID_ZEL_ESC_TASTER_Status" 7724 "GD_ID_ZEL_ESC_TASTER" 7725 "GD_ID_ZEL_CURSOR_RAUF_TASTER_Status" 7725 "GD_ID_ZEL_CURSOR_RAUF_TASTER" 7726 "GD_ID_ZEL_CURSOR_RUNTER_TASTER_Status" 7726 "GD_ID_ZEL_CURSOR_RUNTER_TASTER" 7727 "GD_ID_ZEL_STATUS_F56A_Status" 7727 "GD_ID_ZEL_STATUS_F56A" 7728 "GD_ID_ZEL_STATUS_F56B_Status" 7728 "GD_ID_ZEL_STATUS_F56B" 7729 "GD_ID_ZEL_STATUS_Z56A_Status" 7729 "GD_ID_ZEL_STATUS_Z56A" 7730 "GD_ID_ZEL_STATUS_Z56B_Status" 7730 "GD_ID_ZEL_STATUS_Z56B" 7731 "GD_ID_ZEL_STATUS_RUECKLICHT_LINKS_Status" 7731 "GD_ID_ZEL_STATUS_RUECKLICHT_LINKS" 7732 "GD_ID_ZEL_STATUS_RUECKLICHT_RECHTS_Status" 7732 "GD_ID_ZEL_STATUS_RUECKLICHT_RECHTS" 7733 "GD_ID_ZEL_STATUS_POSITIONSLEUCHTE_Status" 7733 "GD_ID_ZEL_STATUS_POSITIONSLEUCHTE" 7734 "GD_ID_ZEL_STATUS_RUECKLICHT_HAENGER_LINKS_Status" 7734 "GD_ID_ZEL_STATUS_RUECKLICHT_HAENGER_LINKS" 7735 "GD_ID_ZEL_STATUS_RUECKLICHT_HAENGER_RECHTS_Status" 7735 "GD_ID_ZEL_STATUS_RUECKLICHT_HAENGER_RECHTS" 7736 "GD_ID_ZEL_STATUS_BREMSLICHT_LINKS_Status" 7736 "GD_ID_ZEL_STATUS_BREMSLICHT_LINKS" 7737 "GD_ID_ZEL_STATUS_BREMSLICHT_RECHTS_Status" 7737 "GD_ID_ZEL_STATUS_BREMSLICHT_RECHTS" 7738 "GD_ID_ZEL_STATUS_BREMSLICHT_HAENGER_Status" 7738 "GD_ID_ZEL_STATUS_BREMSLICHT_HAENGER" 7739 "GD_ID_ZEL_STATUS_BLINKER_VORNE_LINKS_Status" 7739 "GD_ID_ZEL_STATUS_BLINKER_VORNE_LINKS" 7740 "GD_ID_ZEL_STATUS_BLINKER_VORNE_RECHTS_Status" 7740 "GD_ID_ZEL_STATUS_BLINKER_VORNE_RECHTS" 7741 "GD_ID_ZEL_STATUS_BLINKER_HINTEN_LINKS_Status" 7741 "GD_ID_ZEL_STATUS_BLINKER_HINTEN_LINKS" 7742 "GD_ID_ZEL_STATUS_BLINKER_HINTEN_RECHTS_Status" 7742 "GD_ID_ZEL_STATUS_BLINKER_HINTEN_RECHTS" 7743 "GD_ID_ZEL_STATUS_BLINKER_DOSE_LINKS_Status" 7743 "GD_ID_ZEL_STATUS_BLINKER_DOSE_LINKS" 7744 "GD_ID_ZEL_STATUS_BLINKER_DOSE_RECHTS_Status" 7744 "GD_ID_ZEL_STATUS_BLINKER_DOSE_RECHTS" 7745 "GD_ID_ZEL_ZAHL_BLINKER_HAENGER_Status" 7745 "GD_ID_ZEL_ZAHL_BLINKER_HAENGER" 7746 "GD_ID_ZEL_STATUS_RELAIS_Status" 7746 "GD_ID_ZEL_STATUS_RELAIS" 7747 "GD_ID_ZEL_STATUS_WISCHER_VORNE_HLS_Status" 7747 "GD_ID_ZEL_STATUS_WISCHER_VORNE_HLS" 7748 "GD_ID_ZEL_ZUSTAND_WISCHER_VORNE_Status" 7748 "GD_ID_ZEL_ZUSTAND_WISCHER_VORNE" 7749 "GD_ID_ZEL_WISCHER_STELLUNG_VORNE_Status" 7749 "GD_ID_ZEL_WISCHER_STELLUNG_VORNE" 7750 "GD_ID_ZEL_STATUS_WISCHER_HINTEN_HLS_Status" 7750 "GD_ID_ZEL_STATUS_WISCHER_HINTEN_HLS" 7751 "GD_ID_ZEL_ZUSTAND_WISCHER_HINTEN_Status" 7751 "GD_ID_ZEL_ZUSTAND_WISCHER_HINTEN" 7752 "GD_ID_ZEL_WISCHER_STELLUNG_HINTEN_Status" 7752 "GD_ID_ZEL_WISCHER_STELLUNG_HINTEN" 7753 "GD_ID_ZEL_STATUS_WASCHER_VORNE_Status" 7753 "GD_ID_ZEL_STATUS_WASCHER_VORNE" 7754 "GD_ID_ZEL_STATUS_WASCHER_HINTEN_Status" 7754 "GD_ID_ZEL_STATUS_WASCHER_HINTEN" 7755 "GD_ID_ZEL_STATUS_GD_GROESSEN_Status" 7755 "GD_ID_ZEL_STATUS_GD_GROESSEN" 7756 "GD_ID_ZEL_STATUS_TANKPUMPE_Status" 7756 "GD_ID_ZEL_STATUS_TANKPUMPE" 7757 "GD_ID_ZEL_STATUS_UEBERBREITE_LINKS_Status" 7757 "GD_ID_ZEL_STATUS_UEBERBREITE_LINKS" 7758 "GD_ID_ZEL_STATUS_UEBERBREITE_RECHTS_Status" 7758 "GD_ID_ZEL_STATUS_UEBERBREITE_RECHTS" 7759 "GD_ID_ZEL_ZUSTANDBELEUCHTUNG_Status" 7759 "GD_ID_ZEL_ZUSTANDBELEUCHTUNG" 7760 "GD_ID_ZEL_SCHALTSCHWELLE_1HAENGER_Status" 7760 "GD_ID_ZEL_SCHALTSCHWELLE_1HAENGER" 7761 "GD_ID_ZEL_SCHALTSCHWELLE_2HAENGER_Status" 7761 "GD_ID_ZEL_SCHALTSCHWELLE_2HAENGER" 7762 "GD_ID_ZEL_BETRIEBSPANNUNG_UB_Status" 7762 "GD_ID_ZEL_BETRIEBSPANNUNG_UB" 7763 "GD_ID_ZEL_TEMPERATUR_Status" 7763 "GD_ID_ZEL_TEMPERATUR" 7764 "GD_ID_ZEL_SENSORSPANNUNG_Status" 7764 "GD_ID_ZEL_SENSORSPANNUNG" 7765 "GD_ID_ZEL_HW_VERSION_Status" 7765 "GD_ID_ZEL_HW_VERSION" 7766 "GD_ID_ZEL_LAST_ZAEHLER_Status" 7766 "GD_ID_ZEL_LAST_ZAEHLER" 7767 "GD_ID_ZEL_DEBUG_INDEX_1_Status" 7767 "GD_ID_ZEL_DEBUG_INDEX_1" 7768 "GD_ID_ZEL_DEBUG_INDEX_2_Status" 7768 "GD_ID_ZEL_DEBUG_INDEX_2" 7769 "GD_ID_ZEL_ZUST_BLINKER_Status" 7769 "GD_ID_ZEL_ZUST_BLINKER" 7770 "GD_ID_ZEL_ZUST_RUEFA_UNTERSTUETZUNG_Status" 7770 "GD_ID_ZEL_ZUST_RUEFA_UNTERSTUETZUNG" 7771 "GD_ID_ZEL_STATUS_VENTIL_RUEFA_LINKS_Status" 7771 "GD_ID_ZEL_STATUS_VENTIL_RUEFA_LINKS" 7772 "GD_ID_ZEL_STATUS_VENTIL_RUEFA_RECHTS_Status" 7772 "GD_ID_ZEL_STATUS_VENTIL_RUEFA_RECHTS" 7773 "GD_ID_ZEL_ZUST_LED_ANHAENGERBREMSE_Status" 7773 "GD_ID_ZEL_ZUST_LED_ANHAENGERBREMSE" 7774 "GD_ID_ZEL_STATUS_DUESENHEIZUNG_Status" 7774 "GD_ID_ZEL_STATUS_DUESENHEIZUNG" 7775 "GD_ID_ZEL_STATUS_SPIEGELHEIZUNG_Status" 7775 "GD_ID_ZEL_STATUS_SPIEGELHEIZUNG" 7776 "GD_ID_ZEL_ZUST_RELAIS_KREIS_3_Status" 7776 "GD_ID_ZEL_ZUST_RELAIS_KREIS_3" 7777 "GD_ID_ZEL_ZUST_RELAIS_KREIS_4_Status" 7777 "GD_ID_ZEL_ZUST_RELAIS_KREIS_4" 7778 "GD_ID_ZEL_INNENRAUMLEUCHTE_Status" 7778 "GD_ID_ZEL_INNENRAUMLEUCHTE" 7779 "GD_ID_ZEL_TUERKONTAKT_Status" 7779 "GD_ID_ZEL_TUERKONTAKT" 7780 "GD_ID_ZEL_ISO_ISTZUST_BELEUCHTUNG1_Status" 7780 "GD_ID_ZEL_ISO_ISTZUST_BELEUCHTUNG1" 7781 "GD_ID_ZEL_ISO_ISTZUST_BELEUCHTUNG2_Status" 7781 "GD_ID_ZEL_ISO_ISTZUST_BELEUCHTUNG2" 7782 "GD_ID_ZEL_ISO_ISTZUST_BELEUCHTUNG3_Status" 7782 "GD_ID_ZEL_ISO_ISTZUST_BELEUCHTUNG3" 7783 "GD_ID_ZEL_ISO_ISTZUST_BELEUCHTUNG4_Status" 7783 "GD_ID_ZEL_ISO_ISTZUST_BELEUCHTUNG4" 7784 "GD_ID_ZEL_ISO_SOLLZUST_BELEUCHTUNG1_Status" 7784 "GD_ID_ZEL_ISO_SOLLZUST_BELEUCHTUNG1" 7785 "GD_ID_ZEL_ISO_SOLLZUST_BELEUCHTUNG2_Status" 7785 "GD_ID_ZEL_ISO_SOLLZUST_BELEUCHTUNG2" 7786 "GD_ID_ZEL_ISO_SOLLZUST_BELEUCHTUNG3_Status" 7786 "GD_ID_ZEL_ISO_SOLLZUST_BELEUCHTUNG3" 7787 "GD_ID_ZEL_ISO_SOLLZUST_BELEUCHTUNG4_Status" 7787 "GD_ID_ZEL_ISO_SOLLZUST_BELEUCHTUNG4" 7788 "GD_ID_ZEL_WS_WIPER_INTERVAL_Status" 7788 "GD_ID_ZEL_WS_WIPER_INTERVAL" 7789 "GD_ID_ZEL_RW_WIPER_INTERVAL_Status" 7789 "GD_ID_ZEL_RW_WIPER_INTERVAL" 7790 "GD_ID_ZEL_SERVICEPOSITION_LIN_WISCHER_Status" 7790 "GD_ID_ZEL_SERVICEPOSITION_LIN_WISCHER" 7791 "GD_ID_ZEL_AUFSTIEGSLEUCHTE_Status" 7791 "GD_ID_ZEL_AUFSTIEGSLEUCHTE" 7792 "GD_ID_ZEL_SENSORWERT_RESERVE1_Status" 7792 "GD_ID_ZEL_SENSORWERT_RESERVE1" 7793 "GD_ID_ZEL_OUTWERT_RESERVE1_Status" 7793 "GD_ID_ZEL_OUTWERT_RESERVE1" 7794 "GD_ID_ZEL_SENSORWERT_RESERVE2_Status" 7794 "GD_ID_ZEL_SENSORWERT_RESERVE2" 7795 "GD_ID_ZEL_OUTWERT_RESERVE2_Status" 7795 "GD_ID_ZEL_OUTWERT_RESERVE2" 7796 "GD_ID_ZEL_SENSORWERT_RESERVE3_Status" 7796 "GD_ID_ZEL_SENSORWERT_RESERVE3" 7797 "GD_ID_ZEL_OUTWERT_RESERVE3_Status" 7797 "GD_ID_ZEL_OUTWERT_RESERVE3" 7798 "GD_ID_ZEL_SENSORWERT_TEMP_PT100_Status" 7798 "GD_ID_ZEL_SENSORWERT_TEMP_PT100" 7799 "GD_ID_ZEL_TEMP_PT100_Status" 7799 "GD_ID_ZEL_TEMP_PT100" 7800 "GD_ID_ZEL_SENSORWERT_TEMP_GETRIEBE_Status" 7800 "GD_ID_ZEL_SENSORWERT_TEMP_GETRIEBE" 7801 "GD_ID_ZEL_TEMP_GETRIEBE_Status" 7801 "GD_ID_ZEL_TEMP_GETRIEBE" 7802 "GD_ID_ZEL_SENSORWERT_TEMP_OELTANK_Status" 7802 "GD_ID_ZEL_SENSORWERT_TEMP_OELTANK" 7803 "GD_ID_ZEL_TEMP_OELTANK_Status" 7803 "GD_ID_ZEL_TEMP_OELTANK" 7804 "GD_ID_ZEL_SENSORWERT_TEMP_FAHRMOTOR_Status" 7804 "GD_ID_ZEL_SENSORWERT_TEMP_FAHRMOTOR" 7805 "GD_ID_ZEL_TEMP_FAHRMOTOR_Status" 7805 "GD_ID_ZEL_TEMP_FAHRMOTOR" 7806 "GD_ID_ZEL_SENSORWERT_AUSSENTEMP_Status" 7806 "GD_ID_ZEL_SENSORWERT_AUSSENTEMP" 7807 "GD_ID_ZEL_AUSSENTEMPERATUR_Status" 7807 "GD_ID_ZEL_AUSSENTEMPERATUR" 7808 "GD_ID_ZEL_SENSORWERT_FUELLSTAND_DIESEL_Status" 7808 "GD_ID_ZEL_SENSORWERT_FUELLSTAND_DIESEL" 7809 "GD_ID_ZEL_FUELLSTAND_DIESELTANK_BEDAEMPFT_Status" 7809 "GD_ID_ZEL_FUELLSTAND_DIESELTANK_BEDAEMPFT" 7810 "GD_ID_ZEL_FUELLSTAND_DIESELTANK_Status" 7810 "GD_ID_ZEL_FUELLSTAND_DIESELTANK" 7811 "GD_ID_ZEL_SENSORWERT_FUELLSTAND_HYDOEL_Status" 7811 "GD_ID_ZEL_SENSORWERT_FUELLSTAND_HYDOEL" 7812 "GD_ID_ZEL_FUELLSTAND_HYDOELTANK_BEDAEMPFT_Status" 7812 "GD_ID_ZEL_FUELLSTAND_HYDOELTANK_BEDAEMPFT" 7813 "GD_ID_ZEL_FUELLSTAND_HYDOELTANK_Status" 7813 "GD_ID_ZEL_FUELLSTAND_HYDOELTANK" 7814 "GD_ID_ZEL_SENSORWERT_DRUCK_GETRIEBE_Status" 7814 "GD_ID_ZEL_SENSORWERT_DRUCK_GETRIEBE" 7816 "GD_ID_ZEL_DRUCK_GETRIEBE_Status" 7816 "GD_ID_ZEL_DRUCK_GETRIEBE" 7817 "GD_ID_ZEL_SENSORWERT_LUFTFILTERSENSOR_Status" 7817 "GD_ID_ZEL_SENSORWERT_LUFTFILTERSENSOR" 7818 "GD_ID_ZEL_UNTERDRUCK_LUFTFILTERSENSOR_Status" 7818 "GD_ID_ZEL_UNTERDRUCK_LUFTFILTERSENSOR" 7839 "GD_ID_ZEL_SCHMIERPAUSENZEIT_Status" 7839 "GD_ID_ZEL_SCHMIERPAUSENZEIT" 7840 "GD_ID_ZEL_SCHMIERZYKLENZAHL_Status" 7840 "GD_ID_ZEL_SCHMIERZYKLENZAHL" 7842 "GD_ID_ZEL_SCHMIERUNG_STATUS_Status" 7842 "GD_ID_ZEL_SCHMIERUNG_STATUS" 7843 "GD_ID_ZEL_SCHMIERUNG_FUELLSTAND_Status" 7843 "GD_ID_ZEL_SCHMIERUNG_FUELLSTAND" 7844 "GD_ID_ZEL_TASTE_MANUELL_Status" 7844 "GD_ID_ZEL_TASTE_MANUELL" 7845 "GD_ID_ZEL_TASTE_SCHMIERUNG_AUS_Status" 7845 "GD_ID_ZEL_TASTE_SCHMIERUNG_AUS" 7846 "GD_ID_ZEL_RESTPAUSENANZEIGE_Status" 7846 "GD_ID_ZEL_RESTPAUSENANZEIGE" 7847 "GD_ID_ZEL_STATUS_IMPULSEINGANG_Status" 7847 "GD_ID_ZEL_STATUS_IMPULSEINGANG" 7848 "GD_ID_ZEL_STATUS_PUMPENAUSGANG_Status" 7848 "GD_ID_ZEL_STATUS_PUMPENAUSGANG" 7849 "GD_ID_ZEL_STATUS_FUELLSTANDEINGANG_Status" 7849 "GD_ID_ZEL_STATUS_FUELLSTANDEINGANG" 7850 "GD_ID_ZEL_IMPULSZAHL_IST_Status" 7850 "GD_ID_ZEL_IMPULSZAHL_IST" 7851 "GD_ID_ZEL_ZUST_LS_WISCHER2_VORN_Status" 7851 "GD_ID_ZEL_ZUST_LS_WISCHER2_VORN" 7860 "GD_ID_ZEL_TASTE_SYSTEM1_Status" 7860 "GD_ID_ZEL_TASTE_SYSTEM1" 7861 "GD_ID_ZEL_TASTE_SYSTEM2_Status" 7861 "GD_ID_ZEL_TASTE_SYSTEM2" 7862 "GD_ID_ZEL_TASTE_SYSTEM3_Status" 7862 "GD_ID_ZEL_TASTE_SYSTEM3" 7863 "GD_ID_ZEL_TASTE_DAUERBETRIEB_Status" 7863 "GD_ID_ZEL_TASTE_DAUERBETRIEB" 7864 "GD_ID_ZEL_DOSIERSYSTEM_AKTIV_Status" 7864 "GD_ID_ZEL_DOSIERSYSTEM_AKTIV" 7865 "GD_ID_ZEL_STATUS_SILIERMITTELAUSGANG_2_Status" 7865 "GD_ID_ZEL_STATUS_SILIERMITTELAUSGANG_2" 7866 "GD_ID_ZEL_STATUS_SILIERMITTELAUSGANG_3_Status" 7866 "GD_ID_ZEL_STATUS_SILIERMITTELAUSGANG_3" 7867 "GD_ID_ZEL_INTERVALSTUFE_WISCHER_VORN_Status" 7867 "GD_ID_ZEL_INTERVALSTUFE_WISCHER_VORN" 7868 "GD_ID_ZEL_INTERVALSTUFE_WISCHER_HINTEN_Status" 7868 "GD_ID_ZEL_INTERVALSTUFE_WISCHER_HINTEN" 7869 "GD_ID_ZEL_INTERVALSTUFE_WISCHER_SEITE_Status" 7869 "GD_ID_ZEL_INTERVALSTUFE_WISCHER_SEITE" 7870 "GD_ID_ZEL_STATUS_WISCHER_LINKS_HLS_Status" 7870 "GD_ID_ZEL_STATUS_WISCHER_LINKS_HLS" 7871 "GD_ID_ZEL_ZUSTAND_WISCHER_LINKS_Status" 7871 "GD_ID_ZEL_ZUSTAND_WISCHER_LINKS" 7872 "GD_ID_ZEL_WISCHER_STELLUNG_LINKS_Status" 7872 "GD_ID_ZEL_WISCHER_STELLUNG_LINKS" 7873 "GD_ID_ZEL_STATUS_WISCHER_RECHTS_HLS_Status" 7873 "GD_ID_ZEL_STATUS_WISCHER_RECHTS_HLS" 7874 "GD_ID_ZEL_ZUSTAND_WISCHER_RECHTS_Status" 7874 "GD_ID_ZEL_ZUSTAND_WISCHER_RECHTS" 7875 "GD_ID_ZEL_WISCHER_STELLUNG_RECHTS_Status" 7875 "GD_ID_ZEL_WISCHER_STELLUNG_RECHTS" 7876 "GD_ID_ZEL_STATUS_WASCHER_LINKS_Status" 7876 "GD_ID_ZEL_STATUS_WASCHER_LINKS" 7877 "GD_ID_ZEL_STATUS_WASCHER_RECHTS_Status" 7877 "GD_ID_ZEL_STATUS_WASCHER_RECHTS" 7880 "GD_ID_ZEL_WR_WIPER_INTERVAL_Status" 7880 "GD_ID_ZEL_WR_WIPER_INTERVAL" 7881 "GD_ID_ZEL_WL_WIPER_INTERVAL_Status" 7881 "GD_ID_ZEL_WL_WIPER_INTERVAL" 7882 "GD_ID_ZEL_STATUS_ARBEITSSCHEINWERFER_Status" 7882 "GD_ID_ZEL_STATUS_ARBEITSSCHEINWERFER" 7883 "GD_ID_ZEL_BLINKER_AKTIV_Status" 7883 "GD_ID_ZEL_BLINKER_AKTIV" 7884 "GD_ID_ZEL_STATUS_RUNDUMKENNLEUCHTE_Status" 7884 "GD_ID_ZEL_STATUS_RUNDUMKENNLEUCHTE" 7885 "GD_ID_ZEL_ZEFH_IN_STATUS1_Status" 7885 "GD_ID_ZEL_ZEFH_IN_STATUS1" 7886 "GD_ID_ZEL_ZEFH_IN_STATUS2_Status" 7886 "GD_ID_ZEL_ZEFH_IN_STATUS2" 7887 "GD_ID_ZEL_ZEFH_OUT_STATUS_Status" 7887 "GD_ID_ZEL_ZEFH_OUT_STATUS" 7891 "GD_ID_ZEL_BETRIEBSPANNUNG_UB2_Status" 7891 "GD_ID_ZEL_BETRIEBSPANNUNG_UB2" 7892 "GD_ID_ZEL_SPANNUNG_EXT5V_Status" 7892 "GD_ID_ZEL_SPANNUNG_EXT5V" 7900 "GD_ID_ZEL_BOARD_IDENTIFICATION_Status" 7900 "GD_ID_ZEL_BOARD_IDENTIFICATION" 7902 "GD_ID_ZEL_SOFTWARE_VERSION_Status" 7902 "GD_ID_ZEL_SOFTWARE_VERSION" 7903 "GD_ID_ZEL_SOFTWARE_REVISION_Status" 7903 "GD_ID_ZEL_SOFTWARE_REVISION" 7907 "GD_ID_ZEL_OUTPUT_FAD3_Status" 7907 "GD_ID_ZEL_OUTPUT_FAD3" 7908 "GD_ID_ZEL_OUTPUT_FAD4_Status" 7908 "GD_ID_ZEL_OUTPUT_FAD4" 7909 "GD_ID_ZEL_OUTPUT_FAD5_Status" 7909 "GD_ID_ZEL_OUTPUT_FAD5" 7921 "GD_ID_ZEL_RELAIS_FAR1_Status" 7921 "GD_ID_ZEL_RELAIS_FAR1" 7922 "GD_ID_ZEL_RELAIS_FAR2_Status" 7922 "GD_ID_ZEL_RELAIS_FAR2" 7923 "GD_ID_ZEL_RELAIS_FAR3_Status" 7923 "GD_ID_ZEL_RELAIS_FAR3" 7924 "GD_ID_ZEL_RELAIS_FAR4_Status" 7924 "GD_ID_ZEL_RELAIS_FAR4" 7925 "GD_ID_ZEL_RELAIS_FAR5_Status" 7925 "GD_ID_ZEL_RELAIS_FAR5" 7928 "GD_ID_ZEL_RELAIS_RES_Status" 7928 "GD_ID_ZEL_RELAIS_RES" 7930 "GD_ID_ZEL_TURNLIGHT_STATE" 7934 "GD_ID_ZEL_ERROR_ACKNOWLEDGE_Status" 7934 "GD_ID_ZEL_ERROR_ACKNOWLEDGE" 7935 "GD_ID_ZEL_RELAIS_ISO_Status" 7935 "GD_ID_ZEL_RELAIS_ISO" 7936 "GD_ID_ZEL_LIGHTING_ON_HOLD_DELAY_Status" 7936 "GD_ID_ZEL_LIGHTING_ON_HOLD_DELAY" 7937 "GD_ID_ZEL_FOLDING_LADDER_Status" 7937 "GD_ID_ZEL_FOLDING_LADDER" 7938 "GD_ID_ZEL_SOFTWARE_PROJECT_PART1_Status" 7938 "GD_ID_ZEL_SOFTWARE_PROJECT_PART1" 7939 "GD_ID_ZEL_SOFTWARE_PROJECT_PART2_Status" 7939 "GD_ID_ZEL_SOFTWARE_PROJECT_PART2" 7940 "GD_ID_ZEL_SOFTWARE_PROJECT_PART3_Status" 7940 "GD_ID_ZEL_SOFTWARE_PROJECT_PART3" 7941 "GD_ID_ZEL_SOFTWARE_PROJECT_PART4_Status" 7941 "GD_ID_ZEL_SOFTWARE_PROJECT_PART4" 8176 "GD_ID_ZEL_AKTIVIERE_DIAGNOSE_Status" 8176 "GD_ID_ZEL_AKTIVIERE_DIAGNOSE" 8174 "GD_ID_ZE_ErrorManagement_Status" 8174 "GD_ID_ZE_ErrorManagement" 8191 "GD_ID_ZE_LifeMessage" 8192 "GD_ID_HVAC_DISPLAY_FLAGS" 8193 "GD_ID_HVAC_SET_TEMPERATURE" 8194 "GD_ID_HVAC_BLOWER_SPEED" 8195 "GD_ID_HVAC_OUTSIDE_TEMPERATURE" 8196 "GD_ID_HVAC_HEAT_VALVE_MOTOR_POS" 8197 "GD_ID_HVAC_EVAPORATOR_TEMPERATURE" 8198 "GD_ID_HVAC_CABIN_TEMPERATURE" 8199 "GD_ID_HVAC_OUTLET_TEMPERATURE" 8200 "GD_ID_HVAC_LUMINOSITY" 8202 "GD_ID_HVAC_PRESSURE_SWITCH_STATE_Status" 8202 "GD_ID_HVAC_PRESSURE_SWITCH_STATE" 8203 "GD_ID_HVAC_DRIVER_SCREEN_THROTTLE_SETPOINT_Status" 8203 "GD_ID_HVAC_DRIVER_SCREEN_THROTTLE_SETPOINT" 8204 "GD_ID_HVAC_FOOT_THROTTLE_SETPOINT_Status" 8204 "GD_ID_HVAC_FOOT_THROTTLE_SETPOINT" 8205 "GD_ID_HVAC_MAGNETIC_CLUTCH_OUTPUT_SETPOINT_Status" 8205 "GD_ID_HVAC_MAGNETIC_CLUTCH_OUTPUT_SETPOINT" 8207 "GD_ID_HVAC_HEAT_VALVE_MOTOR_CALIB_ACTIVE_Status" 8207 "GD_ID_HVAC_HEAT_VALVE_MOTOR_CALIB_ACTIVE" 8208 "GD_ID_HVAC_TESTMODE_ACTIVE_Status" 8208 "GD_ID_HVAC_TESTMODE_ACTIVE" 8209 "GD_ID_HVAC_TESTMODE_MOTOR_POSITION" 8210 "GD_ID_HVAC_TESTMODE_FAN_SET_SPEED" 8211 "GD_ID_HVAC_TESTMODE_COMPRESSOR_ON_OFF_Status" 8211 "GD_ID_HVAC_TESTMODE_COMPRESSOR_ON_OFF" 8212 "GD_ID_HVAC_UNITS" 8214 "GD_ID_HVAC_FAN_DIAG_STATE" 8215 "GD_ID_HVAC_FAN_SPEED_INCREASE" 8216 "GD_ID_HVAC_MOTOR_SETPOINT" 8217 "GD_ID_HVAC_FUNCTIONAL_LIGHTING_BRIGHTNESS" 8218 "GD_ID_HVAC_BACKGROUND_LIGHTING_BRIGHTNESS" 8220 "GD_ID_HVAC_HEAT_MOTOR_MAX_POSITION" 8228 "GD_ID_HVAC_DEFROST_BUTTON_Status" 8228 "GD_ID_HVAC_DEFROST_BUTTON" 8229 "GD_ID_HVAC_AIR_DISTRIBUTION_DISC_BUTTON_Status" 8229 "GD_ID_HVAC_AIR_DISTRIBUTION_DISC_BUTTON" 8230 "GD_ID_HVAC_AIR_DISTRIBUTION_DRIVER_BUTTON_Status" 8230 "GD_ID_HVAC_AIR_DISTRIBUTION_DRIVER_BUTTON" 8231 "GD_ID_HVAC_AIR_DISTRIBUTION_FOOT_BUTTON_Status" 8231 "GD_ID_HVAC_AIR_DISTRIBUTION_FOOT_BUTTON" 8232 "GD_ID_HVAC_EXCESS_PRESSURE_BUTTON_Status" 8232 "GD_ID_HVAC_EXCESS_PRESSURE_BUTTON" 8233 "GD_ID_HVAC_AC_BUTTON_Status" 8233 "GD_ID_HVAC_AC_BUTTON" 8239 "GD_ID_HVAC_STATUS_OVERPRESSURE_Status" 8239 "GD_ID_HVAC_STATUS_OVERPRESSURE" 8446 "GD_ID_HVAC_ErrorManagement_Status" 8446 "GD_ID_HVAC_ErrorManagement" 8703 "GD_ID_HVAC_LifeMessage" 8720 "GD_ID_LCP_HEAD_LIGHT_BUTTON_R_Status" 8720 "GD_ID_LCP_HEAD_LIGHT_BUTTON_R" 8721 "GD_ID_LCP_HEAD_LIGHT_LED_RW" 8722 "GD_ID_LCP_HEAD_LIGHT_AUX_BUTTON_R_Status" 8722 "GD_ID_LCP_HEAD_LIGHT_AUX_BUTTON_R" 8723 "GD_ID_LCP_HEAD_LIGHT_AUX_LED_RW" 8728 "GD_ID_LCP_ROTATING_BEACON_BUTTON_R_Status" 8728 "GD_ID_LCP_ROTATING_BEACON_BUTTON_R" 8729 "GD_ID_LCP_ROTATING_BEACON_LED_RW" 8732 "GD_ID_LCP_HAZARD_LIGHT_BUTTON_R_Status" 8732 "GD_ID_LCP_HAZARD_LIGHT_BUTTON_R" 8733 "GD_ID_LCP_HAZARD_LIGHT_LED_RW" 8736 "GD_ID_LCP_WORKLIGHT_AHEAD_BUTTON_R0x22208736100255Buttonworklightfront_Status" 8736 "GD_ID_LCP_WORKLIGHT_AHEAD_BUTTON_R0x22208736100255Buttonworklightfront" 8737 "GD_ID_LCP_WORKLIGHT_AHEAD_LED_RW" 8738 "GD_ID_LCP_WORKLIGHT_BEHIND_BUTTON_R_Status" 8738 "GD_ID_LCP_WORKLIGHT_BEHIND_BUTTON_R" 8739 "GD_ID_LCP_WORKLIGHT_BEHIND_LED_RW" 8740 "GD_ID_LCP_WORKLIGHT_APILLAR_BUTTON_R_Status" 8740 "GD_ID_LCP_WORKLIGHT_APILLAR_BUTTON_R" 8741 "GD_ID_LCP_WORKLIGHT_APILLAR_LED_RW" 8742 "GD_ID_LCP_WORKLIGHT_CPILLAR_BUTTON_R_Status" 8742 "GD_ID_LCP_WORKLIGHT_CPILLAR_BUTTON_R" 8743 "GD_ID_LCP_WORKLIGHT_CPILLAR_LED_RW" 8744 "GD_ID_LCP_WORKLIGHT_MEMORY_BUTTON_R_Status" 8744 "GD_ID_LCP_WORKLIGHT_MEMORY_BUTTON_R" 8745 "GD_ID_LCP_WORKLIGHT_MEMORY_LED_RW" 8746 "GD_ID_LCP_WORKLIGHT_ZONE_II_BUTTON_R_Status" 8746 "GD_ID_LCP_WORKLIGHT_ZONE_II_BUTTON_R" 8747 "GD_ID_LCP_WORKLIGHT_ZONE_II_LED_RW" 8748 "GD_ID_LCP_WORKLIGHT_ZONE_I_BUTTON_R_Status" 8748 "GD_ID_LCP_WORKLIGHT_ZONE_I_BUTTON_R" 8749 "GD_ID_LCP_WORKLIGHT_ZONE_I_LED_RW" 8752 "GD_ID_LCP_REARWINDOW_WIPER_BUTTON_R_Status" 8752 "GD_ID_LCP_REARWINDOW_WIPER_BUTTON_R" 8753 "GD_ID_LCP_REARWINDOW_WIPER_LED_RW" 8754 "GD_ID_LCP_REARWINDOW_WASHER_BUTTON_R_Status" 8754 "GD_ID_LCP_REARWINDOW_WASHER_BUTTON_R" 8755 "GD_ID_LCP_REARWINDOW_WASHER_LED_RW_Status" 8755 "GD_ID_LCP_REARWINDOW_WASHER_LED_RW" 8756 "GD_ID_LCP_REARWINDOW_HEATER_BUTTON_R_Status" 8756 "GD_ID_LCP_REARWINDOW_HEATER_BUTTON_R" 8757 "GD_ID_LCP_REARWINDOW_HEATER_LED_RW_Status" 8757 "GD_ID_LCP_REARWINDOW_HEATER_LED_RW" 8770 "GD_ID_LCP_AUX_3_BUTTON_R_Status" 8770 "GD_ID_LCP_AUX_3_BUTTON_R" 8771 "GD_ID_LCP_AUX_3_LED_RW" 8784 "GD_ID_LCP_AUX_1_BUTTON_R_Status" 8784 "GD_ID_LCP_AUX_1_BUTTON_R" 8785 "GD_ID_LCP_AUX_1_LED_RW" 8786 "GD_ID_LCP_AUX_2_BUTTON_R_Status" 8786 "GD_ID_LCP_AUX_2_BUTTON_R" 8787 "GD_ID_LCP_AUX_2_LED_RW" 8800 "GD_ID_LCP_WINDSCREEN_WIPER_BUTTON_R_Status" 8800 "GD_ID_LCP_WINDSCREEN_WIPER_BUTTON_R" 8801 "GD_ID_LCP_WINDSCREEN_WIPER_LED_RW" 8802 "GD_ID_LCP_WINDSCREEN_WASHER_BUTTON_R_Status" 8802 "GD_ID_LCP_WINDSCREEN_WASHER_BUTTON_R" 8804 "GD_ID_LCP_SIDEWINDOW_RIGHT_WIPER_BUTTON_R_Status" 8804 "GD_ID_LCP_SIDEWINDOW_RIGHT_WIPER_BUTTON_R" 8805 "GD_ID_LCP_SIDEWINDOW_RIGHT_WIPER_LED_RW" 8806 "GD_ID_LCP_SIDEWINDOW_RIGHT_WASHER_BUTTON_R_Status" 8806 "GD_ID_LCP_SIDEWINDOW_RIGHT_WASHER_BUTTON_R" 8808 "GD_ID_LCP_SIDEWINDOW_LEFT_WIPER_BUTTON_R_Status" 8808 "GD_ID_LCP_SIDEWINDOW_LEFT_WIPER_BUTTON_R" 8809 "GD_ID_LCP_SIDEWINDOW_LEFT_WIPER_LED_RW_Status" 8809 "GD_ID_LCP_SIDEWINDOW_LEFT_WIPER_LED_RW" 8810 "GD_ID_LCP_SIDEWINDOW_LEFT_WASHER_BUTTON_R_Status" 8810 "GD_ID_LCP_SIDEWINDOW_LEFT_WASHER_BUTTON_R" 8824 "GD_ID_LCP_NOZZLE_LIGHT_BUTTON_R_Status" 8824 "GD_ID_LCP_NOZZLE_LIGHT_BUTTON_R" 8825 "GD_ID_LCP_NOZZLE_LIGHT_LED_RW" 8832 "GD_ID_LCP_RESERVE_F1_1ST_BUTTON_R_Status" 8832 "GD_ID_LCP_RESERVE_F1_1ST_BUTTON_R" 8833 "GD_ID_LCP_RESERVE_F1_1ST_LED_RW" 8834 "GD_ID_LCP_RESERVE_F1_2ND_BUTTON_R_Status" 8834 "GD_ID_LCP_RESERVE_F1_2ND_BUTTON_R" 8835 "GD_ID_LCP_RESERVE_F1_2ND_LED_RW" 8836 "GD_ID_LCP_RESERVE_F1_3RD_BUTTON_R_Status" 8836 "GD_ID_LCP_RESERVE_F1_3RD_BUTTON_R" 8837 "GD_ID_LCP_RESERVE_F1_3RD_LED_RW" 8838 "GD_ID_LCP_RESERVE_F1_4TH_BUTTON_R_Status" 8838 "GD_ID_LCP_RESERVE_F1_4TH_BUTTON_R" 8839 "GD_ID_LCP_RESERVE_F1_4TH_LED_RW" 8840 "GD_ID_LCP_RESERVE_F1_5TH_BUTTON_R_Status" 8840 "GD_ID_LCP_RESERVE_F1_5TH_BUTTON_R" 8841 "GD_ID_LCP_RESERVE_F1_5TH_LED_RW" 8842 "GD_ID_LCP_RESERVE_F1_6TH_BUTTON_R_Status" 8842 "GD_ID_LCP_RESERVE_F1_6TH_BUTTON_R" 8843 "GD_ID_LCP_RESERVE_F1_6TH_LED_RW" 8864 "GD_ID_LCP_LUMINANCE_FUNC_RW" 8865 "GD_ID_LCP_LUMINANCE_BACK_RW" 8881 "GD_ID_LCP_MUX_LIGHTING_BUTTON_R" 8882 "GD_ID_LCP_MUX_WORKLIGHT_BUTTON_R" 8883 "GD_ID_LCP_MUX_REARWINDOW_BUTTON_R_Status" 8883 "GD_ID_LCP_MUX_REARWINDOW_BUTTON_R" 8886 "GD_ID_LCP_MUX_WINDOW_BUTTON_R" 8888 "GD_ID_LCP_MUX_RESERVE_F1_BUTTON_R" 8912 "GD_ID_LCP_VOLTAGE_VBAT_R" 8913 "GD_ID_LCP_VOLTAGE_5V_R" 8914 "GD_ID_LCP_VOLTAGE_3V3_R" 8916 "GD_ID_LCP_VOLTAGE_TEMP_R" 8920 "GD_ID_LCP_TEMPERATURE_R" 8928 "GD_ID_LCP_DELAY_W_Status" 8928 "GD_ID_LCP_DELAY_W" 9200 "GD_ID_LCP_BOARD_IDENTIFICATION_R" 9202 "GD_ID_LCP_HARDWARE_REVISION_R" 9204 "GD_ID_LCP_SOFTWARE_VERSION_R" 9198 "GD_ID_LCP_ErrorManagement_Status" 9198 "GD_ID_LCP_ErrorManagement" 9215 "GD_ID_LCP_LifeMessage" 27648 "GD_ID_HC_TARGET_STATE_Status" 27648 "GD_ID_HC_TARGET_STATE" 27649 "GD_ID_HC_MACHINE_STATE_Status" 27649 "GD_ID_HC_MACHINE_STATE" 27650 "GD_ID_HC_LEG_STATE_FRONTLEFT" 27651 "GD_ID_HC_LEG_STATE_FRONTRIGHT" 27652 "GD_ID_HC_LEG_STATE_REARLEFT" 27653 "GD_ID_HC_LEG_STATE_REARRIGHT" 27654 "GD_ID_HC_TARGET_CLEARANCE_FL" 27655 "GD_ID_HC_TARGET_CLEARANCE_FR" 27656 "GD_ID_HC_TARGET_CLEARANCE_RL" 27657 "GD_ID_HC_TARGET_CLEARANCE_RR" 27658 "GD_ID_HC_ACTUAL_CLEARANCE_FL_Status" 27658 "GD_ID_HC_ACTUAL_CLEARANCE_FL" 27659 "GD_ID_HC_ACTUAL_CLEARANCE_FR_Status" 27659 "GD_ID_HC_ACTUAL_CLEARANCE_FR" 27660 "GD_ID_HC_ACTUAL_CLEARANCE_RL_Status" 27660 "GD_ID_HC_ACTUAL_CLEARANCE_RL" 27661 "GD_ID_HC_ACTUAL_CLEARANCE_RR_Status" 27661 "GD_ID_HC_ACTUAL_CLEARANCE_RR" 27662 "GD_ID_HC_STROKE_LEGNTH_RAW_FL" 27663 "GD_ID_HC_STROKE_LEGNTH_RAW_FR" 27664 "GD_ID_HC_STROKE_LEGNTH_RAW_RL" 27665 "GD_ID_HC_STROKE_LEGNTH_RAW_RR" 27666 "GD_ID_HC_OKAY_TO_TRANSITION" 27667 "GD_ID_HC_CYLINDER_PWM_EXTEND_FL" 27668 "GD_ID_HC_CYLINDER_PWM_EXTEND_FR" 27669 "GD_ID_HC_CYLINDER_PWM_EXTEND_RL" 27670 "GD_ID_HC_CYLINDER_PWM_EXTEND_RR" 27671 "GD_ID_HC_CYLINDER_PWM_RETRCT_FL" 27672 "GD_ID_HC_CYLINDER_PWM_RETRCT_FR" 27673 "GD_ID_HC_CYLINDER_PWM_RETRCT_RL" 27674 "GD_ID_HC_CYLINDER_PWM_RETRCT_RR" 27675 "GD_ID_HC_LADDER_EXTEND_Status" 27675 "GD_ID_HC_LADDER_EXTEND" 27676 "GD_ID_HC_REQUEST_CCO_OFF_Status" 27676 "GD_ID_HC_REQUEST_CCO_OFF" 27677 "GD_ID_HC_USER_WARNINGS" 27682 "GD_ID_HC_MOVEMENT_ERROR_FL" 27679 "GD_ID_HC_MOVEMENT_ERROR_FR" 27680 "GD_ID_HC_MOVEMENT_ERROR_RL" 27681 "GD_ID_HC_MOVEMENT_ERROR_RR" 27678 "GD_ID_HC_MANUAL_OVERRIDE_Status" 27678 "GD_ID_HC_MANUAL_OVERRIDE" 27683 "GD_ID_HC_CAL_STATE_Status" 27683 "GD_ID_HC_CAL_STATE" 27684 "GD_ID_HC_CAL_CMD" 27685 "GD_ID_HC_SENSOR_RAW_FL" 27686 "GD_ID_HC_SENSOR_RAW_FR" 27687 "GD_ID_HC_SENSOR_RAW_RL" 27688 "GD_ID_HC_SENSOR_RAW_RR" 27689 "GD_ID_HC_COIL_RAW_EXTEND_FL" 27690 "GD_ID_HC_COIL_RAW_RETRCT_FL" 27691 "GD_ID_HC_COIL_RAW_EXTEND_FR" 27692 "GD_ID_HC_COIL_RAW_RETRCT_FR" 27693 "GD_ID_HC_COIL_RAW_EXTEND_RL" 27694 "GD_ID_HC_COIL_RAW_RETRCT_RL" 27695 "GD_ID_HC_COIL_RAW_EXTEND_RR" 27696 "GD_ID_HC_COIL_RAW_RETRCT_RR" 27697 "GD_ID_HC_STROKE_LEGNTH_FILTER_FL_Status" 27697 "GD_ID_HC_STROKE_LEGNTH_FILTER_FL" 27698 "GD_ID_HC_STROKE_LEGNTH_FILTER_FR_Status" 27698 "GD_ID_HC_STROKE_LEGNTH_FILTER_FR" 27699 "GD_ID_HC_STROKE_LEGNTH_FILTER_RL_Status" 27699 "GD_ID_HC_STROKE_LEGNTH_FILTER_RL" 27700 "GD_ID_HC_STROKE_LEGNTH_FILTER_RR_Status" 27700 "GD_ID_HC_STROKE_LEGNTH_FILTER_RR" 28142 "GD_ID_HC_ErrorManagement_Status" 28142 "GD_ID_HC_ErrorManagement" 28159 "GD_ID_HC_LifeMessage" 32480 "GD_ID_ACM_BT_SERVER_ADDR_ROUTER_Status" 32480 "GD_ID_ACM_BT_SERVER_ADDR_ROUTER" 32750 "GD_ID_ACM_ErrorManagement_Status" 32750 "GD_ID_ACM_ErrorManagement" 32767 "GD_ID_ACM_LifeMessage"  ;

SG_MUL_VAL_ 1565 GD_ID_TELEMETRY_GSM_GPRS_ECN0_R DataIndex 6750-6750;
SG_MUL_VAL_ 1565 GD_ID_TELEMETRY_GSM_GPRS_BER_R DataIndex 6751-6751;
SG_MUL_VAL_ 1565 GD_ID_TELEMETRY_GSM_GPRS_LAC_R DataIndex 6752-6752;
SG_MUL_VAL_ 1565 GD_ID_TELEMETRY_GSM_GPRS_CELLID_HIGH_R DataIndex 6753-6753;
SG_MUL_VAL_ 1565 GD_ID_TELEMETRY_GSM_GPRS_CELLID_LOW_R DataIndex 6754-6754;
SG_MUL_VAL_ 1565 GD_ID_TELEMETRY_GSM_GPRS_QUALITY_RSCP_R DataIndex 6755-6755;
SG_MUL_VAL_ 1565 GD_ID_TELEMETRY_OWN_BT_CHANNEL_R DataIndex 6756-6756;
SG_MUL_VAL_ 1565 GD_ID_TELEMETRY_GSM_GPRS_SIGNAL_QUALITY_R DataIndex 6757-6757;
SG_MUL_VAL_ 1565 GD_ID_TELEMETRY_VARIODOC_STATE_R DataIndex 6758-6758;
SG_MUL_VAL_ 1565 GD_ID_TELEMETRY_VARIODOC_CONFIG_IS_VALID_RW DataIndex 6759-6759;
SG_MUL_VAL_ 1565 GD_ID_TELEMETRY_VARIODOC_SERVER_PORT_RW DataIndex 6760-6760;
SG_MUL_VAL_ 1565 GD_ID_TELEMETRY_LAPTOP_BT_CHANNEL_RW DataIndex 6761-6761;
SG_MUL_VAL_ 1565 GD_ID_TELEMETRY_RADIO_TYPE_RW DataIndex 6762-6762;
SG_MUL_VAL_ 1565 GD_ID_TELEMETRY_GSM_GPRS_MCC_R DataIndex 6763-6763;
SG_MUL_VAL_ 1565 GD_ID_TELEMETRY_GSM_GPRS_MNC_R DataIndex 6764-6764;
SG_MUL_VAL_ 1565 GD_ID_TELEMETRY_GSM_GPRS_ALLOWED_ROAMING_RW_Status DataIndex 6765-6765;
SG_MUL_VAL_ 1565 GD_ID_TELEMETRY_GSM_GPRS_ALLOWED_ROAMING_RW DataIndex 6765-6765;
SG_MUL_VAL_ 1565 GD_ID_TELEMETRY_GSM_GPRS_MODE_R DataIndex 6766-6766;
SG_MUL_VAL_ 1565 GD_ID_TELEMETRY_GSM_STATUS_R DataIndex 6767-6767;
SG_MUL_VAL_ 1565 GD_ID_TELEMETRY_GSM_CONFIG_IS_VALID_R DataIndex 6768-6768;
SG_MUL_VAL_ 1565 GD_ID_TELEMETRY_GSM_GPRS_REDIAL_R DataIndex 6769-6769;
SG_MUL_VAL_ 1565 GD_ID_TELEMETRY_GSM_GPRS_INTERN_EXTERN_ANTENNA_R DataIndex 6770-6770;
SG_MUL_VAL_ 1565 GD_ID_TELEMETRY_GSM_GPRS_ROAMING_STATUS_R DataIndex 6771-6771;
SG_MUL_VAL_ 1565 GD_ID_TELEMETRY_USED_NETWORK_PROVIDER_BLKR DataIndex 6772-6772;
SG_MUL_VAL_ 1565 GD_ID_TELEMETRY_PACKETDATATYPE_R DataIndex 6773-6773;
SG_MUL_VAL_ 1565 GD_ID_TELEMETRY_SIGNALQUALITY_R DataIndex 6774-6774;
SG_MUL_VAL_ 1565 GD_ID_TELEMETRY_GPRS_STATE_R DataIndex 6775-6775;
SG_MUL_VAL_ 1565 GD_ID_TELEMETRY_GPRS_CONFIG_IS_VALID_RW DataIndex 6776-6776;
SG_MUL_VAL_ 1565 GD_ID_TELEMETRY_CELLULAR_MODEM_TYPE_R DataIndex 6777-6777;
SG_MUL_VAL_ 1565 GD_ID_TELEMETRY_CDMA2000_IMEI_BLKR DataIndex 6778-6778;
SG_MUL_VAL_ 1565 GD_ID_TELEMETRY_CDMA2000_ESN_BLKR DataIndex 6779-6779;
SG_MUL_VAL_ 1565 GD_ID_TELEMETRY_CDMA2000_MSL_BLKRW DataIndex 6780-6780;
SG_MUL_VAL_ 1565 GD_ID_TELEMETRY_CDMA2000_MDN_BLKRW DataIndex 6781-6781;
SG_MUL_VAL_ 1565 GD_ID_TELEMETRY_CDMA2000_MSID_BLKRW DataIndex 6782-6782;
SG_MUL_VAL_ 1565 GD_ID_TELEMETRY_STATUS_PIN_PUK_R DataIndex 6786-6786;
SG_MUL_VAL_ 1565 GD_ID_TELEMETRY_STATUS_DIAL_INTERNET_R DataIndex 6787-6787;
SG_MUL_VAL_ 1565 GD_ID_TELEMETRY_DATA_RATE_DOWN_R DataIndex 6806-6806;
SG_MUL_VAL_ 1565 GD_ID_TELEMETRY_DATA_RATE_UP_R DataIndex 6807-6807;
SG_MUL_VAL_ 1565 GD_ID_TELEMETRY_DEBUG_RW DataIndex 6808-6808;
SG_MUL_VAL_ 1565 GD_ID_TELEMETRY_EMAIL_COMMAND_R DataIndex 6816-6816;
SG_MUL_VAL_ 1565 GD_ID_TELEMETRY_EMAIL_STATUS_R DataIndex 6817-6817;
SG_MUL_VAL_ 1565 GD_ID_TELEMETRY_OWN_BT_ADDRESS_BLKR DataIndex 6856-6856;
SG_MUL_VAL_ 1565 GD_ID_TELEMETRY_GSM_GPRS_PIN_BLKRW DataIndex 6857-6857;
SG_MUL_VAL_ 1565 GD_ID_TELEMETRY_GSM_GPRS_PUK_BLKW DataIndex 6858-6858;
SG_MUL_VAL_ 1565 GD_ID_TELEMETRY_GPRS_PROVIDER_BLKRW DataIndex 6859-6859;
SG_MUL_VAL_ 1565 GD_ID_TELEMETRY_GPRS_DIAL_BLKRW DataIndex 6860-6860;
SG_MUL_VAL_ 1565 GD_ID_TELEMETRY_GPRS_USER_BLKRW DataIndex 6861-6861;
SG_MUL_VAL_ 1565 GD_ID_TELEMETRY_GPRS_PASSWORD_BLKRW DataIndex 6862-6862;
SG_MUL_VAL_ 1565 GD_ID_TELEMETRY_VARIODOC_SERVER_URL_BLKRW DataIndex 6863-6863;
SG_MUL_VAL_ 1565 GD_ID_TELEMETRY_LAPTOP_BT_ADDRESS_BLKRW DataIndex 6864-6864;
SG_MUL_VAL_ 1565 GD_ID_TELEMETRY_GSM_DIAL_BLKRW DataIndex 6867-6867;
SG_MUL_VAL_ 1565 GD_ID_TELEMETRY_EMAIL_ADDRESS_BLKRW DataIndex 6880-6880;
SG_MUL_VAL_ 1565 GD_ID_TELEMETRY_EMAIL_TEXT_BLKRW DataIndex 6881-6881;
SG_MUL_VAL_ 1565 GD_ID_TELEMETRY_VIN_INTERNAL_BLKRW DataIndex 6882-6882;
SG_MUL_VAL_ 1565 GD_ID_TELEMETRY_ERROR_ACKNOWLEDGE_W_Status DataIndex 7150-7150;
SG_MUL_VAL_ 1565 GD_ID_TELEMETRY_ERROR_ACKNOWLEDGE_W DataIndex 7150-7150;
SG_MUL_VAL_ 1565 GD_ID_TELEMETRY_LifeMessage DataIndex 7167-7167;
SG_MUL_VAL_ 1565 SendInfoTcrr ServiceType 415-415;
SG_MUL_VAL_ 1565 PlausibilityCheck ServiceType 509-509, 359-359, 390-390, 422-422, 423-423, 394-394, 427-427, 404-404, 375-375, 406-406, 414-414;
SG_MUL_VAL_ 1565 LowerHysteresis ServiceType 405-405, 407-407;
SG_MUL_VAL_ 1565 DataIndex ServiceType 509-509, 359-359, 390-390, 422-422, 423-423, 394-394, 427-427, 404-404, 375-375, 406-406, 414-414;
SG_MUL_VAL_ 1565 ErrorId ServiceType 509-509, 359-359, 390-390, 422-422, 423-423, 394-394, 427-427, 404-404, 375-375, 406-406, 414-414;
SG_MUL_VAL_ 1565 CanError ServiceType 509-509, 359-359, 390-390, 422-422, 423-423, 394-394, 427-427, 404-404, 375-375, 406-406, 414-414;
SG_MUL_VAL_ 1565 CalErrorState ServiceType 509-509, 359-359, 390-390, 422-422, 423-423, 394-394, 427-427, 404-404, 375-375, 406-406, 414-414;
SG_MUL_VAL_ 1565 BlockSize ServiceType 399-399;
SG_MUL_VAL_ 1565 RequestType ServiceType 399-399;
SG_MUL_VAL_ 1565 DataByte1 ServiceType 430-430, 431-431;
SG_MUL_VAL_ 1565 DataByte2 ServiceType 430-430, 431-431;
SG_MUL_VAL_ 1565 DataByte3 ServiceType 430-430, 431-431;
SG_MUL_VAL_ 1565 DataByte4 ServiceType 430-430, 431-431;
SG_MUL_VAL_ 1565 CRC_ChecksumOrBlockSizeError ServiceType 398-398;
SG_MUL_VAL_ 1565 ControlType ServiceType 398-398;
SG_MUL_VAL_ 1565 ControlOrErrorCode ServiceType 398-398;

SG_MUL_VAL_ 1565 GD_ID_CEAG_FIELD_HEADLAND_WIDTH_RW DataIndex 16384-16384;
SG_MUL_VAL_ 1565 GD_ID_CEAG_FIELD_HEADLAND_DISTANCE_RW DataIndex 16385-16385;
SG_MUL_VAL_ 1565 GD_ID_CEAG_IMPLEMENT_PATHTOPATHDISTANCE_RW DataIndex 16400-16400;
SG_MUL_VAL_ 1565 GD_ID_CEAG_IMPLEMENT_LINKAGETYPE_RW DataIndex 16402-16402;
SG_MUL_VAL_ 1565 GD_ID_CEAG_IMPLEMENT_LINKAGEFRONT_RW DataIndex 16403-16403;
SG_MUL_VAL_ 1565 GD_ID_CEAG_IMPLEMENT_LINKAGEREAR_RW DataIndex 16404-16404;
SG_MUL_VAL_ 1565 GD_ID_CEAG_IMPLEMENT_MINIMUMRADIUS_RW DataIndex 16405-16405;
SG_MUL_VAL_ 1565 GD_ID_CEAG_IMPLEMENT_OFFSET_SETOFFSET_RW DataIndex 16406-16406;
SG_MUL_VAL_ 1565 GD_ID_CEAG_IMPLEMENT_OFFSET_SETWORKINGWIDTH_RW DataIndex 16407-16407;
SG_MUL_VAL_ 1565 GD_ID_CEAG_IMPLEMENT_OFFSET_STATUS_RW DataIndex 16408-16408;
SG_MUL_VAL_ 1565 GD_ID_CEAG_COMMUNICATION_COMMAND_W DataIndex 16416-16416;
SG_MUL_VAL_ 1565 GD_ID_CEAG_COMMUNICATION_COMMAND_STATUS_R DataIndex 16417-16417;
SG_MUL_VAL_ 1565 GD_ID_CEAG_PATH_DATA_BLKRW DataIndex 16432-16432;
SG_MUL_VAL_ 1565 GD_ID_CEAG_PATH_AB_ANGLE_RW DataIndex 16435-16435;
SG_MUL_VAL_ 1565 GD_ID_CEAG_PATH_AB_DISTANCE_R DataIndex 16436-16436;
SG_MUL_VAL_ 1565 GD_ID_CEAG_PATH_PIVOT_CENTERPOINT_ACCURACY_R DataIndex 16439-16439;
SG_MUL_VAL_ 1565 GD_ID_CEAG_PATH_SEGMENT_ACTUAL_R DataIndex 16441-16441;
SG_MUL_VAL_ 1565 GD_ID_CEAG_PATH_NUMBER_ACTUAL_R DataIndex 16442-16442;
SG_MUL_VAL_ 1565 GD_ID_CEAG_PATH_LP_SLOPE_RW_Status DataIndex 16443-16443;
SG_MUL_VAL_ 1565 GD_ID_CEAG_PATH_LP_SLOPE_RW DataIndex 16443-16443;
SG_MUL_VAL_ 1565 GD_ID_CEAG_PATH_DATA_ACKNOWLEDGE_R_Status DataIndex 16444-16444;
SG_MUL_VAL_ 1565 GD_ID_CEAG_PATH_DATA_ACKNOWLEDGE_R DataIndex 16444-16444;
SG_MUL_VAL_ 1565 GD_ID_CEAG_NUDGEOFFSET_MANUAL_RW DataIndex 16448-16448;
SG_MUL_VAL_ 1565 GD_ID_CEAG_NUDGEOFFSET_TOTAL_R_Status DataIndex 16449-16449;
SG_MUL_VAL_ 1565 GD_ID_CEAG_NUDGEOFFSET_TOTAL_R DataIndex 16449-16449;
SG_MUL_VAL_ 1565 GD_ID_CEAG_OFFSET_NORTH DataIndex 16450-16450;
SG_MUL_VAL_ 1565 GD_ID_CEAG_OFFSET_EAST DataIndex 16451-16451;
SG_MUL_VAL_ 1565 GD_ID_CEAG_AUTOTURN_SETTINGS_RW DataIndex 16464-16464;
SG_MUL_VAL_ 1565 GD_ID_CEAG_AUTOTURN_DIMENSIONS_R DataIndex 16465-16465;
SG_MUL_VAL_ 1565 GD_ID_CEAG_AUTOTURN_STATUS_R DataIndex 16466-16466;
SG_MUL_VAL_ 1565 GD_ID_CEAG_STATUSPAGE_POSITION_GNSS_R_Status DataIndex 16471-16471;
SG_MUL_VAL_ 1565 GD_ID_CEAG_STATUSPAGE_POSITION_GNSS_R DataIndex 16471-16471;
SG_MUL_VAL_ 1565 GD_ID_CEAG_STATUSPAGE_CORRECTION_R_Status DataIndex 16472-16472;
SG_MUL_VAL_ 1565 GD_ID_CEAG_STATUSPAGE_CORRECTION_R DataIndex 16472-16472;
SG_MUL_VAL_ 1565 GD_ID_CEAG_STATUSPAGE_INERTIAL_R_Status DataIndex 16473-16473;
SG_MUL_VAL_ 1565 GD_ID_CEAG_STATUSPAGE_INERTIAL_R DataIndex 16473-16473;
SG_MUL_VAL_ 1565 GD_ID_CEAG_STATUSPAGE_STEERING_SUBSYSTEM_R_Status DataIndex 16474-16474;
SG_MUL_VAL_ 1565 GD_ID_CEAG_STATUSPAGE_STEERING_SUBSYSTEM_R DataIndex 16474-16474;
SG_MUL_VAL_ 1565 GD_ID_CEAG_STATUSPAGE_XTRK_R_Status DataIndex 16475-16475;
SG_MUL_VAL_ 1565 GD_ID_CEAG_STATUSPAGE_XTRK_R DataIndex 16475-16475;
SG_MUL_VAL_ 1565 GD_ID_CEAG_STATUSPAGE_HEADINGTOWAYLINE_R_Status DataIndex 16476-16476;
SG_MUL_VAL_ 1565 GD_ID_CEAG_STATUSPAGE_HEADINGTOWAYLINE_R DataIndex 16476-16476;
SG_MUL_VAL_ 1565 GD_ID_CEAG_STATUSPAGE_VELOCITY_R_Status DataIndex 16477-16477;
SG_MUL_VAL_ 1565 GD_ID_CEAG_STATUSPAGE_VELOCITY_R DataIndex 16477-16477;
SG_MUL_VAL_ 1565 GD_ID_CEAG_STATUSPAGE_CALIBRATION_R_Status DataIndex 16478-16478;
SG_MUL_VAL_ 1565 GD_ID_CEAG_STATUSPAGE_CALIBRATION_R DataIndex 16478-16478;
SG_MUL_VAL_ 1565 GD_ID_CEAG_STATUSPAGE_SYSTEM_R_Status DataIndex 16479-16479;
SG_MUL_VAL_ 1565 GD_ID_CEAG_STATUSPAGE_SYSTEM_R DataIndex 16479-16479;
SG_MUL_VAL_ 1565 GD_ID_CEAG_STATUS_XTRK_R_Status DataIndex 16480-16480;
SG_MUL_VAL_ 1565 GD_ID_CEAG_STATUS_XTRK_R DataIndex 16480-16480;
SG_MUL_VAL_ 1565 GD_ID_CEAG_STATUS_HEADING_R DataIndex 16481-16481;
SG_MUL_VAL_ 1565 GD_ID_CEAG_STATUS_STEERING_R DataIndex 16482-16482;
SG_MUL_VAL_ 1565 GD_ID_CEAG_STEERING_SENSITIVITY_LINEACQUISITION_RW DataIndex 16483-16483;
SG_MUL_VAL_ 1565 GD_ID_CEAG_STEERING_SENSITIVITY_ONLINE_RW DataIndex 16484-16484;
SG_MUL_VAL_ 1565 GD_ID_CEAG_SYSTEM_STANDBYTIME_RW DataIndex 16485-16485;
SG_MUL_VAL_ 1565 GD_ID_CEAG_SYSTEM_POWERSUPPLY_INPUT_R DataIndex 16486-16486;
SG_MUL_VAL_ 1565 GD_ID_CEAG_SYSTEM_POWERSUPPLY_OUTPUT_R DataIndex 16487-16487;
SG_MUL_VAL_ 1565 GD_ID_CEAG_SYSTEM_ALTITUDE_GEOIDAL_SEPARATION_R DataIndex 16488-16488;
SG_MUL_VAL_ 1565 GD_ID_CEAG_STEERING_DISENGAGE_REASON_R DataIndex 16489-16489;
SG_MUL_VAL_ 1565 GD_ID_CEAG_GNSS_GPS_SATVISIBLE_R DataIndex 16496-16496;
SG_MUL_VAL_ 1565 GD_ID_CEAG_GNSS_GPS_SATUSED_R DataIndex 16497-16497;
SG_MUL_VAL_ 1565 GD_ID_CEAG_GNSS_GLONASS_SATVISIBLE_R DataIndex 16498-16498;
SG_MUL_VAL_ 1565 GD_ID_CEAG_GNSS_GLONASS_SATUSED_R DataIndex 16499-16499;
SG_MUL_VAL_ 1565 GD_ID_CEAG_GNSS_GALILEO_SATVISIBLE_R DataIndex 16500-16500;
SG_MUL_VAL_ 1565 GD_ID_CEAG_GNSS_GALILEO_SATUSED_R DataIndex 16501-16501;
SG_MUL_VAL_ 1565 GD_ID_CEAG_GNSS_VALIDPOSITION_R_Status DataIndex 16503-16503;
SG_MUL_VAL_ 1565 GD_ID_CEAG_GNSS_VALIDPOSITION_R DataIndex 16503-16503;
SG_MUL_VAL_ 1565 GD_ID_CEAG_GNSS_POSITION_ACTUAL_BLKR DataIndex 16504-16504;
SG_MUL_VAL_ 1565 GD_ID_CEAG_GNSS_DOP_R DataIndex 16505-16505;
SG_MUL_VAL_ 1565 GD_ID_CEAG_GNSS_TIME_HOURMINUTE_R DataIndex 16506-16506;
SG_MUL_VAL_ 1565 GD_ID_CEAG_GNSS_TIME_SECOND_R DataIndex 16507-16507;
SG_MUL_VAL_ 1565 GD_ID_CEAG_GNSS_ANTENNA_INSTALLATION_RW_Status DataIndex 16508-16508;
SG_MUL_VAL_ 1565 GD_ID_CEAG_GNSS_ANTENNA_INSTALLATION_RW DataIndex 16508-16508;
SG_MUL_VAL_ 1565 GD_ID_CEAG_GNSS_VELOCITY_R DataIndex 16509-16509;
SG_MUL_VAL_ 1565 GD_ID_CEAG_GNSS_DISTANCE_R DataIndex 16510-16510;
SG_MUL_VAL_ 1565 GD_ID_CEAG_CORRECTIONSIGNAL_RTKNETWORK_ROAMING_RW_Status DataIndex 16519-16519;
SG_MUL_VAL_ 1565 GD_ID_CEAG_CORRECTIONSIGNAL_RTKNETWORK_ROAMING_RW DataIndex 16519-16519;
SG_MUL_VAL_ 1565 GD_ID_CEAG_CORRECTIONSIGNAL_RTK_DUHF2_CHANNELSPACING_RW DataIndex 16520-16520;
SG_MUL_VAL_ 1565 GD_ID_CEAG_CORRECTIONSIGNAL_RTK_DUHF2_PROTOCOL_RW DataIndex 16521-16521;
SG_MUL_VAL_ 1565 GD_ID_CEAG_CORRECTIONSIGNAL_RTK_DUHF2_ERRORCORRECTION_RW DataIndex 16522-16522;
SG_MUL_VAL_ 1565 GD_ID_CEAG_CORRECTIONSIGNAL_RTK_FH915_CHANNEL_RW DataIndex 16523-16523;
SG_MUL_VAL_ 1565 GD_ID_CEAG_CORRECTIONSIGNAL_RTK_FH915_LOCATION_RW DataIndex 16524-16524;
SG_MUL_VAL_ 1565 GD_ID_CEAG_CORRECTIONSIGNAL_RTK_FH915_NETWORKID_RW DataIndex 16525-16525;
SG_MUL_VAL_ 1565 GD_ID_CEAG_CORRECTIONSIGNAL_OMNISTAR_FREQUENCY_HIGH_RW DataIndex 16526-16526;
SG_MUL_VAL_ 1565 GD_ID_CEAG_CORRECTIONSIGNAL_OMNISTAR_FREQUENCY_LOW_RW DataIndex 16527-16527;
SG_MUL_VAL_ 1565 GD_ID_CEAG_CORRECTIONSIGNAL_TYPE_SELECTED_RW DataIndex 16528-16528;
SG_MUL_VAL_ 1565 GD_ID_CEAG_CORRECTIONSIGNAL_OMNISTAR_BAUDRATE_RW DataIndex 16529-16529;
SG_MUL_VAL_ 1565 GD_ID_CEAG_CORRECTIONSIGNAL_VBS_EXPIRYDATE_DAYMONTH_R DataIndex 16530-16530;
SG_MUL_VAL_ 1565 GD_ID_CEAG_CORRECTIONSIGNAL_BARGRAPH_R DataIndex 16531-16531;
SG_MUL_VAL_ 1565 GD_ID_CEAG_CORRECTIONSIGNAL_VBS_EXPIRYDATE_YEAR_R DataIndex 16532-16532;
SG_MUL_VAL_ 1565 GD_ID_CEAG_CORRECTIONSIGNAL_HP_XP_EXPIRYDATE_DAYMONTH_R DataIndex 16533-16533;
SG_MUL_VAL_ 1565 GD_ID_CEAG_CORRECTIONSIGNAL_HP_XP_EXPIRYDATE_YEAR_R DataIndex 16535-16535;
SG_MUL_VAL_ 1565 GD_ID_CEAG_CORRECTIONSIGNAL_STATUS_R_Status DataIndex 16536-16536;
SG_MUL_VAL_ 1565 GD_ID_CEAG_CORRECTIONSIGNAL_STATUS_R DataIndex 16536-16536;
SG_MUL_VAL_ 1565 GD_ID_CEAG_CORRECTIONSIGNAL_OMNISTAR_SERIALNUMBER_HIGH_R DataIndex 16537-16537;
SG_MUL_VAL_ 1565 GD_ID_CEAG_CORRECTIONSIGNAL_OMNISTAR_SERIALNUMBER_LOW_R DataIndex 16538-16538;
SG_MUL_VAL_ 1565 GD_ID_CEAG_CORRECTIONSIGNAL_RTK_AGCO_CHANNEL_RW DataIndex 16539-16539;
SG_MUL_VAL_ 1565 GD_ID_CEAG_CORRECTIONSIGNAL_RTK_AGCO_FREQUENCY_HIGH_R DataIndex 16540-16540;
SG_MUL_VAL_ 1565 GD_ID_CEAG_CORRECTIONSIGNAL_RTK_AGCO_FREQUENCY_LOW_R DataIndex 16541-16541;
SG_MUL_VAL_ 1565 GD_ID_CEAG_CORRECTIONSIGNAL_RTK_AGCO_RADIOTYPE_R DataIndex 16542-16542;
SG_MUL_VAL_ 1565 GD_ID_CEAG_CORRECTIONSIGNAL_RTK_EXTERNAL_SERIALINTERFACE_RW DataIndex 16543-16543;
SG_MUL_VAL_ 1565 GD_ID_CEAG_CORRECTIONSIGNAL_RTK_RADIOINSTALLATION_RW_Status DataIndex 16544-16544;
SG_MUL_VAL_ 1565 GD_ID_CEAG_CORRECTIONSIGNAL_RTK_RADIOINSTALLATION_RW DataIndex 16544-16544;
SG_MUL_VAL_ 1565 GD_ID_CEAG_CORRECTIONSIGNAL_RTK_AGCO_CORRECTIONFORMAT_RW DataIndex 16545-16545;
SG_MUL_VAL_ 1565 GD_ID_CEAG_CORRECTIONSIGNAL_RTK_EXTERNAL_CORRECTIONFORMAT_RW DataIndex 16546-16546;
SG_MUL_VAL_ 1565 GD_ID_CEAG_CORRECTIONSIGNAL_RTK_GPS_SATVISIBLE_R DataIndex 16547-16547;
SG_MUL_VAL_ 1565 GD_ID_CEAG_CORRECTIONSIGNAL_RTK_GPS_SATUSED_R DataIndex 16548-16548;
SG_MUL_VAL_ 1565 GD_ID_CEAG_CORRECTIONSIGNAL_RTK_GLONASS_SATVISIBLE_R DataIndex 16549-16549;
SG_MUL_VAL_ 1565 GD_ID_CEAG_CORRECTIONSIGNAL_RTK_GLONASS_SATUSED_R DataIndex 16550-16550;
SG_MUL_VAL_ 1565 GD_ID_CEAG_CORRECTIONSIGNAL_RTK_GALILEO_SATVISIBLE_R DataIndex 16551-16551;
SG_MUL_VAL_ 1565 GD_ID_CEAG_CORRECTIONSIGNAL_RTK_GALILEO_SATUSED_R DataIndex 16552-16552;
SG_MUL_VAL_ 1565 GD_ID_CEAG_CORRECTIONSIGNAL_RTK_RADIO_CONFIGURABLE_R DataIndex 16553-16553;
SG_MUL_VAL_ 1565 GD_ID_CEAG_CORRECTIONSIGNAL_RTK_BASELINE_R DataIndex 16554-16554;
SG_MUL_VAL_ 1565 GD_ID_CEAG_CORRECTIONSIGNAL_SIGNALLAG_R DataIndex 16555-16555;
SG_MUL_VAL_ 1565 GD_ID_CEAG_CORRECTIONSIGNAL_FALLBACK_RW_Status DataIndex 16556-16556;
SG_MUL_VAL_ 1565 GD_ID_CEAG_CORRECTIONSIGNAL_FALLBACK_RW DataIndex 16556-16556;
SG_MUL_VAL_ 1565 GD_ID_CEAG_CORRECTIONSIGNAL_ACCURACY_GNSSANTENNA_R DataIndex 16557-16557;
SG_MUL_VAL_ 1565 GD_ID_CEAG_CORRECTIONSIGNAL_ACCURACY_VEHICLEREFERENCEPOINT_R DataIndex 16558-16558;
SG_MUL_VAL_ 1565 GD_ID_CEAG_CORRECTIONSIGNAL_AUTHORISATIONLEVEL_R DataIndex 16559-16559;
SG_MUL_VAL_ 1565 GD_ID_CEAG_CORRECTIONSIGNAL_RTKNETWORK_GSM_NUMBER_BLKRW DataIndex 16560-16560;
SG_MUL_VAL_ 1565 GD_ID_CEAG_CORRECTIONSIGNAL_RTKNETWORK_GSM_PIN_BLKRW DataIndex 16561-16561;
SG_MUL_VAL_ 1565 GD_ID_CEAG_CORRECTIONSIGNAL_RTKNETWORK_CORRECTIONFORMAT_RW_Status DataIndex 16562-16562;
SG_MUL_VAL_ 1565 GD_ID_CEAG_CORRECTIONSIGNAL_RTKNETWORK_CORRECTIONFORMAT_RW DataIndex 16562-16562;
SG_MUL_VAL_ 1565 GD_ID_CEAG_CORRECTIONSIGNAL_RTKNETWORK_GPRS_ACCESSPOINT_BLKRW DataIndex 16563-16563;
SG_MUL_VAL_ 1565 GD_ID_CEAG_CORRECTIONSIGNAL_RTKNETWORK_GPRS_IPADDRESS_BLKRW DataIndex 16564-16564;
SG_MUL_VAL_ 1565 GD_ID_CEAG_CORRECTIONSIGNAL_RTKNETWORK_GPRS_PORT_BLKRW DataIndex 16565-16565;
SG_MUL_VAL_ 1565 GD_ID_CEAG_CORRECTIONSIGNAL_RTKNETWORK_GPRS_MOUNTPOINT_BLKRW DataIndex 16566-16566;
SG_MUL_VAL_ 1565 GD_ID_CEAG_CORRECTIONSIGNAL_RTKNETWORK_GPRS_USERNAME_CONNECTIONPOVIDER_BLKRW DataIndex 16567-16567;
SG_MUL_VAL_ 1565 GD_ID_CEAG_CORRECTIONSIGNAL_RTKNETWORK_GPRS_PASSWORD_CONNECTIONPROVIDER_BLKRW DataIndex 16568-16568;
SG_MUL_VAL_ 1565 GD_ID_CEAG_CORRECTIONSIGNAL_RTKNETWORK_NMEA_DATA_RW DataIndex 16569-16569;
SG_MUL_VAL_ 1565 GD_ID_CEAG_CORRECTIONSIGNAL_TYPE_ACTUAL_R DataIndex 16570-16570;
SG_MUL_VAL_ 1565 GD_ID_CEAG_CORRECTIONSIGNAL_RTKNETWORK_GPRS_USERNAME_SIGNALPROVIDER_BLKRW DataIndex 16571-16571;
SG_MUL_VAL_ 1565 GD_ID_CEAG_CORRECTIONSIGNAL_RTKNETWORK_GPRS_PASSWORD_SIGNALPROVIDER_BLKRW DataIndex 16572-16572;
SG_MUL_VAL_ 1565 GD_ID_CEAG_CORRECTIONSIGNAL_RTKNETWORK_GSM_GPRS_CONNECTION_RW_Status DataIndex 16573-16573;
SG_MUL_VAL_ 1565 GD_ID_CEAG_CORRECTIONSIGNAL_RTKNETWORK_GSM_GPRS_CONNECTION_RW DataIndex 16573-16573;
SG_MUL_VAL_ 1565 GD_ID_CEAG_CORRECTIONSIGNAL_RTKNETWORK_GPRS_PIN_BLKRW DataIndex 16574-16574;
SG_MUL_VAL_ 1565 GD_ID_CEAG_CORRECTIONSIGNAL_RTKNETWORK_MODE_RW_Status DataIndex 16575-16575;
SG_MUL_VAL_ 1565 GD_ID_CEAG_CORRECTIONSIGNAL_RTKNETWORK_MODE_RW DataIndex 16575-16575;
SG_MUL_VAL_ 1565 GD_ID_CEAG_NMEA_SERIALINTERFACE_RW DataIndex 16576-16576;
SG_MUL_VAL_ 1565 GD_ID_CEAG_NMEA_DATA_1_RW DataIndex 16579-16579;
SG_MUL_VAL_ 1565 GD_ID_CEAG_NMEA_DATA_2_RW DataIndex 16580-16580;
SG_MUL_VAL_ 1565 GD_ID_CEAG_NMEA_DATA_3_RW DataIndex 16581-16581;
SG_MUL_VAL_ 1565 GD_ID_CEAG_NMEA_DATA_4_RW DataIndex 16582-16582;
SG_MUL_VAL_ 1565 GD_ID_CEAG_NMEA_DATA_5_RW DataIndex 16583-16583;
SG_MUL_VAL_ 1565 GD_ID_CEAG_NMEA_OUTPUT_RW DataIndex 16584-16584;
SG_MUL_VAL_ 1565 GD_ID_CEAG_SENSOR_IMU_ROLL_R_Status DataIndex 16606-16606;
SG_MUL_VAL_ 1565 GD_ID_CEAG_SENSOR_IMU_ROLL_R DataIndex 16606-16606;
SG_MUL_VAL_ 1565 GD_ID_CEAG_SENSOR_IMU_PITCH_R_Status DataIndex 16607-16607;
SG_MUL_VAL_ 1565 GD_ID_CEAG_SENSOR_IMU_PITCH_R DataIndex 16607-16607;
SG_MUL_VAL_ 1565 GD_ID_CEAG_SENSOR_IMU_YAW_R_Status DataIndex 16608-16608;
SG_MUL_VAL_ 1565 GD_ID_CEAG_SENSOR_IMU_YAW_R DataIndex 16608-16608;
SG_MUL_VAL_ 1565 GD_ID_CEAG_SENSOR_IMU_MOUNTINGBIAS_R_Status DataIndex 16609-16609;
SG_MUL_VAL_ 1565 GD_ID_CEAG_SENSOR_IMU_MOUNTINGBIAS_R DataIndex 16609-16609;
SG_MUL_VAL_ 1565 GD_ID_CEAG_SENSOR_IMU_DHEADING_R DataIndex 16610-16610;
SG_MUL_VAL_ 1565 GD_ID_CEAG_SENSOR_IMU_WARMING_TIME_R_Status DataIndex 16611-16611;
SG_MUL_VAL_ 1565 GD_ID_CEAG_SENSOR_IMU_WARMING_TIME_R DataIndex 16611-16611;
SG_MUL_VAL_ 1565 GD_ID_CEAG_SENSOR_IMU_CALIBRATION_TIME_R_Status DataIndex 16612-16612;
SG_MUL_VAL_ 1565 GD_ID_CEAG_SENSOR_IMU_CALIBRATION_TIME_R DataIndex 16612-16612;
SG_MUL_VAL_ 1565 GD_ID_CEAG_ID_FA_KALIB_IMU_SET_R DataIndex 16613-16613;
SG_MUL_VAL_ 1565 GD_ID_CEAG_ID_FA_KALIB_IMU_GET_W DataIndex 16614-16614;
SG_MUL_VAL_ 1565 GD_ID_CEAG_ID_GNSS_ANTENNA_TYPE_R DataIndex 16639-16639;
SG_MUL_VAL_ 1565 GD_ID_CEAG_ID_GNSS_ANTENNA_MODEL_BLKR DataIndex 16640-16640;
SG_MUL_VAL_ 1565 GD_ID_CEAG_ID_GNSS_ANTENNA_PSN_BLKR DataIndex 16641-16641;
SG_MUL_VAL_ 1565 GD_ID_CEAG_ID_GNSS_ANTENNA_HWVERSION_BLKR DataIndex 16642-16642;
SG_MUL_VAL_ 1565 GD_ID_CEAG_ID_GNSS_ANTENNA_SWVERSION_BLKR DataIndex 16643-16643;
SG_MUL_VAL_ 1565 GD_ID_CEAG_ID_GNSS_ANTENNA_BOOTVERSION_BLKR DataIndex 16644-16644;
SG_MUL_VAL_ 1565 GD_ID_CEAG_ID_GNSS_ANTENNA_COMPILE_DATE_BLKR DataIndex 16645-16645;
SG_MUL_VAL_ 1565 GD_ID_CEAG_ID_GNSS_ANTENNA_AUTHCODE_BLKW DataIndex 16646-16646;
SG_MUL_VAL_ 1565 GD_ID_CEAG_ID_CORRECTIONSIGNAL_NTRIP_DELAY_R DataIndex 16650-16650;
SG_MUL_VAL_ 1565 GD_ID_CEAG_ErrorManagement_Status DataIndex 16878-16878;
SG_MUL_VAL_ 1565 GD_ID_CEAG_ErrorManagement DataIndex 16878-16878;
SG_MUL_VAL_ 1565 GD_ID_CEAG_LifeMessage DataIndex 16895-16895;
