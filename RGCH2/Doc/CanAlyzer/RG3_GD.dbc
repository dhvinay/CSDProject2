VERSION "HIPBNYYYYYYYYYYYYYYYYYYYYYYYYYYYNNNNNNNNNN/4/%%%/4/'%**4NNN///"

NS_ :

BS_:

BU_: ecuDASH ecuCHS ecuNT01 ecuMFA ecuDIAGNOSE ecuVD03 ecuZE ecuHVAC ecuLCP ecuCHS2 ecuACM

BO_ 1557 msgCHS: 8 ecuCHS
 SG_ ServiceType M : 23|9@1+ (1,0) [0|0] "" Vector__XXX
 SG_ DataIndex m359M : 8|15@1+ (1,0) [0|0] "" Vector__XXX
 SG_ GD_ID_SCT_VALVE_POSITION m12353 : 40|16@1- (1,0) [-125|125] "%" Vector__XXX
 SG_ GD_ID_SCT_VALVE_CALIB_COMMAND m12366 : 40|16@1+ (1,0) [0|254] "" Vector__XXX
 SG_ GD_ID_SCT_VALVE_CALIB_STATUS m12367 : 40|16@1+ (1,0) [0|254] "" Vector__XXX
 SG_ GD_ID_SCT_PILOTVALVE_STATUS_Status m12368 : 39|1@1+ (1,0) [0|0] "1/0" Vector__XXX
 SG_ GD_ID_SCT_PILOTVALVE_STATUS m12368 : 40|16@1+ (1,0) [0|3000] "mA" Vector__XXX
 SG_ GD_ID_SCT_OLAY_STEER_FACTOR m12388 : 40|16@1+ (1,0) [0|80] "" Vector__XXX
 SG_ GD_ID_SCT_HEADLAND_CMD_Status m12416 : 39|1@1+ (1,0) [0|0] "1/0" Vector__XXX
 SG_ GD_ID_SCT_HEADLAND_CMD m12416 : 40|16@1+ (1,0) [0|1] "" Vector__XXX
 SG_ GD_ID_SCT_3RDPARTY_READY_STATUS_Status m12417 : 39|1@1+ (1,0) [0|0] "1/0" Vector__XXX
 SG_ GD_ID_SCT_3RDPARTY_READY_STATUS m12417 : 40|16@1+ (1,0) [0|0] "" Vector__XXX
 SG_ GD_ID_SCT_3RDPARTY_POSITION_STATUS_Status m12418 : 39|1@1+ (1,0) [0|0] "1/0" Vector__XXX
 SG_ GD_ID_SCT_3RDPARTY_POSITION_STATUS m12418 : 40|16@1+ (1,0) [0|0] "" Vector__XXX
 SG_ GD_ID_SCT_3RDPARTY_CANCEL_REQUEST_Status m12419 : 39|1@1+ (1,0) [0|0] "1/0" Vector__XXX
 SG_ GD_ID_SCT_3RDPARTY_CANCEL_REQUEST m12419 : 40|16@1+ (1,0) [0|0] "" Vector__XXX
 SG_ GD_ID_SCT_3RDPARTY_COMMAND_GUIDANCE_Status m12420 : 39|1@1+ (1,0) [0|0] "1/0" Vector__XXX
 SG_ GD_ID_SCT_3RDPARTY_COMMAND_GUIDANCE m12420 : 40|16@1+ (1,0) [0|0] "" Vector__XXX
 SG_ GD_ID_SCT_TSD_MIN_SPEED_FORWARD m12544 : 40|16@1+ (0.001,0) [0|65535] "m/sec" Vector__XXX
 SG_ GD_ID_SCT_TSD_MAX_SPEED_FORWARD m12545 : 40|16@1+ (0.001,0) [0|65535] "m/sec" Vector__XXX
 SG_ GD_ID_SCT_TSD_MIN_MACHINE_RADIUS m12546 : 40|16@1+ (1,0) [0|65535] "mm" Vector__XXX
 SG_ GD_ID_SCT_TSD_MAX_ACQUISITION_ANGLE m12547 : 40|16@1+ (1,0) [0|90] "degrees" Vector__XXX
 SG_ GD_ID_SCT_GUIDANCE_CONFIGURATION_DATA_Status m12560 : 39|1@1+ (1,0) [0|0] "1/0" Vector__XXX
 SG_ GD_ID_SCT_GUIDANCE_CONFIGURATION_DATA m12560 : 40|16@1+ (1,0) [0|65535] "" Vector__XXX
 SG_ GD_ID_SCT_STEERING_MODE_Status m12568 : 39|1@1+ (1,0) [0|0] "1/0" Vector__XXX
 SG_ GD_ID_SCT_STEERING_MODE m12568 : 40|16@1+ (1,0) [0|65535] "" Vector__XXX
 SG_ GD_ID_SCT_SECONDARY_WAS_RAW_VALUE_Status m12569 : 39|1@1+ (1,0) [0|0] "1/0" Vector__XXX
 SG_ GD_ID_SCT_SECONDARY_WAS_RAW_VALUE m12569 : 40|16@1+ (1,0) [0|24510] "uA" Vector__XXX
 SG_ GD_ID_SCT_SECONDARY_WAS_SENSOR_ANGLE_Status m12570 : 39|1@1+ (1,0) [0|0] "1/0" Vector__XXX
 SG_ GD_ID_SCT_SECONDARY_WAS_SENSOR_ANGLE m12570 : 40|16@1- (0.01,0) [-90|90] "degrees" Vector__XXX
 SG_ GD_ID_SCT_SECONDARY_WAS_MEDIAN_ANGLE_Status m12571 : 39|1@1+ (1,0) [0|0] "1/0" Vector__XXX
 SG_ GD_ID_SCT_SECONDARY_WAS_MEDIAN_ANGLE m12571 : 40|16@1- (0.01,0) [-90|90] "degrees" Vector__XXX
 SG_ GD_ID_SCT_SECONDARY_WAS_MEDIAN_ANGLE_MAX_Status m12572 : 39|1@1+ (1,0) [0|0] "1/0" Vector__XXX
 SG_ GD_ID_SCT_SECONDARY_WAS_MEDIAN_ANGLE_MAX m12572 : 40|16@1- (0.01,0) [-90|90] "degrees" Vector__XXX
 SG_ GD_ID_SCT_ALS_X_OFFSET_Status m12573 : 39|1@1+ (1,0) [0|0] "1/0" Vector__XXX
 SG_ GD_ID_SCT_ALS_X_OFFSET m12573 : 40|16@1- (1,0) [-10000|10000] "mm" Vector__XXX
 SG_ GD_ID_SCT_ALS_Y_OFFSET_Status m12574 : 39|1@1+ (1,0) [0|0] "1/0" Vector__XXX
 SG_ GD_ID_SCT_ALS_Y_OFFSET m12574 : 40|16@1- (1,0) [-10000|10000] "mm" Vector__XXX
 SG_ GD_ID_SCT_ADDITIONAL_WORKING_HEIGHT m12575 : 40|16@1+ (1,0) [0|1] "" Vector__XXX
 SG_ GD_ID_SCT_VEHICLE_CURRENT_PAYLOAD_Status m12576 : 39|1@1+ (1,0) [0|0] "1/0" Vector__XXX
 SG_ GD_ID_SCT_VEHICLE_CURRENT_PAYLOAD m12576 : 40|16@1+ (1,0) [0|150] "%" Vector__XXX
 SG_ GD_ID_SCT_ISO_STATE m12598 : 40|16@1+ (1,0) [0|1] "" Vector__XXX
 SG_ GD_ID_SCT_VEHICLE_SPEED_Status m12599 : 39|1@1+ (1,0) [0|0] "1/0" Vector__XXX
 SG_ GD_ID_SCT_VEHICLE_SPEED m12599 : 40|16@1+ (0.01,0) [0|65535] "km/h" Vector__XXX
 SG_ GD_ID_SCT_VEHICLE_MOVEMENT_Status m12600 : 39|1@1+ (1,0) [0|0] "1/0" Vector__XXX
 SG_ GD_ID_SCT_VEHICLE_MOVEMENT m12600 : 40|16@1+ (1,0) [0|10000] "mm" Vector__XXX
 SG_ GD_ID_SCT_PARKING_BRAKE_Status m12601 : 39|1@1+ (1,0) [0|0] "1/0" Vector__XXX
 SG_ GD_ID_SCT_PARKING_BRAKE m12601 : 40|16@1+ (1,0) [0|65535] "" Vector__XXX
 SG_ GD_ID_SCT_CONTROL_MSG_TERMINAL m12608 : 40|16@1+ (1,0) [0|3] "" Vector__XXX
 SG_ GD_ID_SCT_CONTROL_MSG_GUIDEANCE m12609 : 40|16@1+ (1,0) [0|1] "" Vector__XXX
 SG_ GD_ID_SCT_MODIFIED_REFERENCE_POINT_HEIGHT m12610 : 40|16@1- (1,0) [-10000|10000] "mm" Vector__XXX
 SG_ GD_ID_SCT_MODIFIED_GNSS_ANTENNA_X_OFFSET m12611 : 40|16@1- (1,0) [-10000|10000] "mm" Vector__XXX
 SG_ GD_ID_SCT_MODIFIED_GNSS_ANTENNA_Y_OFFSET m12612 : 40|16@1- (1,0) [-10000|10000] "mm" Vector__XXX
 SG_ GD_ID_SCT_MODIFIED_GNSS_ANTENNA_Z_OFFSET m12613 : 40|16@1- (1,0) [-10000|10000] "mm" Vector__XXX
 SG_ GD_ID_SCT_MODIFIED_TRACK_WIDTH m12614 : 40|16@1+ (1,0) [0|10000] "mm" Vector__XXX
 SG_ GD_ID_SCT_MODIFIED_MOUNTING_ERROR_Y_OFFSET m12615 : 40|16@1- (1,0) [-100|100] "mm" Vector__XXX
 SG_ GD_ID_SCT_TRACTOR_SN_TYPE m12736 : 40|16@1+ (1,0) [0|999] "" Vector__XXX
 SG_ GD_ID_SCT_TRACTOR_SN_GROUP m12737 : 40|16@1+ (1,0) [0|99] "" Vector__XXX
 SG_ GD_ID_SCT_TRACTOR_SN_NUMBER m12738 : 40|16@1+ (1,0) [0|99999] "" Vector__XXX
 SG_ GD_ID_SCT_ERROR_ACKNOWLEDGE_Status m12782 : 39|1@1+ (1,0) [0|0] "1/0" Vector__XXX
 SG_ GD_ID_SCT_ERROR_ACKNOWLEDGE m12782 : 40|16@1+ (1,0) [0|255] "" Vector__XXX
 SG_ GD_ID_SCT_ACTIVATE_DIAGNOSTICS m12784 : 40|16@1+ (1,0) [0|65535] "" Vector__XXX
 SG_ GD_ID_SCT_SAFETY_VERSION_Status m12788 : 39|1@1+ (1,0) [0|0] "1/0" Vector__XXX
 SG_ GD_ID_SCT_SAFETY_VERSION m12788 : 40|16@1+ (1,0) [0|65535] "" Vector__XXX
 SG_ GD_ID_SCT_LIB_SAFETY_VERSION m12789 : 40|16@1+ (1,0) [0|65535] "" Vector__XXX
 SG_ GD_ID_SCT_RECIPE_ACCESS_SETPOINT m12792 : 40|16@1+ (1,0) [0|65535] "" Vector__XXX
 SG_ GD_ID_SCT_TI_ACCESS_SETPOINT m12793 : 40|16@1+ (1,0) [0|65535] "" Vector__XXX
 SG_ GD_ID_SCT_TI_ACCESS_STATE m12794 : 40|16@1+ (1,0) [0|65535] "" Vector__XXX
 SG_ GD_ID_SCT_TI_ACCESS_STATE_KL15 m12795 : 40|16@1+ (1,0) [0|65535] "" Vector__XXX
 SG_ GD_ID_SCT_TI_SUB_STATE m12797 : 40|16@1+ (1,0) [0|255] "" Vector__XXX
 SG_ GD_ID_SCT_ErrorManagement_Status m12782 : 39|1@1+ (1,0) [0|0] "1/0" Vector__XXX
 SG_ GD_ID_SCT_ErrorManagement m12782 : 40|16@1+ (1,0) [0|255] "" Vector__XXX
 SG_ GD_ID_SCT_LifeMessage m12799 : 40|16@1+ (1,0) [0|65535] "ms" Vector__XXX

 SG_ GD_ID_Engine_Rpm m12800 : 40|16@1+ (0.125,0) [0|32767] "1/min" Vector__XXX
 SG_ GD_ID_Engine_Load m12801 : 40|16@1+ (0.01,0) [0|10000] "%" Vector__XXX
 SG_ GD_ID_Engine_Coolant_Temp_Status m12802 : 39|1@1+ (1,0) [0|0] "1/0" Vector__XXX
 SG_ GD_ID_Engine_Coolant_Temp m12802 : 40|16@1- (1,0) [-40|130] "C" Vector__XXX
 SG_ GD_ID_Engine_Air_Intake_Temp m12803 : 40|16@1- (1,0) [-40|130] "C" Vector__XXX
 SG_ GD_ID_Engine_Battery_Power_Status m12804 : 39|1@1+ (1,0) [0|0] "1/0" Vector__XXX
 SG_ GD_ID_Engine_Battery_Power m12804 : 40|16@1+ (0.05,0) [0|32767] "V" Vector__XXX
 SG_ GD_ID_Engine_Air_Intake_Pressure m12805 : 40|16@1+ (0.01,0) [0|255] "bar" Vector__XXX
 SG_ GD_ID_Engine_Oil_Pressure m12806 : 40|16@1+ (0.01,0) [0|255] "bar" Vector__XXX
 SG_ GD_ID_Engine_Rpm_Setpoint_Status m12807 : 39|1@1+ (1,0) [0|0] "1/0" Vector__XXX
 SG_ GD_ID_Engine_Rpm_Setpoint m12807 : 40|16@1+ (0.125,0) [0|32767] "1/min" Vector__XXX
 SG_ GD_ID_Engine_Standing_Still_Status m12808 : 39|1@1+ (1,0) [0|0] "1/0" Vector__XXX
 SG_ GD_ID_Engine_Standing_Still m12808 : 40|16@1+ (1,0) [0|0] "STILL/RUNNING" Vector__XXX
 SG_ GD_ID_Engine_Oil_Pressure_Low_Status m12809 : 39|1@1+ (1,0) [0|0] "1/0" Vector__XXX
 SG_ GD_ID_Engine_Oil_Pressure_Low m12809 : 40|16@1+ (1,0) [0|0] "LOW/OK" Vector__XXX
 SG_ GD_ID_Engine_Oil_Service_Interval_Status m12810 : 39|1@1+ (1,0) [0|0] "1/0" Vector__XXX
 SG_ GD_ID_Engine_Oil_Service_Interval m12810 : 40|16@1+ (1,0) [0|0] "EXCEEDED/OK" Vector__XXX
 SG_ GD_ID_Engine_Hours m12811 : 40|16@1+ (1,0) [0|32767] "h" Vector__XXX
 SG_ GD_ID_Engine_Amber_Warning_Lamp_Status m12812 : 39|1@1+ (1,0) [0|0] "1/0" Vector__XXX
 SG_ GD_ID_Engine_Amber_Warning_Lamp m12812 : 40|16@1+ (1,0) [0|0] "ON/OFF" Vector__XXX
 SG_ GD_ID_Engine_Red_Stop_Lamp_Status m12813 : 39|1@1+ (1,0) [0|0] "1/0" Vector__XXX
 SG_ GD_ID_Engine_Red_Stop_Lamp m12813 : 40|16@1+ (1,0) [0|0] "ON/OFF" Vector__XXX
 SG_ GD_ID_Alt_Low_Idle m12814 : 40|16@1+ (1,0) [0|1] "ON/OFF" Vector__XXX
 SG_ GD_ID_Engine_Audible_Warning_Status m12815 : 39|1@1+ (1,0) [0|0] "1/0" Vector__XXX
 SG_ GD_ID_Engine_Audible_Warning m12815 : 40|16@1+ (1,0) [0|0] "ON/OFF" Vector__XXX
 SG_ GD_ID_Ambient_Temp m12816 : 40|16@1- (1,0) [-273|1775] "C" Vector__XXX
 SG_ GD_ID_Ecu_Temp m12817 : 40|16@1- (1,0) [-273|1775] "C" Vector__XXX
 SG_ GD_ID_Fuel_Rate m12820 : 40|16@1+ (0.05,0) [0|32767] "l/h" Vector__XXX
 SG_ GD_ID_Trip_Fuel m12821 : 40|16@1+ (0.05,0) [0|32767] "l" Vector__XXX
 SG_ GD_ID_Trip_DEF m12822 : 40|16@1+ (0.1,0) [0|32767] "l" Vector__XXX
 SG_ GD_ID_DEF_Level m12823 : 40|16@1+ (0.1,0) [0|1000] "%" Vector__XXX
 SG_ GD_ID_Water_In_Fuel_Status m12824 : 39|1@1+ (1,0) [0|0] "1/0" Vector__XXX
 SG_ GD_ID_Water_In_Fuel m12824 : 40|16@1+ (1,0) [0|0] "YES/NO" Vector__XXX
 SG_ GD_ID_Engine_Malfunction_Lamp_Status m12825 : 39|1@1+ (1,0) [0|0] "1/0" Vector__XXX
 SG_ GD_ID_Engine_Malfunction_Lamp m12825 : 40|16@1+ (1,0) [0|1] "ON/OFF/FLASH" Vector__XXX
 SG_ GD_ID_DEF_Level_Warning_Status m12826 : 39|1@1+ (1,0) [0|0] "1/0" Vector__XXX
 SG_ GD_ID_DEF_Level_Warning m12826 : 40|16@1+ (1,0) [0|1] "ON/OFF/FLASH" Vector__XXX
 SG_ GD_ID_Engine_WaitToStart_Status m12827 : 39|1@1+ (1,0) [0|0] "1/0" Vector__XXX
 SG_ GD_ID_Engine_WaitToStart m12827 : 40|16@1+ (1,0) [0|0] "ON/OFF" Vector__XXX
 SG_ GD_ID_Engine_Operating_State m12828 : 40|16@1+ (1,0) [0|15] "" Vector__XXX
 SG_ GD_ID_Engine_Start_Enable_Status m12829 : 39|1@1+ (1,0) [0|0] "1/0" Vector__XXX
 SG_ GD_ID_Engine_Start_Enable m12829 : 40|16@1+ (1,0) [0|0] "ON/OFF" Vector__XXX
 SG_ GD_ID_Implement_Transport_State_Status m12830 : 39|1@1+ (1,0) [0|0] "1/0" Vector__XXX
 SG_ GD_ID_Implement_Transport_State m12830 : 40|16@1+ (1,0) [0|0] "OK/Not" Vector__XXX
 SG_ GD_ID_Implement_Work_State_Status m12831 : 39|1@1+ (1,0) [0|0] "1/0" Vector__XXX
 SG_ GD_ID_Implement_Work_State m12831 : 40|16@1+ (1,0) [0|0] "ON/OFF" Vector__XXX
 SG_ GD_ID_Implement_Actual_Working_Width m12832 : 40|16@1+ (1,0) [0|65535] "mm" Vector__XXX
 SG_ GD_ID_Implement_Actual_Flow m12833 : 40|16@1+ (0.1,0) [0|65535] "l/s" Vector__XXX
 SG_ GD_ID_Implement_ReadyForFieldWork_Status m12834 : 39|1@1+ (1,0) [0|0] "1/0" Vector__XXX
 SG_ GD_ID_Implement_ReadyForFieldWork m12834 : 40|16@1+ (1,0) [0|0] "YES/NO" Vector__XXX
 SG_ GD_ID_WheelBasedDistance_km m12840 : 40|16@1+ (1,0) [0|65535] "km" Vector__XXX
 SG_ GD_ID_WheelBasedDistance_m m12841 : 40|16@1+ (1,0) [0|65535] "m" Vector__XXX
 SG_ GD_ID_GroundBasedDistance_km m12842 : 40|16@1+ (1,0) [0|65535] "km" Vector__XXX
 SG_ GD_ID_GroundBasedDistance_m m12843 : 40|16@1+ (1,0) [0|65535] "m" Vector__XXX
 SG_ GD_ID_SelectedSpeedDistance_km m12844 : 40|16@1+ (1,0) [0|65535] "km" Vector__XXX
 SG_ GD_ID_SelectedSpeedDistance_m m12845 : 40|16@1+ (1,0) [0|65535] "m" Vector__XXX
 SG_ GD_ID_MachineSelectedSpeed m12846 : 40|16@1+ (0.0036,0) [0|32767] "km/h" Vector__XXX
 SG_ GD_ID_WBZ_MACHINE_SELECTED_SOURCE m12847 : 40|16@1+ (1,0) [0|7] "enum" Vector__XXX
 SG_ GD_ID_WBZ_MAX_ENG_RPM m12848 : 40|16@1+ (0.1,0) [0|2500] "rpm" Vector__XXX
 SG_ GD_ID_Working_Time_SecMin_VD m12850 : 40|16@1+ (1,0) [0|59] "s/min" Vector__XXX
 SG_ GD_ID_Working_Time_Hours_VD m12851 : 40|16@1+ (1,0) [0|65535] "h" Vector__XXX
 SG_ GD_ID_Worked_Area_Ha_VD m12852 : 40|16@1+ (1,0) [0|65535] "ha" Vector__XXX
 SG_ GD_ID_Worked_Area_0001Ha_VD m12853 : 40|16@1+ (1,0) [0|9999] "ha" Vector__XXX
 SG_ GD_ID_Used_Fuel_VD m12854 : 40|16@1+ (0.1,0) [0|6553.5] "l" Vector__XXX
 SG_ GD_ID_Remaining_Time_SecMin_VD m12855 : 40|16@1+ (1,0) [0|59] "s/min" Vector__XXX
 SG_ GD_ID_Remaining_Time_Hours_VD m12856 : 40|16@1+ (1,0) [0|65535] "h" Vector__XXX
 SG_ GD_ID_Remaining_Area_Ha_VD m12857 : 40|16@1+ (1,0) [0|65535] "ha" Vector__XXX
 SG_ GD_ID_Remaining_Area_0001Ha_VD m12858 : 40|16@1+ (1,0) [0|9999] "ha" Vector__XXX
 SG_ GD_ID_Required_Fuel_VD m12859 : 40|16@1+ (0.1,0) [0|6553.5] "l" Vector__XXX
 SG_ GD_ID_Field_Size_Ha_VD m12860 : 40|16@1+ (1,0) [0|65535] "ha" Vector__XXX
 SG_ GD_ID_Field_Size_0001Ha_VD m12861 : 40|16@1+ (1,0) [0|9999] "ha" Vector__XXX
 SG_ GD_ID_Reset_VD_Status m12862 : 39|1@1+ (1,0) [0|0] "1/0" Vector__XXX
 SG_ GD_ID_Reset_VD m12862 : 40|16@1+ (1,0) [0|0] "ON/OFF" Vector__XXX
 SG_ GD_Iso_IsoState_state_RW m12870 : 40|16@1+ (1,0) [0|15] "ON/OFF" Vector__XXX
 SG_ GD_ID_WBZ_TERMINAL_PAGE_SIZE m12871 : 40|16@1+ (1,0) [0|3] "enum" Vector__XXX
 SG_ GD_ID_WBZ_ENG_DEF_LVL_LAMP_Status m12878 : 39|1@1+ (1,0) [0|0] "1/0" Vector__XXX
 SG_ GD_ID_WBZ_ENG_DEF_LVL_LAMP m12878 : 40|16@1+ (1,0) [0|1] "" Vector__XXX
 SG_ GD_ID_WBZ_ENG_DEF_MIL_LAMP_Status m12879 : 39|1@1+ (1,0) [0|0] "1/0" Vector__XXX
 SG_ GD_ID_WBZ_ENG_DEF_MIL_LAMP m12879 : 40|16@1+ (1,0) [0|1] "" Vector__XXX
 SG_ GD_ID_IgnitionState_Status m12880 : 39|1@1+ (1,0) [0|0] "1/0" Vector__XXX
 SG_ GD_ID_IgnitionState m12880 : 40|16@1+ (1,0) [0|0] "ON/OFF" Vector__XXX
 SG_ GD_ID_WBZ_ENG_FAN_RPM m12881 : 40|16@1+ (0.125,0) [0|32767] "RPM" Vector__XXX
 SG_ GD_ID_WBZ_ENG_FUEL_TEMP m12882 : 40|16@1- (1,0) [-40|210] "C" Vector__XXX
 SG_ GD_ID_WBZ_ENG_AUXIO1_01 m12883 : 40|16@1+ (1,0) [0|3] "" Vector__XXX
 SG_ GD_ID_WBZ_ENG_FAN_DUTY_CYCLE m12884 : 40|16@1+ (0.01,0) [0|10000] "%" Vector__XXX
 SG_ GD_ID_WBZ_DEF_TEMP m12885 : 40|16@1- (1,0) [-40|215] "C" Vector__XXX
 SG_ GD_ID_WBZ_EXHAUST_TEMP m12886 : 40|16@1- (0.03125,-273) [-273|1734.969] "C" Vector__XXX
 SG_ GD_ID_WBZ_FUEL_PRESSURE m12887 : 40|16@1+ (0.04,0) [0|10.2] "bar" Vector__XXX
 SG_ GD_ID_WBZ_CURVATURE_SETPOINT m12888 : 40|16@1- (0.25,-8032) [-8032|8031.75] "1/Km" Vector__XXX
 SG_ GD_ID_WBZ_CURVATURE_ENABLE_Status m12889 : 39|1@1+ (1,0) [0|0] "1/0" Vector__XXX
 SG_ GD_ID_WBZ_CURVATURE_ENABLE m12889 : 40|16@1+ (1,0) [0|0] "" Vector__XXX
 SG_ GD_ID_WBZ_ENG_START_CMD_Status m12890 : 39|1@1+ (1,0) [0|0] "1/0" Vector__XXX
 SG_ GD_ID_WBZ_ENG_START_CMD m12890 : 40|16@1+ (1,0) [0|0] "" Vector__XXX
 SG_ GD_ID_WBZ_THIRD_PARTY_MANUS_Status m12891 : 39|1@1+ (1,0) [0|0] "1/0" Vector__XXX
 SG_ GD_ID_WBZ_THIRD_PARTY_MANUS m12891 : 40|16@1+ (1,0) [0|32] "" Vector__XXX
 SG_ GD_ID_WBZ_NEW_LEADER_ACL_Status m12892 : 39|1@1+ (1,0) [0|0] "1/0" Vector__XXX
 SG_ GD_ID_WBZ_NEW_LEADER_ACL m12892 : 40|16@1+ (1,0) [0|0] "" Vector__XXX
 SG_ GD_ID_WBZ_AUXIO1_01_FI02 m12901 : 40|16@1+ (1,0) [0|3] "" Vector__XXX
 SG_ GD_ID_WBZ_AUXIO1_02_FI02 m12902 : 40|16@1+ (1,0) [0|3] "" Vector__XXX
 SG_ GD_ID_WBZ_AUXIO1_03_FI02 m12903 : 40|16@1+ (1,0) [0|3] "" Vector__XXX
 SG_ GD_ID_WBZ_AUXIO1_04_FI02 m12904 : 40|16@1+ (1,0) [0|3] "" Vector__XXX
 SG_ GD_ID_WBZ_AUXIO1_05_FI02 m12905 : 40|16@1+ (1,0) [0|3] "" Vector__XXX
 SG_ GD_ID_WBZ_AUXIO1_06_FI02 m12906 : 40|16@1+ (1,0) [0|3] "" Vector__XXX
 SG_ GD_ID_WBZ_AUXIO1_07_FI02 m12907 : 40|16@1+ (1,0) [0|3] "" Vector__XXX
 SG_ GD_ID_WBZ_AUXIO1_08_FI02 m12908 : 40|16@1+ (1,0) [0|3] "" Vector__XXX
 SG_ GD_ID_WBZ_AUXIO1_09_FI02 m12909 : 40|16@1+ (1,0) [0|3] "" Vector__XXX
 SG_ GD_ID_WBZ_AUXIO1_10_FI02 m12910 : 40|16@1+ (1,0) [0|3] "" Vector__XXX
 SG_ GD_ID_WBZ_AUXIO1_11_FI02 m12911 : 40|16@1+ (1,0) [0|3] "" Vector__XXX
 SG_ GD_ID_WBZ_AUXIO1_12_FI02 m12912 : 40|16@1+ (1,0) [0|3] "" Vector__XXX
 SG_ GD_ID_WBZ_AUXIO2_17_FI02 m12917 : 40|16@1+ (1,0) [0|3] "" Vector__XXX
 SG_ GD_ID_WBZ_AUXIO2_18_FI02 m12918 : 40|16@1+ (1,0) [0|3] "" Vector__XXX
 SG_ GD_ID_WBZ_AUXIO1_01_FI00 m12919 : 40|16@1+ (1,0) [0|3] "" Vector__XXX
 SG_ GD_ID_WBZ_AUXIO1_02_FI00 m12920 : 40|16@1+ (1,0) [0|3] "" Vector__XXX
 SG_ GD_ID_WBZ_AUXIO1_03_FI00 m12921 : 40|16@1+ (1,0) [0|3] "" Vector__XXX
 SG_ GD_ID_WBZ_AUXIO1_04_FI00 m12922 : 40|16@1+ (1,0) [0|3] "" Vector__XXX
 SG_ GD_ID_WBZ_AUXIO1_05_FI00 m12923 : 40|16@1+ (1,0) [0|3] "" Vector__XXX
 SG_ GD_ID_WBZ_AUXIO1_06_FI00 m12924 : 40|16@1+ (1,0) [0|3] "" Vector__XXX
 SG_ GD_ID_WBZ_AUXIO1_07_FI00 m12925 : 40|16@1+ (1,0) [0|3] "" Vector__XXX
 SG_ GD_ID_WBZ_AUXIO1_08_FI00 m12926 : 40|16@1+ (1,0) [0|3] "" Vector__XXX
 SG_ GD_ID_WBZ_AUXIO1_09_FI00 m12927 : 40|16@1+ (1,0) [0|3] "" Vector__XXX
 SG_ GD_ID_WBZ_AUXIO1_10_FI00 m12928 : 40|16@1+ (1,0) [0|3] "" Vector__XXX
 SG_ GD_ID_WBZ_AUXIO1_11_FI00 m12929 : 40|16@1+ (1,0) [0|3] "" Vector__XXX
 SG_ GD_ID_WBZ_AUXIO1_12_FI00 m12930 : 40|16@1+ (1,0) [0|3] "" Vector__XXX
 SG_ GD_ID_WBZ_AUXIO1_13_FI00 m12931 : 40|16@1+ (1,0) [0|3] "" Vector__XXX
 SG_ GD_ID_WBZ_AUXIO1_14_FI00 m12932 : 40|16@1+ (1,0) [0|3] "" Vector__XXX
 SG_ GD_ID_WBZ_AUXIO1_15_FI00 m12933 : 40|16@1+ (1,0) [0|3] "" Vector__XXX
 SG_ GD_ID_WBZ_AUXIO1_16_FI00 m12934 : 40|16@1+ (1,0) [0|3] "" Vector__XXX
 SG_ GD_ID_WBZ_AUXIO1_CH2 m12935 : 40|16@1+ (0.125,0) [0|8031.875] "RPM" Vector__XXX
 SG_ GD_ID_WBZ_AUXIO2_17_FI00 m12936 : 40|16@1+ (1,0) [0|3] "" Vector__XXX
 SG_ GD_ID_WBZ_AUXIO2_18_FI00 m12937 : 40|16@1+ (1,0) [0|3] "" Vector__XXX
 SG_ GD_ID_WBZ_AUXIO2_21_FI00 m12940 : 40|16@1+ (1,0) [0|3] "" Vector__XXX
 SG_ GD_ID_WBZ_AUXIO2_22_FI00 m12941 : 40|16@1+ (1,0) [0|3] "" Vector__XXX
 SG_ GD_ID_WBZ_AUXIO2_26_FI00 m12945 : 40|16@1+ (1,0) [0|3] "" Vector__XXX
 SG_ GD_ID_WBZ_AUXIO2_27_FI00 m12946 : 40|16@1+ (1,0) [0|3] "" Vector__XXX
 SG_ GD_ID_WBZ_AUXIO2_28_FI00 m12947 : 40|16@1+ (1,0) [0|3] "" Vector__XXX
 SG_ GD_ID_WBZ_AUXIO2_29_FI00 m12948 : 40|16@1+ (1,0) [0|3] "" Vector__XXX
 SG_ GD_ID_WBZ_AUXIO2_30_FI00 m12949 : 40|16@1+ (1,0) [0|3] "" Vector__XXX
 SG_ GD_ID_WBZ_AUXIO2_31_FI00 m12950 : 40|16@1+ (1,0) [0|3] "" Vector__XXX
 SG_ GD_ID_WBZ_AUXIO2_32_FI00 m12951 : 40|16@1+ (1,0) [0|3] "" Vector__XXX
 SG_ GD_ID_WBZ_AUXIO1_01_FI01 m12952 : 40|16@1+ (1,0) [0|3] "" Vector__XXX
 SG_ GD_ID_WBZ_AUXIO1_02_FI01 m12953 : 40|16@1+ (1,0) [0|3] "" Vector__XXX
 SG_ GD_ID_WBZ_AUXIO1_03_FI01 m12954 : 40|16@1+ (1,0) [0|3] "" Vector__XXX
 SG_ GD_ID_WBZ_AUXIO1_04_FI01 m12955 : 40|16@1+ (1,0) [0|3] "" Vector__XXX
 SG_ GD_ID_WBZ_AUXIO1_05_FI01 m12956 : 40|16@1+ (1,0) [0|3] "" Vector__XXX
 SG_ GD_ID_WBZ_AUXIO1_06_FI01 m12957 : 40|16@1+ (1,0) [0|3] "" Vector__XXX
 SG_ GD_ID_WBZ_AUXIO1_07_FI01 m12958 : 40|16@1+ (1,0) [0|3] "" Vector__XXX
 SG_ GD_ID_WBZ_AUXIO1_08_FI01 m12959 : 40|16@1+ (1,0) [0|3] "" Vector__XXX
 SG_ GD_ID_WBZ_AUXIO1_09_FI01 m12960 : 40|16@1+ (1,0) [0|3] "" Vector__XXX
 SG_ GD_ID_WBZ_AUXIO1_10_FI01 m12961 : 40|16@1+ (1,0) [0|3] "" Vector__XXX
 SG_ GD_ID_WBZ_AUXIO1_11_FI01 m12962 : 40|16@1+ (1,0) [0|3] "" Vector__XXX
 SG_ GD_ID_WBZ_AUXIO1_12_FI01 m12963 : 40|16@1+ (1,0) [0|3] "" Vector__XXX
 SG_ GD_ID_WBZ_AUXIO1_13_FI01 m12964 : 40|16@1+ (1,0) [0|3] "" Vector__XXX
 SG_ GD_ID_WBZ_AUXIO1_14_FI01 m12965 : 40|16@1+ (1,0) [0|3] "" Vector__XXX
 SG_ GD_ID_WBZ_AUXIO1_15_FI01 m12966 : 40|16@1+ (1,0) [0|3] "" Vector__XXX
 SG_ GD_ID_WBZ_AUXIO1_16_FI01 m12967 : 40|16@1+ (1,0) [0|3] "" Vector__XXX
 SG_ GD_ID_WBZ_AUXIO2_17_FI01 m12969 : 40|16@1+ (1,0) [0|3] "" Vector__XXX
 SG_ GD_ID_WBZ_AUXIO2_18_FI01 m12970 : 40|16@1+ (1,0) [0|3] "" Vector__XXX
 SG_ GD_ID_WBZ_AUXIO2_21_FI01 m12973 : 40|16@1+ (1,0) [0|3] "" Vector__XXX
 SG_ GD_ID_WBZ_AUXIO2_22_FI01 m12974 : 40|16@1+ (1,0) [0|3] "" Vector__XXX
 SG_ GD_ID_WBZ_AUXIO2_26_FI01 m12978 : 40|16@1+ (1,0) [0|3] "" Vector__XXX
 SG_ GD_ID_WBZ_AUXIO2_27_FI01 m12979 : 40|16@1+ (1,0) [0|3] "" Vector__XXX
 SG_ GD_ID_WBZ_AUXIO2_28_FI01 m12980 : 40|16@1+ (1,0) [0|3] "" Vector__XXX
 SG_ GD_ID_WBZ_AUXIO2_29_FI01 m12981 : 40|16@1+ (1,0) [0|3] "" Vector__XXX
 SG_ GD_ID_WBZ_AUXIO2_30_FI01 m12982 : 40|16@1+ (1,0) [0|3] "" Vector__XXX
 SG_ GD_ID_WBZ_AUXIO2_31_FI01 m12983 : 40|16@1+ (1,0) [0|3] "" Vector__XXX
 SG_ GD_ID_WBZ_AUXIO2_32_FI01 m12984 : 40|16@1+ (1,0) [0|3] "" Vector__XXX
 SG_ GD_ID_WBZ_AUXIO2_21_FI02 m12985 : 40|16@1+ (1,0) [0|3] "" Vector__XXX
 SG_ GD_ID_WBZ_AUXIO2_22_FI02 m12986 : 40|16@1+ (1,0) [0|3] "" Vector__XXX
 SG_ GD_ID_WBZ_TI_ACCESS m13000 : 40|16@1+ (1,0) [0|65535] "" Vector__XXX
 SG_ GD_ID_Unknown_Engine_Error_Part1 m13052 : 40|16@1+ (1,0) [0|65535] "" Vector__XXX
 SG_ GD_ID_Unknown_Engine_Error_Part2 m13053 : 40|16@1+ (1,0) [0|65535] "" Vector__XXX
 SG_ GD_ID_WBZ_DPF_WARNING_LAMP_Status m13120 : 39|1@1+ (1,0) [0|0] "1/0" Vector__XXX
 SG_ GD_ID_WBZ_DPF_WARNING_LAMP m13120 : 40|16@1+ (1,0) [0|1] "" Vector__XXX
 SG_ GD_ID_WBZ_DPF_HEST_LAMP_Status m13121 : 39|1@1+ (1,0) [0|0] "1/0" Vector__XXX
 SG_ GD_ID_WBZ_DPF_HEST_LAMP m13121 : 40|16@1+ (1,0) [0|1] "" Vector__XXX
 SG_ GD_ID_WBZ_DPF_SOOT_ASH m13123 : 40|16@1+ (1,0) [0|65535] "%" Vector__XXX
 SG_ GD_ID_WBZ_DPF_HOURS_SINCE_REGEN m13124 : 40|16@1+ (1,0) [0|65535] "h" Vector__XXX
 SG_ GD_ID_WBZ_DPF_MINUTES_SINCE_REGEN m13125 : 40|16@1+ (1,0) [0|65535] "min" Vector__XXX
 SG_ GD_ID_WBZ_DPF_STATI m13126 : 40|16@1+ (1,0) [0|65535] "" Vector__XXX
 SG_ GD_ID_WBZ_DPF_INHIBITED_STATI m13128 : 40|16@1+ (1,0) [0|32768] "" Vector__XXX
 SG_ GD_ID_WBZ_DPF_CONTROL_REGEN m13129 : 40|16@1+ (1,0) [0|2] "" Vector__XXX
 SG_ GD_ID_WBZ_DPF_ENABLE_REGEN_Status m13130 : 39|1@1+ (1,0) [0|0] "1/0" Vector__XXX
 SG_ GD_ID_WBZ_DPF_ENABLE_REGEN m13130 : 40|16@1+ (1,0) [0|0] "" Vector__XXX
 SG_ GD_ID_WBZ_ErrorManagement_Status m13294 : 39|1@1+ (1,0) [0|0] "1/0" Vector__XXX
 SG_ GD_ID_WBZ_ErrorManagement m13294 : 40|16@1+ (1,0) [0|255] "" Vector__XXX
 SG_ GD_ID_WBZ_LifeMessage m13311 : 40|16@1+ (1,0) [0|65535] "ms" Vector__XXX

 SG_ GD_ID_SystemBrigthness m13376 : 40|16@1+ (1,0) [0|100] "%" Vector__XXX
 SG_ GD_ID_SystemBrightness_Errors m13440 : 40|16@1+ (1,0) [0|32767] "1 bit/error" Vector__XXX
 SG_ GD_ID_SBL_ErrorManagement_Status m13806 : 39|1@1+ (1,0) [0|0] "1/0" Vector__XXX
 SG_ GD_ID_SBL_ErrorManagement m13806 : 40|16@1+ (1,0) [0|255] "" Vector__XXX
 SG_ GD_ID_SBL_LifeMessage m13823 : 40|16@1+ (1,0) [0|65535] "ms" Vector__XXX

 SG_ GD_ID_Current_Track_Width m13824 : 40|16@1+ (1,0) [0|32767] "mm" Vector__XXX
 SG_ GD_ID_TA_Min_Track_Width m13825 : 40|16@1+ (1,0) [1800|3900] "mm" Vector__XXX
 SG_ GD_ID_Max_Track_Width m13826 : 40|16@1+ (1,0) [0|32767] "mm" Vector__XXX
 SG_ GD_ID_Calib_State_Track_Width_Status m13827 : 39|1@1+ (1,0) [0|0] "1/0" Vector__XXX
 SG_ GD_ID_Calib_State_Track_Width m13827 : 40|16@1+ (1,0) [0|0] "TRUE/FALSE" Vector__XXX
 SG_ GD_ID_TA_Front_Axle_Width m13828 : 40|16@1+ (1,0) [0|32767] "mm" Vector__XXX
 SG_ GD_ID_TA_Front_Track_Width m13829 : 40|16@1+ (1,0) [1800|3900] "mm" Vector__XXX
 SG_ GD_ID_TA_Rear_Axle_Width m13830 : 40|16@1+ (1,0) [0|32767] "mm" Vector__XXX
 SG_ GD_ID_TA_Rear_Track_Width m13831 : 40|16@1+ (1,0) [1800|3900] "mm" Vector__XXX
 SG_ GD_ID_Track_Adjust_Errors_Status m13832 : 39|1@1+ (1,0) [0|0] "1/0" Vector__XXX
 SG_ GD_ID_Track_Adjust_Errors m13832 : 40|16@1+ (1,0) [0|65535] "1 bit/error" Vector__XXX
 SG_ GD_ID_TA_Calibration_Command m13833 : 40|16@1+ (1,0) [0|65535] "" Vector__XXX
 SG_ GD_ID_TA_Calibration_State m13834 : 40|16@1+ (1,0) [0|65535] "" Vector__XXX
 SG_ GD_ID_TA_MANUAL_IN_Status m13835 : 39|1@1+ (1,0) [0|0] "1/0" Vector__XXX
 SG_ GD_ID_TA_MANUAL_IN m13835 : 40|16@1+ (1,0) [0|0] "" Vector__XXX
 SG_ GD_ID_TA_MANUAL_OUT_Status m13836 : 39|1@1+ (1,0) [0|0] "1/0" Vector__XXX
 SG_ GD_ID_TA_MANUAL_OUT m13836 : 40|16@1+ (1,0) [0|0] "" Vector__XXX
 SG_ GD_ID_TA_Actual_Front_In_R_Status m13839 : 39|1@1+ (1,0) [0|0] "1/0" Vector__XXX
 SG_ GD_ID_TA_Actual_Front_In_R m13839 : 40|16@1+ (1,0) [0|0] "ON/OFF" Vector__XXX
 SG_ GD_ID_TA_Actual_Front_Out_R_Status m13840 : 39|1@1+ (1,0) [0|0] "1/0" Vector__XXX
 SG_ GD_ID_TA_Actual_Front_Out_R m13840 : 40|16@1+ (1,0) [0|0] "ON/OFF" Vector__XXX
 SG_ GD_ID_TA_Actual_Rear_In_R_Status m13841 : 39|1@1+ (1,0) [0|0] "1/0" Vector__XXX
 SG_ GD_ID_TA_Actual_Rear_In_R m13841 : 40|16@1+ (1,0) [0|0] "ON/OFF" Vector__XXX
 SG_ GD_ID_TA_Actual_Rear_Out_R_Status m13842 : 39|1@1+ (1,0) [0|0] "1/0" Vector__XXX
 SG_ GD_ID_TA_Actual_Rear_Out_R m13842 : 40|16@1+ (1,0) [0|0] "ON/OFF" Vector__XXX
 SG_ GD_ID_TA_Actual_Front_In_Status m13843 : 39|1@1+ (1,0) [0|0] "1/0" Vector__XXX
 SG_ GD_ID_TA_Actual_Front_In m13843 : 40|16@1+ (1,0) [0|0] "ON/OFF" Vector__XXX
 SG_ GD_ID_TA_Actual_Front_Out_Status m13844 : 39|1@1+ (1,0) [0|0] "1/0" Vector__XXX
 SG_ GD_ID_TA_Actual_Front_Out m13844 : 40|16@1+ (1,0) [0|0] "ON/OFF" Vector__XXX
 SG_ GD_ID_TA_Actual_Rear_In_Status m13845 : 39|1@1+ (1,0) [0|0] "1/0" Vector__XXX
 SG_ GD_ID_TA_Actual_Rear_In m13845 : 40|16@1+ (1,0) [0|0] "ON/OFF" Vector__XXX
 SG_ GD_ID_TA_Actual_Rear_Out_Status m13846 : 39|1@1+ (1,0) [0|0] "1/0" Vector__XXX
 SG_ GD_ID_TA_Actual_Rear_Out m13846 : 40|16@1+ (1,0) [0|0] "ON/OFF" Vector__XXX
 SG_ GD_ID_Track_Adjust_Equipped_Status m13847 : 39|1@1+ (1,0) [0|0] "1/0" Vector__XXX
 SG_ GD_ID_Track_Adjust_Equipped m13847 : 40|16@1+ (1,0) [0|0] "YES/NO" Vector__XXX
 SG_ GD_ID_TA_Min_Tire_Track_Width m13848 : 40|16@1+ (1,0) [0|3900] "mm" Vector__XXX
 SG_ GD_ID_Current_Axle_Width m13849 : 40|16@1+ (1,0) [0|3900] "mm" Vector__XXX
 SG_ GD_ID_TA_Operation_State_Status m13850 : 39|1@1+ (1,0) [0|0] "1/0" Vector__XXX
 SG_ GD_ID_TA_Operation_State m13850 : 40|16@1+ (1,0) [0|3] "enum" Vector__XXX
 SG_ GD_ID_TA_In_Tolerance_Status m13851 : 39|1@1+ (1,0) [0|0] "1/0" Vector__XXX
 SG_ GD_ID_TA_In_Tolerance m13851 : 40|16@1+ (1,0) [0|0] "bool" Vector__XXX
 SG_ GD_ID_TA_Auto_Enable_A_Status m13852 : 39|1@1+ (1,0) [0|0] "1/0" Vector__XXX
 SG_ GD_ID_TA_Auto_Enable_A m13852 : 40|16@1+ (1,0) [0|0] "bool" Vector__XXX
 SG_ GD_ID_TA_Auto_Enable_B_Status m13853 : 39|1@1+ (1,0) [0|0] "1/0" Vector__XXX
 SG_ GD_ID_TA_Auto_Enable_B m13853 : 40|16@1+ (1,0) [0|0] "bool" Vector__XXX
 SG_ GD_ID_TA_Auto_Enable_Dual_Status m13854 : 39|1@1+ (1,0) [0|0] "1/0" Vector__XXX
 SG_ GD_ID_TA_Auto_Enable_Dual m13854 : 40|16@1+ (1,0) [0|0] "bool" Vector__XXX
 SG_ GD_ID_TA_Setpoint_A m13855 : 40|16@1+ (1,0) [1800|3900] "mm" Vector__XXX
 SG_ GD_ID_TA_Setpoint_B m13856 : 40|16@1+ (1,0) [1800|3900] "mm" Vector__XXX
 SG_ GD_ID_TA_Setpoint_Dual_Front m13857 : 40|16@1+ (1,0) [1800|3900] "mm" Vector__XXX
 SG_ GD_ID_TA_Setpoint_Dual_Rear m13858 : 40|16@1+ (1,0) [1800|3900] "mm" Vector__XXX
 SG_ GD_ID_TA_Equipped_Status m13864 : 39|1@1+ (1,0) [0|0] "1/0" Vector__XXX
 SG_ GD_ID_TA_Equipped m13864 : 40|16@1+ (1,0) [0|0] "YES/NO" Vector__XXX
 SG_ GD_ID_TA_FL_POSITION m13874 : 40|16@1+ (1,0) [0|2250] "mm" Vector__XXX
 SG_ GD_ID_TA_FR_POSITION m13875 : 40|16@1+ (1,0) [0|2250] "mm" Vector__XXX
 SG_ GD_ID_TA_RL_POSITION m13876 : 40|16@1+ (1,0) [0|2250] "mm" Vector__XXX
 SG_ GD_ID_TA_RR_POSITION m13877 : 40|16@1+ (1,0) [0|2250] "mm" Vector__XXX
 SG_ GD_ID_TA_Setpoint_A_Rear_Status m13878 : 39|1@1+ (1,0) [0|0] "1/0" Vector__XXX
 SG_ GD_ID_TA_Setpoint_A_Rear m13878 : 40|16@1+ (1,0) [1800|3900] "mm" Vector__XXX
 SG_ GD_ID_TA_Setpoint_B_Rear_Status m13879 : 39|1@1+ (1,0) [0|0] "1/0" Vector__XXX
 SG_ GD_ID_TA_Setpoint_B_Rear m13879 : 40|16@1+ (1,0) [1800|3900] "mm" Vector__XXX
 SG_ GD_ID_TA_TARGET_TRACKWIDTH_FL m13880 : 40|16@1+ (1,0) [0|3900] "mm" Vector__XXX
 SG_ GD_ID_TA_TARGET_TRACKWIDTH_FR m13881 : 40|16@1+ (1,0) [0|3900] "mm" Vector__XXX
 SG_ GD_ID_TA_TARGET_TRACKWIDTH_RL m13882 : 40|16@1+ (1,0) [0|3900] "mm" Vector__XXX
 SG_ GD_ID_TA_TARGET_TRACKWIDTH_RR m13883 : 40|16@1+ (1,0) [0|3900] "mm" Vector__XXX
 SG_ GD_ID_TA_ADDITIONAL_WIDTH_FL m13884 : 40|16@1+ (0.1,0) [0|80] "mm" Vector__XXX
 SG_ GD_ID_TA_ADDITIONAL_WIDTH_FR m13885 : 40|16@1+ (0.1,0) [0|80] "mm" Vector__XXX
 SG_ GD_ID_TA_ADDITIONAL_WIDTH_RL m13886 : 40|16@1+ (0.1,0) [0|80] "mm" Vector__XXX
 SG_ GD_ID_TA_ADDITIONAL_WIDTH_RR m13887 : 40|16@1+ (0.1,0) [0|80] "mm" Vector__XXX
 SG_ GD_ID_TA_ErrorManagement_Status m14318 : 39|1@1+ (1,0) [0|0] "1/0" Vector__XXX
 SG_ GD_ID_TA_ErrorManagement m14318 : 40|16@1+ (1,0) [0|255] "" Vector__XXX
 SG_ GD_ID_TA_LifeMessage m14335 : 40|16@1+ (1,0) [0|65535] "ms" Vector__XXX

 SG_ GD_ID_RG3_HYDRAULIC_LEVEL m15360 : 40|16@1+ (1,0) [0|100] "%" Vector__XXX
 SG_ GD_ID_RG3_TURN_SCT_TO_OFF_Status m15361 : 39|1@1+ (1,0) [0|0] "1/0" Vector__XXX
 SG_ GD_ID_RG3_TURN_SCT_TO_OFF m15361 : 40|16@1+ (1,0) [0|0] "" Vector__XXX
 SG_ GD_ID_RG3_HVAC_COMPRESSOR_Status m15362 : 39|1@1+ (1,0) [0|0] "1/0" Vector__XXX
 SG_ GD_ID_RG3_HVAC_COMPRESSOR m15362 : 40|16@1+ (1,0) [0|65535] "mA" Vector__XXX
 SG_ GD_ID_RG3_HVAC_INPUT_VOLTAGE m15363 : 40|16@1+ (1,0) [0|65535] "mV" Vector__XXX
 SG_ GD_ID_RG3_FRONT_SYS_PUMP_COMMAND_Status m15364 : 39|1@1+ (1,0) [0|0] "1/0" Vector__XXX
 SG_ GD_ID_RG3_FRONT_SYS_PUMP_COMMAND m15364 : 40|16@1+ (1,0) [0|65535] "mA" Vector__XXX
 SG_ GD_ID_RG3_FRONT_SYS_PUMP_ACTUAL m15365 : 40|16@1+ (1,0) [0|65535] "mA" Vector__XXX
 SG_ GD_ID_RG3_REAR_SYS_PUMP_COMMAND_Status m15366 : 39|1@1+ (1,0) [0|0] "1/0" Vector__XXX
 SG_ GD_ID_RG3_REAR_SYS_PUMP_COMMAND m15366 : 40|16@1+ (1,0) [0|65535] "mA" Vector__XXX
 SG_ GD_ID_RG3_REAR_SYS_PUMP_ACTUAL m15367 : 40|16@1+ (1,0) [0|65535] "mA" Vector__XXX
 SG_ GD_ID_RG3_TI_ACCESS m15460 : 40|16@1+ (1,0) [0|1] "" Vector__XXX
 SG_ GD_ID_RG3_OPERATOR_PRESENCE_Status m15860 : 39|1@1+ (1,0) [0|0] "1/0" Vector__XXX
 SG_ GD_ID_RG3_OPERATOR_PRESENCE m15860 : 40|16@1+ (1,0) [0|32760] "Sec" Vector__XXX
 SG_ GD_ID_RG3_ErrorManagement_Status m15854 : 39|1@1+ (1,0) [0|0] "1/0" Vector__XXX
 SG_ GD_ID_RG3_ErrorManagement m15854 : 40|16@1+ (1,0) [0|255] "" Vector__XXX
 SG_ GD_ID_RG3_LifeMessage m15871 : 40|16@1+ (1,0) [0|65535] "ms" Vector__XXX

 SG_ GD_ID_EMM_SIGNAL_LN00_ERROR_W_Status m15872 : 39|1@1+ (1,0) [0|0] "1/0" Vector__XXX
 SG_ GD_ID_EMM_SIGNAL_LN00_ERROR_W m15872 : 40|16@1+ (1,0) [0|255] "" Vector__XXX
 SG_ GD_ID_EMM_SIGNAL_LN01_ERROR_W_Status m15873 : 39|1@1+ (1,0) [0|0] "1/0" Vector__XXX
 SG_ GD_ID_EMM_SIGNAL_LN01_ERROR_W m15873 : 40|16@1+ (1,0) [0|255] "" Vector__XXX
 SG_ GD_ID_EMM_SIGNAL_LN02_ERROR_W_Status m15874 : 39|1@1+ (1,0) [0|0] "1/0" Vector__XXX
 SG_ GD_ID_EMM_SIGNAL_LN02_ERROR_W m15874 : 40|16@1+ (1,0) [0|255] "" Vector__XXX
 SG_ GD_ID_EMM_SIGNAL_LN03_ERROR_W_Status m15875 : 39|1@1+ (1,0) [0|0] "1/0" Vector__XXX
 SG_ GD_ID_EMM_SIGNAL_LN03_ERROR_W m15875 : 40|16@1+ (1,0) [0|255] "" Vector__XXX
 SG_ GD_ID_EMM_SIGNAL_LN04_ERROR_W_Status m15876 : 39|1@1+ (1,0) [0|0] "1/0" Vector__XXX
 SG_ GD_ID_EMM_SIGNAL_LN04_ERROR_W m15876 : 40|16@1+ (1,0) [0|255] "" Vector__XXX
 SG_ GD_ID_EMM_SIGNAL_LN05_ERROR_W_Status m15877 : 39|1@1+ (1,0) [0|0] "1/0" Vector__XXX
 SG_ GD_ID_EMM_SIGNAL_LN05_ERROR_W m15877 : 40|16@1+ (1,0) [0|255] "" Vector__XXX
 SG_ GD_ID_EMM_SIGNAL_LN06_ERROR_W_Status m15878 : 39|1@1+ (1,0) [0|0] "1/0" Vector__XXX
 SG_ GD_ID_EMM_SIGNAL_LN06_ERROR_W m15878 : 40|16@1+ (1,0) [0|255] "" Vector__XXX
 SG_ GD_ID_EMM_SIGNAL_LN07_ERROR_W_Status m15879 : 39|1@1+ (1,0) [0|0] "1/0" Vector__XXX
 SG_ GD_ID_EMM_SIGNAL_LN07_ERROR_W m15879 : 40|16@1+ (1,0) [0|255] "" Vector__XXX
 SG_ GD_ID_EMM_SIGNAL_LN08_ERROR_W_Status m15880 : 39|1@1+ (1,0) [0|0] "1/0" Vector__XXX
 SG_ GD_ID_EMM_SIGNAL_LN08_ERROR_W m15880 : 40|16@1+ (1,0) [0|255] "" Vector__XXX
 SG_ GD_ID_EMM_SIGNAL_LN09_ERROR_W_Status m15881 : 39|1@1+ (1,0) [0|0] "1/0" Vector__XXX
 SG_ GD_ID_EMM_SIGNAL_LN09_ERROR_W m15881 : 40|16@1+ (1,0) [0|255] "" Vector__XXX
 SG_ GD_ID_EMM_SIGNAL_LN10_ERROR_W_Status m15882 : 39|1@1+ (1,0) [0|0] "1/0" Vector__XXX
 SG_ GD_ID_EMM_SIGNAL_LN10_ERROR_W m15882 : 40|16@1+ (1,0) [0|255] "" Vector__XXX
 SG_ GD_ID_EMM_SIGNAL_LN11_ERROR_W_Status m15883 : 39|1@1+ (1,0) [0|0] "1/0" Vector__XXX
 SG_ GD_ID_EMM_SIGNAL_LN11_ERROR_W m15883 : 40|16@1+ (1,0) [0|255] "" Vector__XXX
 SG_ GD_ID_EMM_SIGNAL_LN12_ERROR_W_Status m15884 : 39|1@1+ (1,0) [0|0] "1/0" Vector__XXX
 SG_ GD_ID_EMM_SIGNAL_LN12_ERROR_W m15884 : 40|16@1+ (1,0) [0|255] "" Vector__XXX
 SG_ GD_ID_EMM_SIGNAL_LN13_ERROR_W_Status m15885 : 39|1@1+ (1,0) [0|0] "1/0" Vector__XXX
 SG_ GD_ID_EMM_SIGNAL_LN13_ERROR_W m15885 : 40|16@1+ (1,0) [0|255] "" Vector__XXX
 SG_ GD_ID_EMM_SIGNAL_LN14_ERROR_W_Status m15886 : 39|1@1+ (1,0) [0|0] "1/0" Vector__XXX
 SG_ GD_ID_EMM_SIGNAL_LN14_ERROR_W m15886 : 40|16@1+ (1,0) [0|255] "" Vector__XXX
 SG_ GD_ID_EMM_SIGNAL_LN15_ERROR_W_Status m15887 : 39|1@1+ (1,0) [0|0] "1/0" Vector__XXX
 SG_ GD_ID_EMM_SIGNAL_LN15_ERROR_W m15887 : 40|16@1+ (1,0) [0|255] "" Vector__XXX
 SG_ GD_ID_EMM_SIGNAL_LN16_ERROR_W_Status m15888 : 39|1@1+ (1,0) [0|0] "1/0" Vector__XXX
 SG_ GD_ID_EMM_SIGNAL_LN16_ERROR_W m15888 : 40|16@1+ (1,0) [0|255] "" Vector__XXX
 SG_ GD_ID_EMM_SIGNAL_LN17_ERROR_W_Status m15889 : 39|1@1+ (1,0) [0|0] "1/0" Vector__XXX
 SG_ GD_ID_EMM_SIGNAL_LN17_ERROR_W m15889 : 40|16@1+ (1,0) [0|255] "" Vector__XXX
 SG_ GD_ID_EMM_SIGNAL_LN18_ERROR_W_Status m15890 : 39|1@1+ (1,0) [0|0] "1/0" Vector__XXX
 SG_ GD_ID_EMM_SIGNAL_LN18_ERROR_W m15890 : 40|16@1+ (1,0) [0|255] "" Vector__XXX
 SG_ GD_ID_EMM_SIGNAL_LN19_ERROR_W_Status m15891 : 39|1@1+ (1,0) [0|0] "1/0" Vector__XXX
 SG_ GD_ID_EMM_SIGNAL_LN19_ERROR_W m15891 : 40|16@1+ (1,0) [0|255] "" Vector__XXX
 SG_ GD_ID_EMM_SIGNAL_LN20_ERROR_W_Status m15892 : 39|1@1+ (1,0) [0|0] "1/0" Vector__XXX
 SG_ GD_ID_EMM_SIGNAL_LN20_ERROR_W m15892 : 40|16@1+ (1,0) [0|255] "" Vector__XXX
 SG_ GD_ID_EMM_SIGNAL_LN21_ERROR_W_Status m15893 : 39|1@1+ (1,0) [0|0] "1/0" Vector__XXX
 SG_ GD_ID_EMM_SIGNAL_LN21_ERROR_W m15893 : 40|16@1+ (1,0) [0|255] "" Vector__XXX
 SG_ GD_ID_EMM_SIGNAL_LN22_ERROR_W_Status m15894 : 39|1@1+ (1,0) [0|0] "1/0" Vector__XXX
 SG_ GD_ID_EMM_SIGNAL_LN22_ERROR_W m15894 : 40|16@1+ (1,0) [0|255] "" Vector__XXX
 SG_ GD_ID_EMM_SIGNAL_LN23_ERROR_W_Status m15895 : 39|1@1+ (1,0) [0|0] "1/0" Vector__XXX
 SG_ GD_ID_EMM_SIGNAL_LN23_ERROR_W m15895 : 40|16@1+ (1,0) [0|255] "" Vector__XXX
 SG_ GD_ID_EMM_SIGNAL_LN24_ERROR_W_Status m15896 : 39|1@1+ (1,0) [0|0] "1/0" Vector__XXX
 SG_ GD_ID_EMM_SIGNAL_LN24_ERROR_W m15896 : 40|16@1+ (1,0) [0|255] "" Vector__XXX
 SG_ GD_ID_EMM_SIGNAL_LN25_ERROR_W_Status m15897 : 39|1@1+ (1,0) [0|0] "1/0" Vector__XXX
 SG_ GD_ID_EMM_SIGNAL_LN25_ERROR_W m15897 : 40|16@1+ (1,0) [0|255] "" Vector__XXX
 SG_ GD_ID_EMM_SIGNAL_LN26_ERROR_W_Status m15898 : 39|1@1+ (1,0) [0|0] "1/0" Vector__XXX
 SG_ GD_ID_EMM_SIGNAL_LN26_ERROR_W m15898 : 40|16@1+ (1,0) [0|255] "" Vector__XXX
 SG_ GD_ID_EMM_SIGNAL_LN27_ERROR_W_Status m15899 : 39|1@1+ (1,0) [0|0] "1/0" Vector__XXX
 SG_ GD_ID_EMM_SIGNAL_LN27_ERROR_W m15899 : 40|16@1+ (1,0) [0|255] "" Vector__XXX
 SG_ GD_ID_EMM_SIGNAL_LN28_ERROR_W_Status m15900 : 39|1@1+ (1,0) [0|0] "1/0" Vector__XXX
 SG_ GD_ID_EMM_SIGNAL_LN28_ERROR_W m15900 : 40|16@1+ (1,0) [0|255] "" Vector__XXX
 SG_ GD_ID_EMM_SIGNAL_LN29_ERROR_W_Status m15901 : 39|1@1+ (1,0) [0|0] "1/0" Vector__XXX
 SG_ GD_ID_EMM_SIGNAL_LN29_ERROR_W m15901 : 40|16@1+ (1,0) [0|255] "" Vector__XXX
 SG_ GD_ID_EMM_SIGNAL_LN30_ERROR_W_Status m15902 : 39|1@1+ (1,0) [0|0] "1/0" Vector__XXX
 SG_ GD_ID_EMM_SIGNAL_LN30_ERROR_W m15902 : 40|16@1+ (1,0) [0|255] "" Vector__XXX
 SG_ GD_ID_EMM_SIGNAL_LN31_ERROR_W_Status m15903 : 39|1@1+ (1,0) [0|0] "1/0" Vector__XXX
 SG_ GD_ID_EMM_SIGNAL_LN31_ERROR_W m15903 : 40|16@1+ (1,0) [0|255] "" Vector__XXX
 SG_ GD_ID_EMM_SIGNAL_LN32_ERROR_W_Status m15904 : 39|1@1+ (1,0) [0|0] "1/0" Vector__XXX
 SG_ GD_ID_EMM_SIGNAL_LN32_ERROR_W m15904 : 40|16@1+ (1,0) [0|255] "" Vector__XXX
 SG_ GD_ID_EMM_SIGNAL_LN33_ERROR_W_Status m15905 : 39|1@1+ (1,0) [0|0] "1/0" Vector__XXX
 SG_ GD_ID_EMM_SIGNAL_LN33_ERROR_W m15905 : 40|16@1+ (1,0) [0|255] "" Vector__XXX
 SG_ GD_ID_EMM_SIGNAL_LN34_ERROR_W_Status m15906 : 39|1@1+ (1,0) [0|0] "1/0" Vector__XXX
 SG_ GD_ID_EMM_SIGNAL_LN34_ERROR_W m15906 : 40|16@1+ (1,0) [0|255] "" Vector__XXX
 SG_ GD_ID_EMM_SIGNAL_LN35_ERROR_W_Status m15907 : 39|1@1+ (1,0) [0|0] "1/0" Vector__XXX
 SG_ GD_ID_EMM_SIGNAL_LN35_ERROR_W m15907 : 40|16@1+ (1,0) [0|255] "" Vector__XXX
 SG_ GD_ID_EMM_SIGNAL_LN36_ERROR_W_Status m15908 : 39|1@1+ (1,0) [0|0] "1/0" Vector__XXX
 SG_ GD_ID_EMM_SIGNAL_LN36_ERROR_W m15908 : 40|16@1+ (1,0) [0|255] "" Vector__XXX
 SG_ GD_ID_EMM_SIGNAL_LN37_ERROR_W_Status m15909 : 39|1@1+ (1,0) [0|0] "1/0" Vector__XXX
 SG_ GD_ID_EMM_SIGNAL_LN37_ERROR_W m15909 : 40|16@1+ (1,0) [0|255] "" Vector__XXX
 SG_ GD_ID_EMM_SIGNAL_LN38_ERROR_W_Status m15910 : 39|1@1+ (1,0) [0|0] "1/0" Vector__XXX
 SG_ GD_ID_EMM_SIGNAL_LN38_ERROR_W m15910 : 40|16@1+ (1,0) [0|255] "" Vector__XXX
 SG_ GD_ID_EMM_SIGNAL_LN39_ERROR_W_Status m15911 : 39|1@1+ (1,0) [0|0] "1/0" Vector__XXX
 SG_ GD_ID_EMM_SIGNAL_LN39_ERROR_W m15911 : 40|16@1+ (1,0) [0|255] "" Vector__XXX
 SG_ GD_ID_EMM_SIGNAL_LN40_ERROR_W_Status m15912 : 39|1@1+ (1,0) [0|0] "1/0" Vector__XXX
 SG_ GD_ID_EMM_SIGNAL_LN40_ERROR_W m15912 : 40|16@1+ (1,0) [0|255] "" Vector__XXX
 SG_ GD_ID_EMM_SIGNAL_LN41_ERROR_W_Status m15913 : 39|1@1+ (1,0) [0|0] "1/0" Vector__XXX
 SG_ GD_ID_EMM_SIGNAL_LN41_ERROR_W m15913 : 40|16@1+ (1,0) [0|255] "" Vector__XXX
 SG_ GD_ID_EMM_SIGNAL_LN42_ERROR_W_Status m15914 : 39|1@1+ (1,0) [0|0] "1/0" Vector__XXX
 SG_ GD_ID_EMM_SIGNAL_LN42_ERROR_W m15914 : 40|16@1+ (1,0) [0|255] "" Vector__XXX
 SG_ GD_ID_EMM_SIGNAL_LN43_ERROR_W_Status m15915 : 39|1@1+ (1,0) [0|0] "1/0" Vector__XXX
 SG_ GD_ID_EMM_SIGNAL_LN43_ERROR_W m15915 : 40|16@1+ (1,0) [0|255] "" Vector__XXX
 SG_ GD_ID_EMM_SIGNAL_LN44_ERROR_W_Status m15916 : 39|1@1+ (1,0) [0|0] "1/0" Vector__XXX
 SG_ GD_ID_EMM_SIGNAL_LN44_ERROR_W m15916 : 40|16@1+ (1,0) [0|255] "" Vector__XXX
 SG_ GD_ID_EMM_SIGNAL_LN45_ERROR_W_Status m15917 : 39|1@1+ (1,0) [0|0] "1/0" Vector__XXX
 SG_ GD_ID_EMM_SIGNAL_LN45_ERROR_W m15917 : 40|16@1+ (1,0) [0|255] "" Vector__XXX
 SG_ GD_ID_EMM_SIGNAL_LN46_ERROR_W_Status m15918 : 39|1@1+ (1,0) [0|0] "1/0" Vector__XXX
 SG_ GD_ID_EMM_SIGNAL_LN46_ERROR_W m15918 : 40|16@1+ (1,0) [0|255] "" Vector__XXX
 SG_ GD_ID_EMM_SIGNAL_LN47_ERROR_W_Status m15919 : 39|1@1+ (1,0) [0|0] "1/0" Vector__XXX
 SG_ GD_ID_EMM_SIGNAL_LN47_ERROR_W m15919 : 40|16@1+ (1,0) [0|255] "" Vector__XXX
 SG_ GD_ID_EMM_SIGNAL_LN48_ERROR_W_Status m15920 : 39|1@1+ (1,0) [0|0] "1/0" Vector__XXX
 SG_ GD_ID_EMM_SIGNAL_LN48_ERROR_W m15920 : 40|16@1+ (1,0) [0|255] "" Vector__XXX
 SG_ GD_ID_EMM_SIGNAL_LN49_ERROR_W_Status m15921 : 39|1@1+ (1,0) [0|0] "1/0" Vector__XXX
 SG_ GD_ID_EMM_SIGNAL_LN49_ERROR_W m15921 : 40|16@1+ (1,0) [0|255] "" Vector__XXX
 SG_ GD_ID_EMM_SIGNAL_LN50_ERROR_W_Status m15922 : 39|1@1+ (1,0) [0|0] "1/0" Vector__XXX
 SG_ GD_ID_EMM_SIGNAL_LN50_ERROR_W m15922 : 40|16@1+ (1,0) [0|255] "" Vector__XXX
 SG_ GD_ID_EMM_SIGNAL_LN51_ERROR_W_Status m15923 : 39|1@1+ (1,0) [0|0] "1/0" Vector__XXX
 SG_ GD_ID_EMM_SIGNAL_LN51_ERROR_W m15923 : 40|16@1+ (1,0) [0|255] "" Vector__XXX
 SG_ GD_ID_EMM_SIGNAL_LN52_ERROR_W_Status m15924 : 39|1@1+ (1,0) [0|0] "1/0" Vector__XXX
 SG_ GD_ID_EMM_SIGNAL_LN52_ERROR_W m15924 : 40|16@1+ (1,0) [0|255] "" Vector__XXX
 SG_ GD_ID_EMM_SIGNAL_LN53_ERROR_W_Status m15925 : 39|1@1+ (1,0) [0|0] "1/0" Vector__XXX
 SG_ GD_ID_EMM_SIGNAL_LN53_ERROR_W m15925 : 40|16@1+ (1,0) [0|255] "" Vector__XXX
 SG_ GD_ID_EMM_SIGNAL_LN54_ERROR_W_Status m15926 : 39|1@1+ (1,0) [0|0] "1/0" Vector__XXX
 SG_ GD_ID_EMM_SIGNAL_LN54_ERROR_W m15926 : 40|16@1+ (1,0) [0|255] "" Vector__XXX
 SG_ GD_ID_EMM_SIGNAL_LN55_ERROR_W_Status m15927 : 39|1@1+ (1,0) [0|0] "1/0" Vector__XXX
 SG_ GD_ID_EMM_SIGNAL_LN55_ERROR_W m15927 : 40|16@1+ (1,0) [0|255] "" Vector__XXX
 SG_ GD_ID_EMM_SIGNAL_LN56_ERROR_W_Status m15928 : 39|1@1+ (1,0) [0|0] "1/0" Vector__XXX
 SG_ GD_ID_EMM_SIGNAL_LN56_ERROR_W m15928 : 40|16@1+ (1,0) [0|255] "" Vector__XXX
 SG_ GD_ID_EMM_SIGNAL_LN57_ERROR_W_Status m15929 : 39|1@1+ (1,0) [0|0] "1/0" Vector__XXX
 SG_ GD_ID_EMM_SIGNAL_LN57_ERROR_W m15929 : 40|16@1+ (1,0) [0|255] "" Vector__XXX
 SG_ GD_ID_EMM_SIGNAL_LN58_ERROR_W_Status m15930 : 39|1@1+ (1,0) [0|0] "1/0" Vector__XXX
 SG_ GD_ID_EMM_SIGNAL_LN58_ERROR_W m15930 : 40|16@1+ (1,0) [0|255] "" Vector__XXX
 SG_ GD_ID_EMM_SIGNAL_LN59_ERROR_W_Status m15931 : 39|1@1+ (1,0) [0|0] "1/0" Vector__XXX
 SG_ GD_ID_EMM_SIGNAL_LN59_ERROR_W m15931 : 40|16@1+ (1,0) [0|255] "" Vector__XXX
 SG_ GD_ID_EMM_SIGNAL_LN60_ERROR_W_Status m15932 : 39|1@1+ (1,0) [0|0] "1/0" Vector__XXX
 SG_ GD_ID_EMM_SIGNAL_LN60_ERROR_W m15932 : 40|16@1+ (1,0) [0|255] "" Vector__XXX
 SG_ GD_ID_EMM_SIGNAL_LN61_ERROR_W_Status m15933 : 39|1@1+ (1,0) [0|0] "1/0" Vector__XXX
 SG_ GD_ID_EMM_SIGNAL_LN61_ERROR_W m15933 : 40|16@1+ (1,0) [0|255] "" Vector__XXX
 SG_ GD_ID_EMM_SIGNAL_LN62_ERROR_W_Status m15934 : 39|1@1+ (1,0) [0|0] "1/0" Vector__XXX
 SG_ GD_ID_EMM_SIGNAL_LN62_ERROR_W m15934 : 40|16@1+ (1,0) [0|255] "" Vector__XXX
 SG_ GD_ID_EMM_SIGNAL_LN63_ERROR_W_Status m15935 : 39|1@1+ (1,0) [0|0] "1/0" Vector__XXX
 SG_ GD_ID_EMM_SIGNAL_LN63_ERROR_W m15935 : 40|16@1+ (1,0) [0|255] "" Vector__XXX
 SG_ GD_ID_EMM_TERMINAL_TRANSFER_R_Status m15938 : 39|1@1+ (1,0) [0|0] "1/0" Vector__XXX
 SG_ GD_ID_EMM_TERMINAL_TRANSFER_R m15938 : 40|16@1+ (1,0) [0|255] "" Vector__XXX
 SG_ GD_ID_EMM_ACM_TRANSFER_R_Status m15939 : 39|1@1+ (1,0) [0|0] "1/0" Vector__XXX
 SG_ GD_ID_EMM_ACM_TRANSFER_R m15939 : 40|16@1+ (1,0) [0|65535] "" Vector__XXX
 SG_ GD_ID_EMM_TERMINAL_ACKNOWLEDGE_W_Status m15970 : 39|1@1+ (1,0) [0|0] "1/0" Vector__XXX
 SG_ GD_ID_EMM_TERMINAL_ACKNOWLEDGE_W m15970 : 40|16@1+ (1,0) [0|255] "" Vector__XXX
 SG_ GD_ID_EMM_REQUEST_ENVVAR_W m16000 : 40|16@1+ (1,0) [0|255] "" Vector__XXX
 SG_ GD_ID_EMM_ENV_VAR_VALUE1 m16001 : 40|16@1+ (1,0) [0|65535] "" Vector__XXX
 SG_ GD_ID_EMM_ENV_VAR_VALUE2 m16002 : 40|16@1+ (1,0) [0|65535] "" Vector__XXX
 SG_ GD_ID_EMM_ENV_VAR_VALUE3 m16003 : 40|16@1+ (1,0) [0|65535] "" Vector__XXX
 SG_ GD_ID_EMM_ENV_VAR_VALUE4 m16004 : 40|16@1+ (1,0) [0|65535] "" Vector__XXX
 SG_ GD_ID_EMM_ENV_VAR_VALUE5 m16005 : 40|16@1+ (1,0) [0|65535] "" Vector__XXX
 SG_ GD_ID_EMM_ENV_VAR_OPERATING_HOUR m16006 : 40|16@1+ (1,0) [0|65535] "" Vector__XXX
 SG_ GD_ID_EMM_ENV_VAR_ERROR_COUNTER m16007 : 40|16@1+ (1,0) [0|65535] "" Vector__XXX
 SG_ GD_ID_EMM_ENV_VAR_DATE1 m16008 : 40|16@1+ (1,0) [0|65535] "" Vector__XXX
 SG_ GD_ID_EMM_ENV_VAR_DATE2 m16009 : 40|16@1+ (1,0) [0|65535] "" Vector__XXX
 SG_ GD_ID_EMM_ENV_VAR_TIME1 m16010 : 40|16@1+ (1,0) [0|65535] "" Vector__XXX
 SG_ GD_ID_EMM_ENV_VAR_TIME2 m16011 : 40|16@1+ (1,0) [0|65535] "" Vector__XXX
 SG_ GD_ID_EMM_ENV_VAR_STATUS m16012 : 40|16@1+ (1,0) [0|3] "" Vector__XXX
 SG_ GD_ID_EMM_DEBUG_SET_RESET_ERROR m16127 : 40|16@1+ (1,0) [0|255] "" Vector__XXX
 SG_ GD_ID_EMM_STATUS_R m16128 : 40|16@1+ (1,0) [0|65535] "" Vector__XXX
 SG_ GD_ID_EMM_ERR_LOG_DELETED_Status m16172 : 39|1@1+ (1,0) [0|0] "1/0" Vector__XXX
 SG_ GD_ID_EMM_ERR_LOG_DELETED m16172 : 40|16@1+ (1,0) [0|0] "" Vector__XXX
 SG_ GD_ID_EMM_ERR_ACTIVE_Status m16222 : 39|1@1+ (1,0) [0|0] "1/0" Vector__XXX
 SG_ GD_ID_EMM_ERR_ACTIVE m16222 : 40|16@1+ (1,0) [0|65535] "" Vector__XXX
 SG_ GD_ID_EMM_ErrorManagement_Status m16366 : 39|1@1+ (1,0) [0|0] "1/0" Vector__XXX
 SG_ GD_ID_EMM_ErrorManagement m16366 : 40|16@1+ (1,0) [0|255] "" Vector__XXX
 SG_ GD_ID_EMM_LifeMessage m16383 : 40|16@1+ (1,0) [0|65535] "ms" Vector__XXX

 SG_ GD_ID_PICTO_ErrorManagement_Status m15854 : 39|1@1+ (1,0) [0|0] "1/0" Vector__XXX
 SG_ GD_ID_PICTO_ErrorManagement m15854 : 40|16@1+ (1,0) [0|255] "" Vector__XXX
 SG_ GD_ID_PICTO_LifeMessage m15871 : 40|16@1+ (1,0) [0|65535] "[ms]" Vector__XXX

 SG_ GD_ID_EFC_REQ_PWM_PCT m26113 : 40|16@1+ (0.01,0) [0|10000] "%" Vector__XXX
 SG_ GD_ID_EFC_TARGET_FAN_SPD m26114 : 40|16@1- (0.125,0) [-32768|32767] "RPM" Vector__XXX
 SG_ GD_ID_EFC_COOLING_DEMAND m26115 : 40|16@1+ (0.01,0) [0|10000] "%" Vector__XXX
 SG_ GD_ID_EFC_USE_EC_Status m26122 : 39|1@1+ (1,0) [0|0] "1/0" Vector__XXX
 SG_ GD_ID_EFC_USE_EC m26122 : 40|16@1+ (1,0) [0|0] "" Vector__XXX
 SG_ GD_ID_EFC_FACTOR_EC m26123 : 40|16@1+ (0.01,0) [0|10000] "%" Vector__XXX
 SG_ GD_ID_EFC_MAX_TEMP_EC m26124 : 40|16@1+ (1,0) [0|200] "C" Vector__XXX
 SG_ GD_ID_EFC_MIN_TEMP_EC m26125 : 40|16@1+ (1,0) [0|200] "C" Vector__XXX
 SG_ GD_ID_EFC_USE_EF_Status m26126 : 39|1@1+ (1,0) [0|0] "1/0" Vector__XXX
 SG_ GD_ID_EFC_USE_EF m26126 : 40|16@1+ (1,0) [0|0] "" Vector__XXX
 SG_ GD_ID_EFC_FACTOR_EF m26127 : 40|16@1+ (0.01,0) [0|10000] "%" Vector__XXX
 SG_ GD_ID_EFC_MAX_TEMP_EF m26128 : 40|16@1+ (1,0) [0|200] "C" Vector__XXX
 SG_ GD_ID_EFC_MIN_TEMP_EF m26129 : 40|16@1+ (1,0) [0|200] "C" Vector__XXX
 SG_ GD_ID_EFC_USE_EM_Status m26130 : 39|1@1+ (1,0) [0|0] "1/0" Vector__XXX
 SG_ GD_ID_EFC_USE_EM m26130 : 40|16@1+ (1,0) [0|0] "" Vector__XXX
 SG_ GD_ID_EFC_FACTOR_EM m26131 : 40|16@1+ (0.01,0) [0|10000] "%" Vector__XXX
 SG_ GD_ID_EFC_MAX_TEMP_EM m26132 : 40|16@1+ (1,0) [0|200] "C" Vector__XXX
 SG_ GD_ID_EFC_MIN_TEMP_EM m26133 : 40|16@1+ (1,0) [0|200] "C" Vector__XXX
 SG_ GD_ID_EFC_USE_HO_Status m26134 : 39|1@1+ (1,0) [0|0] "1/0" Vector__XXX
 SG_ GD_ID_EFC_USE_HO m26134 : 40|16@1+ (1,0) [0|0] "" Vector__XXX
 SG_ GD_ID_EFC_FACTOR_HO m26135 : 40|16@1+ (0.01,0) [0|10000] "%" Vector__XXX
 SG_ GD_ID_EFC_MAX_TEMP_HO m26136 : 40|16@1+ (1,0) [0|200] "C" Vector__XXX
 SG_ GD_ID_EFC_MIN_TEMP_HO m26137 : 40|16@1+ (1,0) [0|200] "C" Vector__XXX
 SG_ GD_ID_EFC_USE_TO_Status m26138 : 39|1@1+ (1,0) [0|0] "1/0" Vector__XXX
 SG_ GD_ID_EFC_USE_TO m26138 : 40|16@1+ (1,0) [0|0] "" Vector__XXX
 SG_ GD_ID_EFC_FACTOR_TO m26139 : 40|16@1+ (0.01,0) [0|10000] "%" Vector__XXX
 SG_ GD_ID_EFC_MAX_TEMP_TO m26140 : 40|16@1+ (1,0) [0|200] "C" Vector__XXX
 SG_ GD_ID_EFC_MIN_TEMP_TO m26141 : 40|16@1+ (1,0) [0|200] "C" Vector__XXX
 SG_ GD_ID_EFC_USE_AC_Status m26142 : 39|1@1+ (1,0) [0|0] "1/0" Vector__XXX
 SG_ GD_ID_EFC_USE_AC m26142 : 40|16@1+ (1,0) [0|0] "" Vector__XXX
 SG_ GD_ID_EFC_FACTOR_AC m26143 : 40|16@1+ (0.01,0) [0|10000] "%" Vector__XXX
 SG_ GD_ID_EFC_PWM_OVERRIDE_Status m26144 : 39|1@1+ (1,0) [0|0] "1/0" Vector__XXX
 SG_ GD_ID_EFC_PWM_OVERRIDE m26144 : 40|16@1+ (0.01,0) [0|10000] "%" Vector__XXX
 SG_ GD_ID_EFC_TARGET_SPD_OVERRIDE_Status m26145 : 39|1@1+ (1,0) [0|0] "1/0" Vector__XXX
 SG_ GD_ID_EFC_TARGET_SPD_OVERRIDE m26145 : 40|16@1- (0.125,0) [-32768|32767] "RPM" Vector__XXX
 SG_ GD_ID_EFC_TARGET_FAN_WING_ANGLE_Status m26146 : 39|1@1+ (1,0) [0|0] "1/0" Vector__XXX
 SG_ GD_ID_EFC_TARGET_FAN_WING_ANGLE m26146 : 40|16@1+ (1,0) [0|400] "Deg" Vector__XXX
 SG_ GD_ID_EFC_ACTUAL_FAN_WING_ANGLE m26147 : 40|16@1+ (1,0) [0|1280] "Deg" Vector__XXX
 SG_ GD_ID_EFC_TARGET_COOLANT_TEMP m26148 : 40|16@1+ (1,0) [0|150] "C" Vector__XXX
 SG_ GD_ID_EFC_TARGET_MANIFOLD_TEMP m26149 : 40|16@1+ (1,0) [0|150] "C" Vector__XXX
 SG_ GD_ID_EFC_COOLANT_I_GAIN m26150 : 40|16@1+ (1,0) [0|1000] "scaledRatio" Vector__XXX
 SG_ GD_ID_EFC_COOLANT_P_A_GAIN m26151 : 40|16@1+ (1,0) [0|1000] "scaledRatio" Vector__XXX
 SG_ GD_ID_EFC_COOLANT_P_B_GAIN m26152 : 40|16@1+ (1,0) [0|1000] "scaledRatio" Vector__XXX
 SG_ GD_ID_EFC_COOLANT_P_C_GAIN m26153 : 40|16@1+ (1,0) [0|1000] "scaledRatio" Vector__XXX
 SG_ GD_ID_EFC_MANIFOLD_I_GAIN m26154 : 40|16@1+ (1,0) [0|1000] "scaledRatio" Vector__XXX
 SG_ GD_ID_EFC_MANIFOLD_P_A_GAIN m26155 : 40|16@1+ (1,0) [0|1000] "scaledRatio" Vector__XXX
 SG_ GD_ID_EFC_MANIFOLD_P_B_GAIN m26156 : 40|16@1+ (1,0) [0|1000] "scaledRatio" Vector__XXX
 SG_ GD_ID_EFC_MANIFOLD_P_C_GAIN m26157 : 40|16@1+ (1,0) [0|1000] "scaledRatio" Vector__XXX
 SG_ GD_ID_EFC_INLET_VALVE_P_GAIN m26158 : 40|16@1+ (1,0) [0|1000] "scaledRatio" Vector__XXX
 SG_ GD_ID_EFC_INLET_VALVE_I_TIME m26159 : 40|16@1+ (1,0) [0|1000] "msec" Vector__XXX
 SG_ GD_ID_EFC_INLET_ACTIVATION_CYCLES m26160 : 40|16@1+ (1,0) [0|1000] "cycles" Vector__XXX
 SG_ GD_ID_EFC_INLET_GRADIENT_TRESHOLD m26161 : 40|16@1+ (1,0) [0|1000] "1/1000 Deg" Vector__XXX
 SG_ GD_ID_EFC_INLET_MAX_ENERGIZE_TIME m26162 : 40|16@1+ (1,0) [0|1000] "msec" Vector__XXX
 SG_ GD_ID_EFC_OUTLET_VALVE_P_GAIN m26163 : 40|16@1+ (1,0) [0|1000] "scaledRatio" Vector__XXX
 SG_ GD_ID_EFC_OUTLET_VALVE_I_TIME m26164 : 40|16@1+ (1,0) [0|1000] "msec" Vector__XXX
 SG_ GD_ID_EFC_OUTLET_ACTIVATION_CYCLES m26165 : 40|16@1+ (1,0) [0|1000] "cycles" Vector__XXX
 SG_ GD_ID_EFC_OUTLET_GRADIENT_TRESHOLD m26166 : 40|16@1+ (1,0) [0|1000] "1/1000 Deg" Vector__XXX
 SG_ GD_ID_EFC_OUTLET_MAX_ENERGIZE_TIME m26167 : 40|16@1+ (1,0) [0|1000] "msec" Vector__XXX
 SG_ GD_ID_EFC_STARTUP_STATE m26168 : 40|16@1+ (1,0) [0|4] "enum" Vector__XXX
 SG_ GD_ID_EFC_FAN_ANGLE_WINNER m26169 : 40|16@1+ (1,0) [0|17] "enum" Vector__XXX
 SG_ GD_ID_EFC_REVERSE_LOCK_REASONS m26170 : 40|16@1+ (1,0) [0|4096] "enum" Vector__XXX
 SG_ GD_ID_EFC_ERROR_REASONS m26171 : 40|16@1+ (1,0) [0|16384] "enum" Vector__XXX
 SG_ GD_ID_EFC_REVERSE_STATE_Status m26172 : 39|1@1+ (1,0) [0|0] "1/0" Vector__XXX
 SG_ GD_ID_EFC_REVERSE_STATE m26172 : 40|16@1+ (1,0) [0|3] "enum" Vector__XXX
 SG_ GD_ID_EFC_REVERSIBLE_FAN_RPM m26173 : 40|16@1+ (1,0) [0|2500] "rpm" Vector__XXX
 SG_ GD_ID_EFC_INLET_PAUSE_TIME m26174 : 40|16@1+ (1,0) [0|2000] "msec" Vector__XXX
 SG_ GD_ID_EFC_INLET_PAUSE_TIME_EXTENSION m26175 : 40|16@1+ (1,0) [0|10000] "msec" Vector__XXX
 SG_ GD_ID_EFC_OUTLET_PAUSE_TIME m26176 : 40|16@1+ (1,0) [0|2000] "msec" Vector__XXX
 SG_ GD_ID_EFC_OUTLET_PAUSE_TIME_EXTENSION m26177 : 40|16@1+ (1,0) [0|10000] "msec" Vector__XXX
 SG_ GD_ID_EFC_START_MANUAL_REVERSING m26178 : 40|16@1+ (1,0) [0|1] "state" Vector__XXX
 SG_ GD_ID_EFC_STOP_REVERSING m26179 : 40|16@1+ (1,0) [0|1] "state" Vector__XXX
 SG_ GD_ID_EFC_ENABLE_AUTOMATIC_REVERSING m26180 : 40|16@1+ (1,0) [0|1] "state" Vector__XXX
 SG_ GD_ID_EFC_BLOW_OUT_DURATION m26181 : 40|16@1+ (1,0) [10|140] "s" Vector__XXX
 SG_ GD_ID_EFC_BLOW_OUT_PERIOD m26182 : 40|16@1+ (1,0) [1|240] "min" Vector__XXX
 SG_ GD_ID_EFC_ANGLE_SENSOR_VOLTAGE m26183 : 40|16@1+ (1,0) [0|5000] "mV" Vector__XXX
 SG_ GD_ID_EFC_BLOW_OUT_DURATION_MIN m26184 : 40|16@1+ (1,0) [10|140] "s" Vector__XXX
 SG_ GD_ID_EFC_BLOW_OUT_DURATION_MAX m26185 : 40|16@1+ (1,0) [10|140] "s" Vector__XXX
 SG_ GD_ID_EFC_BLOW_OUT_PERIOD_MIN m26186 : 40|16@1+ (1,0) [1|240] "min" Vector__XXX
 SG_ GD_ID_EFC_BLOW_OUT_PERIOD_MAX m26187 : 40|16@1+ (1,0) [1|240] "min" Vector__XXX
 SG_ GD_ID_EFC_ErrorManagement_Status m26606 : 39|1@1+ (1,0) [0|0] "1/0" Vector__XXX
 SG_ GD_ID_EFC_ErrorManagement m26606 : 40|16@1+ (1,0) [0|255] "" Vector__XXX
 SG_ GD_ID_EFC_LifeMessage m26623 : 40|16@1+ (1,0) [0|65535] "[ms]" Vector__XXX

 SG_ GD_ID_ECAD_LOGIC_STATE m26624 : 40|16@1+ (1,0) [0|9] "enum" Vector__XXX
 SG_ GD_ID_ECAD_VALVE_STATE m26625 : 40|16@1+ (1,0) [0|2] "enum" Vector__XXX
 SG_ GD_ID_ECAD_GOVENOR_VALVE_Status m26626 : 39|1@1+ (1,0) [0|0] "1/0" Vector__XXX
 SG_ GD_ID_ECAD_GOVENOR_VALVE m26626 : 40|16@1+ (1,0) [0|2000] "mA" Vector__XXX
 SG_ GD_ID_ECAD_REGEN_VALVE_Status m26627 : 39|1@1+ (1,0) [0|0] "1/0" Vector__XXX
 SG_ GD_ID_ECAD_REGEN_VALVE m26627 : 40|16@1+ (1,0) [0|2000] "mA" Vector__XXX
 SG_ GD_ID_ECAD_AIR_VOLUME m26628 : 40|16@1+ (1,0) [0|1500] "L" Vector__XXX
 SG_ GD_ID_ECAD_REGEN_VOLUME m26629 : 40|16@1+ (1,0) [0|180] "L" Vector__XXX
 SG_ GD_ID_ECAD_REGEN_TARGET m26630 : 40|16@1+ (1,0) [0|1500] "L" Vector__XXX
 SG_ GD_ID_ECAD_COMPRESSOR_RPM m26631 : 40|16@1+ (1,0) [0|2000] "rpm" Vector__XXX
 SG_ GD_ID_ECAD_AIR_FLOW m26632 : 40|16@1+ (0.1,0) [0|600] "lps" Vector__XXX
 SG_ GD_ID_ECAD_REGEN_FLOW m26633 : 40|16@1+ (0.1,0) [0|72] "lps" Vector__XXX
 SG_ GD_ID_ECAD_REGEN_FLOW_SCALED m26634 : 40|16@1+ (0.1,0) [0|600] "lps" Vector__XXX
 SG_ GD_ID_ECAD_NET_FLOW m26635 : 40|16@1- (0.1,0) [-600|600] "lps" Vector__XXX
 SG_ GD_ID_ECAD_HEATER_Status m26636 : 39|1@1+ (1,0) [0|0] "1/0" Vector__XXX
 SG_ GD_ID_ECAD_HEATER m26636 : 40|16@1+ (1,0) [0|3000] "mA" Vector__XXX
 SG_ GD_ID_ECAD_ErrorManagement_Status m27118 : 39|1@1+ (1,0) [0|0] "1/0" Vector__XXX
 SG_ GD_ID_ECAD_ErrorManagement m27118 : 40|16@1+ (1,0) [0|255] "" Vector__XXX
 SG_ GD_ID_ECAD_LifeMessage m27135 : 40|16@1+ (1,0) [0|65535] "[ms]" Vector__XXX

 SG_ GD_ID_4WS_REQUESTED_MODE m28161 : 40|16@1+ (1,0) [0|4] "" Vector__XXX
 SG_ GD_ID_4WS_CURRENT_MODE m28162 : 40|16@1+ (1,0) [0|4] "" Vector__XXX
 SG_ GD_ID_4WS_JOG_LEFT_Status m28166 : 39|1@1+ (1,0) [0|0] "1/0" Vector__XXX
 SG_ GD_ID_4WS_JOG_LEFT m28166 : 40|16@1+ (1,0) [0|1] "ON/OFF" Vector__XXX
 SG_ GD_ID_4WS_JOG_RIGHT_Status m28167 : 39|1@1+ (1,0) [0|0] "1/0" Vector__XXX
 SG_ GD_ID_4WS_JOG_RIGHT m28167 : 40|16@1+ (1,0) [0|1] "ON/OFF" Vector__XXX
 SG_ GD_ID_4WS_JOG_CLEAR_Status m28168 : 39|1@1+ (1,0) [0|0] "1/0" Vector__XXX
 SG_ GD_ID_4WS_JOG_CLEAR m28168 : 40|16@1+ (1,0) [0|1] "ON/OFF" Vector__XXX
 SG_ GD_ID_4WS_JOG_ANGLE_Status m28169 : 39|1@1+ (1,0) [0|0] "1/0" Vector__XXX
 SG_ GD_ID_4WS_JOG_ANGLE m28169 : 40|16@1+ (0.1,0) [0|25] "deg" Vector__XXX
 SG_ GD_ID_4WS_UI_FRONT_ANGLE_Status m28175 : 39|1@1+ (1,0) [0|0] "1/0" Vector__XXX
 SG_ GD_ID_4WS_UI_FRONT_ANGLE m28175 : 40|16@1+ (0.2,0) [0|175] "deg" Vector__XXX
 SG_ GD_ID_4WS_UI_REAR_ANGLE_Status m28176 : 39|1@1+ (1,0) [0|0] "1/0" Vector__XXX
 SG_ GD_ID_4WS_UI_REAR_ANGLE m28176 : 40|16@1+ (0.2,0) [0|175] "deg" Vector__XXX
 SG_ GD_ID_4WS_MACHINE_REAR_ANGLE m28178 : 40|16@1- (0.01,0) [-4500|4500] "deg" Vector__XXX
 SG_ GD_ID_4WS_REAR_ANGLE_SETPOINT m28179 : 40|16@1- (0.01,0) [-4500|4500] "deg" Vector__XXX
 SG_ GD_ID_4WS_REAR_ANGLE_SENSOR_VALUE m28180 : 40|16@1+ (0,0) [0|20000] "uA" Vector__XXX
 SG_ GD_ID_4WS_CURRENT_CONTROL_KP_Status m28183 : 39|1@1+ (1,0) [0|0] "1/0" Vector__XXX
 SG_ GD_ID_4WS_CURRENT_CONTROL_KP m28183 : 40|16@1+ (1,0) [0|65535] "" Vector__XXX
 SG_ GD_ID_4WS_CURRENT_CONTROL_KI_Status m28184 : 39|1@1+ (1,0) [0|0] "1/0" Vector__XXX
 SG_ GD_ID_4WS_CURRENT_CONTROL_KI m28184 : 40|16@1+ (1,0) [0|65535] "" Vector__XXX
 SG_ GD_ID_4WS_REAR_ANGLE_TARGET_Status m28185 : 39|1@1+ (1,0) [0|0] "1/0" Vector__XXX
 SG_ GD_ID_4WS_REAR_ANGLE_TARGET m28185 : 40|16@1- (1,0) [-45|45] "deg" Vector__XXX
 SG_ GD_ID_4WS_LEFT_PWM_Status m28186 : 39|1@1+ (1,0) [0|0] "1/0" Vector__XXX
 SG_ GD_ID_4WS_LEFT_PWM m28186 : 40|16@1+ (1,0) [0|100] "%" Vector__XXX
 SG_ GD_ID_4WS_RIGHT_PWM_Status m28187 : 39|1@1+ (1,0) [0|0] "1/0" Vector__XXX
 SG_ GD_ID_4WS_RIGHT_PWM m28187 : 40|16@1+ (1,0) [0|100] "%" Vector__XXX
 SG_ GD_ID_4WS_RIGHT_VALVE_COIL_CURRENT m28191 : 40|16@1+ (1,0) [0|5000] "mA" Vector__XXX
 SG_ GD_ID_4WS_LEFT_VALVE_COIL_CURRENT m28192 : 40|16@1+ (1,0) [0|5000] "mA" Vector__XXX
 SG_ GD_ID_4WS_ANGLE_CONTROL_KP_Status m28193 : 39|1@1+ (1,0) [0|0] "1/0" Vector__XXX
 SG_ GD_ID_4WS_ANGLE_CONTROL_KP m28193 : 40|16@1+ (1,0) [0|65535] "" Vector__XXX
 SG_ GD_ID_4WS_ANGLE_CONTROL_KI_Status m28194 : 39|1@1+ (1,0) [0|0] "1/0" Vector__XXX
 SG_ GD_ID_4WS_ANGLE_CONTROL_KI m28194 : 40|16@1+ (1,0) [0|65535] "" Vector__XXX
 SG_ GD_ID_4WS_TARGET_CURRENT_Status m28195 : 39|1@1+ (1,0) [0|0] "1/0" Vector__XXX
 SG_ GD_ID_4WS_TARGET_CURRENT m28195 : 40|16@1+ (1,0) [0|5000] "mA" Vector__XXX
 SG_ GD_ID_4WS_CURRENT_CONTROL_KC_Status m28196 : 39|1@1+ (1,0) [0|0] "1/0" Vector__XXX
 SG_ GD_ID_4WS_CURRENT_CONTROL_KC m28196 : 40|16@1+ (1,0) [0|65535] "" Vector__XXX
 SG_ GD_ID_4WS_COMMAND_CURRENT_Status m28201 : 39|1@1+ (1,0) [0|0] "1/0" Vector__XXX
 SG_ GD_ID_4WS_COMMAND_CURRENT m28201 : 40|16@1+ (1,0) [0|3000] "mA" Vector__XXX
 SG_ GD_ID_4WS_ACTIVE_CURRENT_LOOP m28202 : 40|16@1+ (1,0) [0|3] "enum" Vector__XXX
 SG_ GD_ID_4WS_UNFILTERED_REAR_ANGLE_Status m28203 : 39|1@1+ (1,0) [0|0] "1/0" Vector__XXX
 SG_ GD_ID_4WS_UNFILTERED_REAR_ANGLE m28203 : 40|16@1+ (0.2,0) [0|175] "deg" Vector__XXX
 SG_ GD_ID_4WS_START_CURRENT_CALIB_COMMAND m28210 : 40|16@1+ (0,0) [0|65535] "enum" Vector__XXX
 SG_ GD_ID_4WS_START_CURRENT_CALIB_STATUS m28211 : 40|16@1+ (0,0) [0|65535] "enum" Vector__XXX
 SG_ GD_ID_4WS_REAR_ANGLE_CALIB_COMMAND m28260 : 40|16@1+ (0,0) [0|65535] "enum" Vector__XXX
 SG_ GD_ID_4WS_REAR_ANGLE_CALIB_STATUS m28261 : 40|16@1+ (0,0) [0|65535] "enum" Vector__XXX
 SG_ GD_ID_4WS_ErrorManagement_Status m28654 : 39|1@1+ (1,0) [0|0] "1/0" Vector__XXX
 SG_ GD_ID_4WS_ErrorManagement m28654 : 40|16@1+ (1,0) [0|255] "" Vector__XXX
 SG_ GD_ID_4WS_LifeMessage m28671 : 40|16@1+ (1,0) [0|65535] "" Vector__XXX

 SG_ GD_ID_DASH_HAZARDS_LIGHT_Status m1 : 39|1@1+ (1,0) [0|0] "1/0" Vector__XXX
 SG_ GD_ID_DASH_HAZARDS_LIGHT m1 : 40|16@1+ (1,0) [0|0] "" Vector__XXX
 SG_ GD_ID_DASH_BLINKER_TRAILER_1_Status m2 : 39|1@1+ (1,0) [0|0] "1/0" Vector__XXX
 SG_ GD_ID_DASH_BLINKER_TRAILER_1 m2 : 40|16@1+ (1,0) [0|0] "" Vector__XXX
 SG_ GD_ID_DASH_BLINKER_TRAILER_2_Status m3 : 39|1@1+ (1,0) [0|0] "1/0" Vector__XXX
 SG_ GD_ID_DASH_BLINKER_TRAILER_2 m3 : 40|16@1+ (1,0) [0|0] "" Vector__XXX
 SG_ GD_ID_DASH_BLINKER_LEFT_Status m4 : 39|1@1+ (1,0) [0|0] "1/0" Vector__XXX
 SG_ GD_ID_DASH_BLINKER_LEFT m4 : 40|16@1+ (1,0) [0|0] "" Vector__XXX
 SG_ GD_ID_DASH_BLINKER_RIGHT_Status m5 : 39|1@1+ (1,0) [0|0] "1/0" Vector__XXX
 SG_ GD_ID_DASH_BLINKER_RIGHT m5 : 40|16@1+ (1,0) [0|0] "" Vector__XXX
 SG_ GD_ID_DASH_HIGH_BEAM_LIGHT_Status m6 : 39|1@1+ (1,0) [0|0] "1/0" Vector__XXX
 SG_ GD_ID_DASH_HIGH_BEAM_LIGHT m6 : 40|16@1+ (1,0) [0|0] "" Vector__XXX
 SG_ GD_ID_DASH_FORWARD_DRIVE_DIRECTION_ARROW m7 : 40|16@1+ (1,0) [0|2] "" Vector__XXX
 SG_ GD_ID_DASH_REVERSE_DRIVE_DIRECTION_ARROW m8 : 40|16@1+ (1,0) [0|2] "" Vector__XXX
 SG_ GD_ID_DASH_CRUISE_CONTROL_LIGHT_Status m10 : 39|1@1+ (1,0) [0|0] "1/0" Vector__XXX
 SG_ GD_ID_DASH_CRUISE_CONTROL_LIGHT m10 : 40|16@1+ (1,0) [0|0] "" Vector__XXX
 SG_ GD_ID_DASH_4WD_LIGHT_Status m11 : 39|1@1+ (1,0) [0|0] "1/0" Vector__XXX
 SG_ GD_ID_DASH_4WD_LIGHT m11 : 40|16@1+ (1,0) [0|0] "" Vector__XXX
 SG_ GD_ID_DASH_DIFFERENTIAL_LOCK_LIGHT_Status m12 : 39|1@1+ (1,0) [0|0] "1/0" Vector__XXX
 SG_ GD_ID_DASH_DIFFERENTIAL_LOCK_LIGHT m12 : 40|16@1+ (1,0) [0|0] "" Vector__XXX
 SG_ GD_ID_DASH_BRAKE_PAD_WEAR_LIGHT_Status m13 : 39|1@1+ (1,0) [0|0] "1/0" Vector__XXX
 SG_ GD_ID_DASH_BRAKE_PAD_WEAR_LIGHT m13 : 40|16@1+ (1,0) [0|0] "" Vector__XXX
 SG_ GD_ID_DASH_HYDRAULIC_OIL_TEMP m14 : 40|16@1+ (1,-40) [0|250] "°C" Vector__XXX
 SG_ GD_ID_DASH_AIR_FILTER_POLUTION_Status m15 : 39|1@1+ (1,0) [0|0] "1/0" Vector__XXX
 SG_ GD_ID_DASH_AIR_FILTER_POLUTION m15 : 40|16@1+ (1,0) [0|0] "" Vector__XXX
 SG_ GD_ID_DASH_BRAKE_FLUID_LEVEL_LIGHT_Status m16 : 39|1@1+ (1,0) [0|0] "1/0" Vector__XXX
 SG_ GD_ID_DASH_BRAKE_FLUID_LEVEL_LIGHT m16 : 40|16@1+ (1,0) [0|0] "" Vector__XXX
 SG_ GD_ID_DASH_ENGINE_OIL_PRESSURE_Status m17 : 39|1@1+ (1,0) [0|0] "1/0" Vector__XXX
 SG_ GD_ID_DASH_ENGINE_OIL_PRESSURE m17 : 40|16@1+ (0.04,0) [0|10] "bar" Vector__XXX
 SG_ GD_ID_DASH_CHARGE_AIR_TEMPERATURE m18 : 40|16@1+ (1,-40) [0|215] "°C" Vector__XXX
 SG_ GD_ID_DASH_ENGINE_COOLANT_TEMPERATURE_BAR_GRAPH m19 : 40|16@1+ (1,0) [0|100] "%" Vector__XXX
 SG_ GD_ID_DASH_FUEL_LEVEL_BAR_GRAPH m20 : 40|16@1+ (1,0) [0|100] "%" Vector__XXX
 SG_ GD_ID_DASH_AIR_PRESSURE_LEVEL_1_BAR_GRAPH m21 : 40|16@1+ (1,0) [0|100] "%" Vector__XXX
 SG_ GD_ID_DASH_AIR_PRESSURE_LEVEL_2 m22 : 40|16@1+ (1,0) [0|100] "%" Vector__XXX
 SG_ GD_ID_DASH_DEF_LEVEL_BAR_GRAPH m23 : 40|16@1+ (1,0) [0|100] "%" Vector__XXX
 SG_ GD_ID_DASH_ENGINE_SPEED m24 : 40|16@1+ (0.1,0) [0|9990] "rpm" Vector__XXX
 SG_ GD_ID_DASH_FRONT_PTO_SPEED m25 : 40|16@1+ (0.1,0) [0|9990] "rpm" Vector__XXX
 SG_ GD_ID_DASH_REAR_PTO_SPEED m26 : 40|16@1+ (0.1,0) [0|9990] "rpm" Vector__XXX
 SG_ GD_ID_DASH_THEORETICAL_VEHICLE_SPEED m27 : 40|16@1+ (0.01,0) [0|990] "rpm" Vector__XXX
 SG_ GD_ID_DASH_ACTUAL_VEHICLE_SPEED m28 : 40|16@1+ (0.01,0) [0|990] "rpm" Vector__XXX
 SG_ GD_ID_DASH_REAR_PTO_STATUS_Status m29 : 39|1@1+ (1,0) [0|0] "1/0" Vector__XXX
 SG_ GD_ID_DASH_REAR_PTO_STATUS m29 : 40|16@1+ (1,0) [0|0] "" Vector__XXX
 SG_ GD_ID_DASH_REAR_PTO_POSITION m30 : 40|16@1+ (1,0) [0|100] "%" Vector__XXX
 SG_ GD_ID_DASH_BUTTON_PRESSED_ENTER_Status m31 : 39|1@1+ (1,0) [0|0] "1/0" Vector__XXX
 SG_ GD_ID_DASH_BUTTON_PRESSED_ENTER m31 : 40|16@1+ (1,0) [0|0] "" Vector__XXX
 SG_ GD_ID_DASH_BUTTON_PRESSED_ESC_Status m32 : 39|1@1+ (1,0) [0|0] "1/0" Vector__XXX
 SG_ GD_ID_DASH_BUTTON_PRESSED_ESC m32 : 40|16@1+ (1,0) [0|0] "" Vector__XXX
 SG_ GD_ID_DASH_BUTTON_PRESSED_CURSOR_UP_Status m33 : 39|1@1+ (1,0) [0|0] "1/0" Vector__XXX
 SG_ GD_ID_DASH_BUTTON_PRESSED_CURSOR_UP m33 : 40|16@1+ (1,0) [0|0] "" Vector__XXX
 SG_ GD_ID_DASH_BUTTON_PRESSED_CURSOR_DOWN_Status m34 : 39|1@1+ (1,0) [0|0] "1/0" Vector__XXX
 SG_ GD_ID_DASH_BUTTON_PRESSED_CURSOR_DOWN m34 : 40|16@1+ (1,0) [0|0] "" Vector__XXX
 SG_ GD_ID_DASH_COLD_START_LIGHT_Status m37 : 39|1@1+ (1,0) [0|0] "1/0" Vector__XXX
 SG_ GD_ID_DASH_COLD_START_LIGHT m37 : 40|16@1+ (1,0) [0|0] "" Vector__XXX
 SG_ GD_ID_DASH_SHOW_ENGINE_SPEED_SYMBOL_Status m38 : 39|1@1+ (1,0) [0|0] "1/0" Vector__XXX
 SG_ GD_ID_DASH_SHOW_ENGINE_SPEED_SYMBOL m38 : 40|16@1+ (1,0) [0|0] "" Vector__XXX
 SG_ GD_ID_DASH_SHOW_FRONT_PTO_SPEED_SYMBOL_Status m39 : 39|1@1+ (1,0) [0|0] "1/0" Vector__XXX
 SG_ GD_ID_DASH_SHOW_FRONT_PTO_SPEED_SYMBOL m39 : 40|16@1+ (1,0) [0|0] "" Vector__XXX
 SG_ GD_ID_DASH_SHOW_REAR_PTO_SPEED_SYMBOL_Status m40 : 39|1@1+ (1,0) [0|0] "1/0" Vector__XXX
 SG_ GD_ID_DASH_SHOW_REAR_PTO_SPEED_SYMBOL m40 : 40|16@1+ (1,0) [0|0] "" Vector__XXX
 SG_ GD_ID_DASH_SHOW_ACTUAL_SPEED_SYMBOL_Status m41 : 39|1@1+ (1,0) [0|0] "1/0" Vector__XXX
 SG_ GD_ID_DASH_SHOW_ACTUAL_SPEED_SYMBOL m41 : 40|16@1+ (1,0) [0|0] "" Vector__XXX
 SG_ GD_ID_DASH_SHOW_CRUISE_CONTROL_SPEED_SYMBOL_Status m42 : 39|1@1+ (1,0) [0|0] "1/0" Vector__XXX
 SG_ GD_ID_DASH_SHOW_CRUISE_CONTROL_SPEED_SYMBOL m42 : 40|16@1+ (1,0) [0|0] "" Vector__XXX
 SG_ GD_ID_DASH_SHOW_KMPH_SYMBOL_Status m43 : 39|1@1+ (1,0) [0|0] "1/0" Vector__XXX
 SG_ GD_ID_DASH_SHOW_KMPH_SYMBOL m43 : 40|16@1+ (1,0) [0|0] "" Vector__XXX
 SG_ GD_ID_DASH_SHOW_MPH_SYMBOL_Status m44 : 39|1@1+ (1,0) [0|0] "1/0" Vector__XXX
 SG_ GD_ID_DASH_SHOW_MPH_SYMBOL m44 : 40|16@1+ (1,0) [0|0] "" Vector__XXX
 SG_ GD_ID_DASH_BACKLIGHT_INTENSITY m45 : 40|16@1+ (1,0) [0|100] "%" Vector__XXX
 SG_ GD_ID_DASH_OPERATING_HOURS_Status m46 : 39|1@1+ (1,0) [0|0] "1/0" Vector__XXX
 SG_ GD_ID_DASH_OPERATING_HOURS m46 : 40|16@1+ (1,0) [0|19999] "h" Vector__XXX
 SG_ GD_ID_DASH_TIME_MINUTES_AND_HOURS m47 : 40|16@1+ (1,0) [0|65535] "min" Vector__XXX
 SG_ GD_ID_DASH_TIME_SECONDS m48 : 40|16@1+ (1,0) [0|60] "s" Vector__XXX
 SG_ GD_ID_DASH_TRANSMISSION_NEUTRAL_STATUS_Status m50 : 39|1@1+ (1,0) [0|0] "1/0" Vector__XXX
 SG_ GD_ID_DASH_TRANSMISSION_NEUTRAL_STATUS m50 : 40|16@1+ (1,0) [0|65535] "" Vector__XXX
 SG_ GD_ID_DASH_FILTER_CONTAMINATION_Status m51 : 39|1@1+ (1,0) [0|0] "1/0" Vector__XXX
 SG_ GD_ID_DASH_FILTER_CONTAMINATION m51 : 40|16@1+ (1,0) [0|65535] "" Vector__XXX
 SG_ GD_ID_DASH_SPARE_OUTPUT_1 m52 : 40|16@1+ (1,0) [0|65535] "mV/%" Vector__XXX
 SG_ GD_ID_DASH_SPARE_OUTPUT_2 m53 : 40|16@1+ (1,0) [0|65535] "mV/%" Vector__XXX
 SG_ GD_ID_DASH_ABS_TRAILER_LIGHT_Status m54 : 39|1@1+ (1,0) [0|0] "1/0" Vector__XXX
 SG_ GD_ID_DASH_ABS_TRAILER_LIGHT m54 : 40|16@1+ (1,0) [0|0] "" Vector__XXX
 SG_ GD_ID_DASH_TRAILER_BRAKE_LIGHT_Status m55 : 39|1@1+ (1,0) [0|0] "1/0" Vector__XXX
 SG_ GD_ID_DASH_TRAILER_BRAKE_LIGHT m55 : 40|16@1+ (1,0) [0|0] "" Vector__XXX
 SG_ GD_ID_DASH_REAR_FOG_LIGHT_Status m56 : 39|1@1+ (1,0) [0|0] "1/0" Vector__XXX
 SG_ GD_ID_DASH_REAR_FOG_LIGHT m56 : 40|16@1+ (1,0) [0|0] "" Vector__XXX
 SG_ GD_ID_DASH_BUZZER_UNDERTONE_Status m58 : 39|1@1+ (1,0) [0|0] "1/0" Vector__XXX
 SG_ GD_ID_DASH_BUZZER_UNDERTONE m58 : 40|16@1+ (1,0) [0|0] "" Vector__XXX
 SG_ GD_ID_DASH_BUZZER_LOUD_Status m59 : 39|1@1+ (1,0) [0|0] "1/0" Vector__XXX
 SG_ GD_ID_DASH_BUZZER_LOUD m59 : 40|16@1+ (1,0) [0|0] "" Vector__XXX
 SG_ GD_ID_DASH_ABS_TRACTOR_LIGHT_Status m60 : 39|1@1+ (1,0) [0|0] "1/0" Vector__XXX
 SG_ GD_ID_DASH_ABS_TRACTOR_LIGHT m60 : 40|16@1+ (1,0) [0|0] "" Vector__XXX
 SG_ GD_ID_DASH_SPARE_LIGHT_2_Status m61 : 39|1@1+ (1,0) [0|0] "1/0" Vector__XXX
 SG_ GD_ID_DASH_SPARE_LIGHT_2 m61 : 40|16@1+ (1,0) [0|0] "" Vector__XXX
 SG_ GD_ID_DASH_DATE_YEAR m70 : 40|16@1+ (1,0) [0|9999] "Year" Vector__XXX
 SG_ GD_ID_DASH_DATE_MONTH_DAY m71 : 40|16@1+ (1,0) [0|65535] "Month & Day" Vector__XXX
 SG_ GD_ID_DASH_LOCK_STATUS_Status m72 : 39|1@1+ (1,0) [0|0] "1/0" Vector__XXX
 SG_ GD_ID_DASH_LOCK_STATUS m72 : 40|16@1+ (1,0) [0|0] "" Vector__XXX
 SG_ GD_ID_MFA_FunctionLighting m1696 : 40|16@1+ (1,0) [0|100] "%" Vector__XXX
 SG_ GD_ID_MFA_NightDesign m1697 : 40|16@1+ (1,0) [0|100] "%" Vector__XXX
 SG_ GD_ID_LCP_LUMINANCE_FUNC_RW m8864 : 40|16@1+ (1,0) [0|100] "%" Vector__XXX
 SG_ GD_ID_LCP_LUMINANCE_BACK_RW m8865 : 40|16@1+ (1,0) [0|100] "%" Vector__XXX
 SG_ GD_ID_LCP_DELAY_W_Status m8928 : 39|1@1+ (1,0) [0|0] "1/0" Vector__XXX
 SG_ GD_ID_LCP_DELAY_W m8928 : 40|16@1+ (1,0) [0|10000] "ms" Vector__XXX

BO_ 1558 msgHVAC: 8 ecuHVAC
 SG_ ServiceType M : 23|9@1+ (1,0) [0|0] "" Vector__XXX

BA_DEF_ BO_  "VFrameFormat" ENUM  "StandardCAN","ExtendedCAN","reserved","J1939PG";
BA_DEF_DEF_  "VFrameFormat" "J1939PG";
BA_ "VFrameFormat" BO_ 1558 0;
VAL_ 1557 GD_ID_SCT_VALVE_CALIB_COMMAND 0 "Start command" 1 "Start calibration steering valve" 2 "Automatic turn left" 3 "Automatic turn right" 254 "Calibration successful"  ;
VAL_ 1557 GD_ID_SCT_VALVE_CALIB_STATUS 0 "Start command" 1 "Start calibration steering valve" 2 "Automatic turn left" 3 "Automatic turn right" 254 "Calibration successful"  ;
VAL_ 1557 GD_ID_SCT_STEERING_MODE 0 "Front-Wheel (all except Three-Wheeler)" 1 "Front-Wheel (Three-Wheeler)" 2 "Rear-Wheel" 3 "Differential" 4 "Articulated" 5 "Four-Wheel" 6 "Auto-Coordinated 4-Wheel Steering" 7 "Dog-Walk" 8 "Crab Steering"  ;
VAL_ 1557 GD_ID_SCT_ADDITIONAL_WORKING_HEIGHT 0 "Inactive" 1 "Active"  ;
VAL_ 1557 GD_ID_SCT_ISO_STATE 0 "NMEA2000 Messages on ISOBus Prohibited" 1 "NMEA2000 Messages on ISOBUS Allowed"  ;
VAL_ 1557 GD_ID_SCT_CONTROL_MSG_TERMINAL 0 "No Message" 1 "New Data Available" 2 "Factory Reset"  ;
VAL_ 1557 GD_ID_SCT_CONTROL_MSG_GUIDEANCE 0 "No Message" 1 "New Data Available"  ;
VAL_ 1557 GD_ID_SCT_TI_SUB_STATE 0 "DISABLE" 1 "TI_INIT" 2 "RECORD_STANDBY" 3 "RECORD_ACTIVE" 4 "PLAY_STANDBY" 5 "PLAY_ACTIVE" 6 "CONFIG" 7 "EDIT" 8 "DATAXCHANGE" 240 "SAFESTATE" 255 "NO_SUBSTATEWXL"  ;
VAL_ 1557 GD_ID_SCT_PILOTVALVE_STATUS_Status 0 "Valve State - Not Active" 1 "Valve State - Active"  ;
VAL_ 1557 GD_ID_SCT_GUIDANCE_CONFIGURATION_DATA_Status 0 "CEAGuideVersion" 1 "CEAGuideVersion"  ;
VAL_ 1557 GD_ID_SCT_STEERING_MODE_Status 0 "Steering Mode NOT Variable" 1 "Steering Mode Variable"  ;
VAL_ 1557 GD_ID_SCT_SECONDARY_WAS_RAW_VALUE_Status 0 "Secondary WAS Is NOT Present" 1 "Secondary WAS Is Present"  ;
VAL_ 1557 GD_ID_SCT_SECONDARY_WAS_SENSOR_ANGLE_Status 0 "Secondary WAS Is NOT Present" 1 "Secondary WAS Is Present"  ;
VAL_ 1557 GD_ID_SCT_SECONDARY_WAS_MEDIAN_ANGLE_Status 0 "Secondary WAS Is NOT Present" 1 "Secondary WAS Is Present"  ;
VAL_ 1557 GD_ID_SCT_SECONDARY_WAS_MEDIAN_ANGLE_MAX_Status 0 "Secondary WAS Is NOT Present" 1 "Secondary WAS Is Present"  ;
VAL_ 1557 GD_ID_SCT_ALS_X_OFFSET_Status 0 "Inactive" 1 "Active"  ;
VAL_ 1557 GD_ID_SCT_ALS_Y_OFFSET_Status 0 "Inactive" 1 "Active"  ;
VAL_ 1557 GD_ID_SCT_VEHICLE_CURRENT_PAYLOAD_Status 0 "Can NOT Carry Payload" 1 "Can Carry Payload"  ;
VAL_ 1557 GD_ID_SCT_VEHICLE_SPEED_Status 0 "Reverse" 1 "Forward"  ;
VAL_ 1557 GD_ID_SCT_VEHICLE_MOVEMENT_Status 0 "Moved" 1 "NOT Moved"  ;
VAL_ 1557 GD_ID_SCT_PARKING_BRAKE_Status 0 "Inactive" 0 "Active"  ;
VAL_ 1557 GD_ID_SCT_ERROR_ACKNOWLEDGE_Status 0 "Not Acknowledged" 1 "Acknowledged"  ;
VAL_ 1557 GD_ID_SCT_SAFETY_VERSION_Status 0 "First safety concept for MOD X900 for homologation of the EHL/EHPF in 2006" 1 " - Inclusion of superimposed steering  - Operation concept modification (omission of state StandBy; as a result of superimposed steering)  - Omission of the cut-off valve (as a result of the usage of the OSPE steering valve this functionality is now realised by the pilot pressure valve) - Plausibility check of steering wheel sensor (SWS) and wheel angle sensor (WAS)"  ;
VAL_ 1557 GD_ID_Alt_Low_Idle 0 "OFF" 1 "ON (Alternative selection 1)"  ;
VAL_ 1557 GD_ID_Engine_Operating_State 0 "Engine Stopped" 1 "Pre-Start" 2 "Starting" 3 "Warm-Up" 4 "Running" 5 "Cool-down" 6 "Engine Stopping" 7 "Post-Run" 15 "Not available"  ;
VAL_ 1557 GD_ID_WBZ_MACHINE_SELECTED_SOURCE 0 "Wheel" 1 "Radar" 2 "GPS" 7 "Not Avaliable"  ;
VAL_ 1557 GD_ID_WBZ_TERMINAL_PAGE_SIZE 0 "DoNothing" 1 "QuarterScreen" 2 "HalfScreen" 3 "FullScreen"  ;
VAL_ 1557 GD_ID_WBZ_ENG_DEF_LVL_LAMP 0 "Flash" 1 "Solid"  ;
VAL_ 1557 GD_ID_WBZ_ENG_DEF_MIL_LAMP 0 "Flash" 1 "Solid"  ;
VAL_ 1557 GD_ID_WBZ_AUXIO1_01_FI02 0 "Btn released" 1 "Btn pressed" 2 "Error" 3 "Not Available"  ;
VAL_ 1557 GD_ID_WBZ_AUXIO1_02_FI02 0 "Btn released" 1 "Btn pressed" 2 "Error" 3 "Not Available"  ;
VAL_ 1557 GD_ID_WBZ_AUXIO1_03_FI02 0 "Btn released" 1 "Btn pressed" 2 "Error" 3 "Not Available"  ;
VAL_ 1557 GD_ID_WBZ_AUXIO1_04_FI02 0 "Btn released" 1 "Btn pressed" 2 "Error" 3 "Not Available"  ;
VAL_ 1557 GD_ID_WBZ_AUXIO1_05_FI02 0 "Btn released" 1 "Btn pressed" 2 "Error" 3 "Not Available"  ;
VAL_ 1557 GD_ID_WBZ_AUXIO1_06_FI02 0 "Btn released" 1 "Btn pressed" 2 "Error" 3 "Not Available"  ;
VAL_ 1557 GD_ID_WBZ_AUXIO1_07_FI02 0 "Btn released" 1 "Btn pressed" 2 "Error" 3 "Not Available"  ;
VAL_ 1557 GD_ID_WBZ_AUXIO1_08_FI02 0 "Btn released" 1 "Btn pressed" 2 "Error" 3 "Not Available"  ;
VAL_ 1557 GD_ID_WBZ_AUXIO1_09_FI02 0 "Btn released" 1 "Btn pressed" 2 "Error" 3 "Not Available"  ;
VAL_ 1557 GD_ID_WBZ_AUXIO1_10_FI02 0 "Btn released" 1 "Btn pressed" 2 "Error" 3 "Not Available"  ;
VAL_ 1557 GD_ID_WBZ_AUXIO1_11_FI02 0 "Btn released" 1 "Btn pressed" 2 "Error" 3 "Not Available"  ;
VAL_ 1557 GD_ID_WBZ_AUXIO1_12_FI02 0 "Btn released" 1 "Btn pressed" 2 "Error" 3 "Not Available"  ;
VAL_ 1557 GD_ID_WBZ_AUXIO2_17_FI02 0 "LED off" 1 "LED on" 2 "Error" 3 "Not Available"  ;
VAL_ 1557 GD_ID_WBZ_AUXIO2_18_FI02 0 "LED off" 1 "LED on" 2 "Error" 3 "Not Available"  ;
VAL_ 1557 GD_ID_WBZ_AUXIO1_01_FI00 0 "Btn released" 1 "Btn pressed" 2 "Error" 3 "Not Available"  ;
VAL_ 1557 GD_ID_WBZ_AUXIO1_02_FI00 0 "Btn released" 1 "Btn pressed" 2 "Error" 3 "Not Available"  ;
VAL_ 1557 GD_ID_WBZ_AUXIO1_03_FI00 0 "Btn released" 1 "Btn pressed" 2 "Error" 3 "Not Available"  ;
VAL_ 1557 GD_ID_WBZ_AUXIO1_04_FI00 0 "Btn released" 1 "Btn pressed" 2 "Error" 3 "Not Available"  ;
VAL_ 1557 GD_ID_WBZ_AUXIO1_05_FI00 0 "Btn released" 1 "Btn pressed" 2 "Error" 3 "Not Available"  ;
VAL_ 1557 GD_ID_WBZ_AUXIO1_06_FI00 0 "Btn released" 1 "Btn pressed" 2 "Error" 3 "Not Available"  ;
VAL_ 1557 GD_ID_WBZ_AUXIO1_07_FI00 0 "Btn released" 1 "Btn pressed" 2 "Error" 3 "Not Available"  ;
VAL_ 1557 GD_ID_WBZ_AUXIO1_08_FI00 0 "Btn released" 1 "Btn pressed" 2 "Error" 3 "Not Available"  ;
VAL_ 1557 GD_ID_WBZ_AUXIO1_09_FI00 0 "Btn released" 1 "Btn pressed" 2 "Error" 3 "Not Available"  ;
VAL_ 1557 GD_ID_WBZ_AUXIO1_10_FI00 0 "Btn released" 1 "Btn pressed" 2 "Error" 3 "Not Available"  ;
VAL_ 1557 GD_ID_WBZ_AUXIO1_11_FI00 0 "Btn released" 1 "Btn pressed" 2 "Error" 3 "Not Available"  ;
VAL_ 1557 GD_ID_WBZ_AUXIO1_12_FI00 0 "Btn released" 1 "Btn pressed" 2 "Error" 3 "Not Available"  ;
VAL_ 1557 GD_ID_WBZ_AUXIO1_13_FI00 0 "Btn released" 1 "Btn pressed" 2 "Error" 3 "Not Available"  ;
VAL_ 1557 GD_ID_WBZ_AUXIO1_14_FI00 0 "Btn released" 1 "Btn pressed" 2 "Error" 3 "Not Available"  ;
VAL_ 1557 GD_ID_WBZ_AUXIO1_15_FI00 0 "Btn released" 1 "Btn pressed" 2 "Error" 3 "Not Available"  ;
VAL_ 1557 GD_ID_WBZ_AUXIO1_16_FI00 0 "Btn released" 1 "Btn pressed" 2 "Error" 3 "Not Available"  ;
VAL_ 1557 GD_ID_WBZ_AUXIO2_17_FI00 0 "OFF" 1 "ON" 2 "Error" 3 "Not Available"  ;
VAL_ 1557 GD_ID_WBZ_AUXIO2_18_FI00 0 "OFF" 1 "ON" 2 "Error" 3 "Not Available"  ;
VAL_ 1557 GD_ID_WBZ_AUXIO2_21_FI00 0 "OFF" 1 "ON" 2 "Error" 3 "Not Available"  ;
VAL_ 1557 GD_ID_WBZ_AUXIO2_22_FI00 0 "OFF" 1 "ON" 2 "Error" 3 "Not Available"  ;
VAL_ 1557 GD_ID_WBZ_AUXIO2_26_FI00 0 "OFF" 1 "ON" 2 "Error" 3 "Not Available"  ;
VAL_ 1557 GD_ID_WBZ_AUXIO2_27_FI00 0 "OFF" 1 "ON" 2 "Error" 3 "Not Available"  ;
VAL_ 1557 GD_ID_WBZ_AUXIO2_28_FI00 0 "OFF" 1 "ON" 2 "Error" 3 "Not Available"  ;
VAL_ 1557 GD_ID_WBZ_AUXIO2_29_FI00 0 "OFF" 1 "ON" 2 "Error" 3 "Not Available"  ;
VAL_ 1557 GD_ID_WBZ_AUXIO2_30_FI00 0 "OFF" 1 "ON" 2 "Error" 3 "Not Available"  ;
VAL_ 1557 GD_ID_WBZ_AUXIO2_31_FI00 0 "OFF" 1 "ON" 2 "Error" 3 "Not Available"  ;
VAL_ 1557 GD_ID_WBZ_AUXIO2_32_FI00 0 "OFF" 1 "ON" 2 "Error" 3 "Not Available"  ;
VAL_ 1557 GD_ID_WBZ_AUXIO1_01_FI01 0 "Btn released" 1 "Btn pressed" 2 "Error" 3 "Not Available"  ;
VAL_ 1557 GD_ID_WBZ_AUXIO1_02_FI01 0 "Btn released" 1 "Btn pressed" 2 "Error" 3 "Not Available"  ;
VAL_ 1557 GD_ID_WBZ_AUXIO1_03_FI01 0 "Btn released" 1 "Btn pressed" 2 "Error" 3 "Not Available"  ;
VAL_ 1557 GD_ID_WBZ_AUXIO1_04_FI01 0 "Btn released" 1 "Btn pressed" 2 "Error" 3 "Not Available"  ;
VAL_ 1557 GD_ID_WBZ_AUXIO1_05_FI01 0 "Btn released" 1 "Btn pressed" 2 "Error" 3 "Not Available"  ;
VAL_ 1557 GD_ID_WBZ_AUXIO1_06_FI01 0 "Btn released" 1 "Btn pressed" 2 "Error" 3 "Not Available"  ;
VAL_ 1557 GD_ID_WBZ_AUXIO1_07_FI01 0 "Btn released" 1 "Btn pressed" 2 "Error" 3 "Not Available"  ;
VAL_ 1557 GD_ID_WBZ_AUXIO1_08_FI01 0 "Btn released" 1 "Btn pressed" 2 "Error" 3 "Not Available"  ;
VAL_ 1557 GD_ID_WBZ_AUXIO1_09_FI01 0 "Btn released" 1 "Btn pressed" 2 "Error" 3 "Not Available"  ;
VAL_ 1557 GD_ID_WBZ_AUXIO1_10_FI01 0 "Btn released" 1 "Btn pressed" 2 "Error" 3 "Not Available"  ;
VAL_ 1557 GD_ID_WBZ_AUXIO1_11_FI01 0 "Btn released" 1 "Btn pressed" 2 "Error" 3 "Not Available"  ;
VAL_ 1557 GD_ID_WBZ_AUXIO1_12_FI01 0 "Btn released" 1 "Btn pressed" 2 "Error" 3 "Not Available"  ;
VAL_ 1557 GD_ID_WBZ_AUXIO1_13_FI01 0 "Btn released" 1 "Btn pressed" 2 "Error" 3 "Not Available"  ;
VAL_ 1557 GD_ID_WBZ_AUXIO1_14_FI01 0 "Btn released" 1 "Btn pressed" 2 "Error" 3 "Not Available"  ;
VAL_ 1557 GD_ID_WBZ_AUXIO1_15_FI01 0 "Btn released" 1 "Btn pressed" 2 "Error" 3 "Not Available"  ;
VAL_ 1557 GD_ID_WBZ_AUXIO1_16_FI01 0 "Btn released" 1 "Btn pressed" 2 "Error" 3 "Not Available"  ;
VAL_ 1557 GD_ID_WBZ_AUXIO2_17_FI01 0 "OFF" 1 "ON" 2 "Error" 3 "Not Available"  ;
VAL_ 1557 GD_ID_WBZ_AUXIO2_18_FI01 0 "OFF" 1 "ON" 2 "Error" 3 "Not Available"  ;
VAL_ 1557 GD_ID_WBZ_AUXIO2_21_FI01 0 "OFF" 1 "ON" 2 "Error" 3 "Not Available"  ;
VAL_ 1557 GD_ID_WBZ_AUXIO2_22_FI01 0 "OFF" 1 "ON" 2 "Error" 3 "Not Available"  ;
VAL_ 1557 GD_ID_WBZ_AUXIO2_26_FI01 0 "OFF" 1 "ON" 2 "Error" 3 "Not Available"  ;
VAL_ 1557 GD_ID_WBZ_AUXIO2_27_FI01 0 "OFF" 1 "ON" 2 "Error" 3 "Not Available"  ;
VAL_ 1557 GD_ID_WBZ_AUXIO2_28_FI01 0 "OFF" 1 "ON" 2 "Error" 3 "Not Available"  ;
VAL_ 1557 GD_ID_WBZ_AUXIO2_29_FI01 0 "OFF" 1 "ON" 2 "Error" 3 "Not Available"  ;
VAL_ 1557 GD_ID_WBZ_AUXIO2_30_FI01 0 "OFF" 1 "ON" 2 "Error" 3 "Not Available"  ;
VAL_ 1557 GD_ID_WBZ_AUXIO2_31_FI01 0 "OFF" 1 "ON" 2 "Error" 3 "Not Available"  ;
VAL_ 1557 GD_ID_WBZ_AUXIO2_32_FI01 0 "OFF" 1 "ON" 2 "Error" 3 "Not Available"  ;
VAL_ 1557 GD_ID_WBZ_AUXIO2_21_FI02 0 "OFF" 1 "ON" 2 "Error" 3 "Not Available"  ;
VAL_ 1557 GD_ID_WBZ_AUXIO2_22_FI02 0 "OFF" 1 "ON" 2 "Error" 3 "Not Available"  ;
VAL_ 1557 GD_ID_WBZ_DPF_WARNING_LAMP 0 "solid" 1 "flash"  ;
VAL_ 1557 GD_ID_WBZ_DPF_STATI 0 "No heat mode" 1 "Heat mode 1" 2 "Heat mode 2" 3 "Active regeneration needed" 4 "Power derating 1" 5 "Power derating 2" 8 "Regeneration Succesful" 16 "Precondition active"  ;
VAL_ 1557 GD_ID_WBZ_DPF_INHIBITED_STATI 0 "Not Inhibited" 1 "Engine operation state not reached" 2 "Coolant temperature not reached" 8 "Parking brake not applied" 64 "Not in standstill" 32768 "Regeneration activatable"  ;
VAL_ 1557 GD_ID_WBZ_DPF_CONTROL_REGEN 1 "Start" 2 "Cancel"  ;
VAL_ 1557 GD_ID_Engine_Standing_Still_Status 0 "Running" 1 "Still"  ;
VAL_ 1557 GD_ID_Engine_Oil_Pressure_Low_Status 0 "pressure is okay" 1 "pressure is too low"  ;
VAL_ 1557 GD_ID_Engine_Oil_Service_Interval_Status 0 "interval is okay" 1 "interval is exceeded"  ;
VAL_ 1557 GD_ID_Water_In_Fuel_Status 0 "No" 1 "Yes"  ;
VAL_ 1557 GD_ID_WBZ_ENG_DEF_LVL_LAMP_Status 0 "Off" 1 "On"  ;
VAL_ 1557 GD_ID_WBZ_ENG_DEF_MIL_LAMP_Status 0 "Off" 1 "On"  ;
VAL_ 1557 GD_ID_WBZ_THIRD_PARTY_MANUS_Status 0 "NA" 1 "Active"  ;
VAL_ 1557 GD_ID_WBZ_NEW_LEADER_ACL_Status 0 "Missing" 1 "Present"  ;
VAL_ 1557 GD_ID_WBZ_DPF_WARNING_LAMP_Status 0 "OFF" 1 "ON"  ;
VAL_ 1557 GD_ID_WBZ_DPF_HEST_LAMP_Status 0 "OFF" 1 "ON"  ;
VAL_ 1557 GD_ID_TA_Calibration_Command 52224 "Start" 52225 "Proceed From Step1" 52226 "Proceed From Step2" 52227 "Proceed From Step3" 52228 "Accept-Proceed From Step4" 60928 "Decline-Proceed From Step4" 56576 "Abort"  ;
VAL_ 1557 GD_ID_TA_Calibration_State 1 "Step1 - Begin Calib" 2 "Step2 - Min Track" 3 "Step3 - Max Track" 4 "Step4 - User AcceptOrDeny" 0 "Calibration Finished" 65280 "Calibration Error"  ;
VAL_ 1557 GD_ID_TA_Operation_State 0 "Manual" 1 "AutoA" 2 "AutoB" 3 "AutoDual" 4 "Transition"  ;
VAL_ 1557 GD_ID_TA_Operation_State_Status 0 "active" 1 "idle"  ;
VAL_ 1557 GD_ID_RG3_FRONT_SYS_PUMP_COMMAND_Status 0 "Not Commanding Current" 1 "Commanding Current"  ;
VAL_ 1557 GD_ID_RG3_REAR_SYS_PUMP_COMMAND_Status 0 "Not Commanding Current" 1 "Commanding Current"  ;
VAL_ 1557 GD_ID_EMM_ENV_VAR_STATUS 0 "EMM_ENVVAR_TRANSFER_START" 1 "EMM_ENVVAR_TRANSFER_OK" 2 "EMM_ENVVAR_NO_ENTRY" 3 "EMM_ENVVAR_TRANSFER_ERROR"  ;
VAL_ 1557 GD_ID_EMM_STATUS_R 0 "EMM_STATUS_NONE" 1 "EMM_STATUS_RUNNING" 2 "EMM_STATUS_EXT_ON_AIR" 4 "EMM_STATUS_KOMBI_ON_AIR" 8 "EMM_STATUS_HVAC_ON_AIR" 15 "EMM_STATUS_READY"  ;
VAL_ 1557 GD_ID_EFC_STARTUP_STATE 0 "FC_START_STATE__IDLE" 1 "FC_START_STATE__BELOW_START_SPEED" 2 "FC_START_STATE__CHECK_TEMPERATURES" 3 "FC_START_STATE__DETERMINE_FAN_SPEED" 4 "FC_START_STATE__SPEED_UP"  ;
VAL_ 1557 GD_ID_EFC_FAN_ANGLE_WINNER 0 "FCW_NO_ONE" 1 "FCW_GEAR_OIL_TEMP" 2 "FCW_HYDRAULIC_OIL_TEMP" 3 "FCW_AIR_CONDITION_ON" 4 "FCW_AIR_CONDITION_TEMP" 5 "FCW_DRIVING_SPEED" 6 "FCW_ENGINE_TEMP" 7 "FCW_CHARGE_AIR_TEMP" 8 "FCW_EXTERNAL_FAN_SPEED_SET" 9 "FCW_ENGINE_START_SPEED" 10 "FCW_REVERSE_MANUELL" 11 "FCW_ERROR_MANAGEMENT" 12 "FCW_PERFUSION" 13 "FCW_EXTERNAL_WING_SET" 14 "FCW_SLIP_HEAT_PROTECTION" 15 "FCW_FAN_INLET_OVERSPEED" 16 "FCW_ENGINE_SPEED_DEPENDENCY" 17 "FCW_REVERSE_AUTOMATICALLY"  ;
VAL_ 1557 GD_ID_EFC_REVERSE_LOCK_REASONS 0 "REV_LOCK__NO_LOCK" 1 "REV_LOCK__COOLANT_TEMPERATURE" 2 "REV_LOCK__GEAR_TEMPERATURE" 4 "REV_LOCK__CHARGE_AIR_TEMPERATURE" 16 "REV_LOCK__ENGINE_LOAD" 64 "REV_LOCK__HYDRAULIC_TEMPERATURE" 128 "REV_LOCK__DPF_REGENERATION" 256 "REV_LOCK__VEHICLE_SPEED" 1024 "REV_LOCK__ENGINE_SPEED" 2048 "REV_LOCK__ERROR" 4096 "REV_LOCK__STARTPHASE"  ;
VAL_ 1557 GD_ID_EFC_ERROR_REASONS 0 "ERROR_FC_NO_ERROR" 1 "ERROR_FC_PLAUSI_FAN_SPEED_ABOVE" 2 "ERROR_FC_PLAUSI_FAN_SPEED_BELOW" 4 "ERROR_FC_FAN_SPEED_TO_HIGH" 8 "ERROR_FC_FAN_SPEED_SENSOR_ERROR" 16 "ERROR_FC_VALVE_SPEED" 32 "ERROR_FC_VALVE_REVERSION" 64 "ERROR_FC_VALVE_INLET" 128 "ERROR_FC_VALVE_OUTLET" 256 "ERROR_FC_PLAUSI_WING_POSITION_ABOVE" 512 "ERROR_FC_PLAUSI_WING_POSITION_BELOW" 1024 "ERROR_FC_WING_SENSOR" 2048 "ERROR_FC_WING_ANGLE_TO_HIGH" 4096 "ERROR_FC_PLAUSI_DIESEL_FAN" 8192 "ERROR_FC_PLAUSI_WING_POSITION_COMPRESSED_AIR" 16384 "ERROR_FC_MAX_WING_ANGLE_NOT_EXCEEDED"  ;
VAL_ 1557 GD_ID_EFC_REVERSE_STATE 0 "FC_REVERSE_STATE_WING__IDLE" 1 "FC_REVERSE_STATE_WING__AUF_REVERSIERPOSITION_FAHREN" 2 "FC_REVERSE_STATE_WING__AUF_POSITION_NORMALE_REGELUNG_FAHREN" 3 "FC_REVERSE_STATE_WING__ENDE"  ;
VAL_ 1557 GD_ID_ECAD_LOGIC_STATE 0 "Init" 1 "EngOff" 2 "Idle" 3 "Pumping" 4 "Delay" 5 "Start" 6 "Regen" 7 "Stop" 8 "Powerdown" 9 "Shutdown"  ;
VAL_ 1557 GD_ID_ECAD_VALVE_STATE 0 "PC" 1 "Regen" 2 "Pumping"  ;
VAL_ 1557 GD_ID_ECAD_GOVENOR_VALVE_Status 0 "OFF" 1 "ON"  ;
VAL_ 1557 GD_ID_ECAD_REGEN_VALVE_Status 0 "OFF" 1 "ON"  ;
VAL_ 1557 GD_ID_ECAD_HEATER_Status 0 "OFF" 1 "ON"  ;
VAL_ 1557 GD_ID_4WS_REQUESTED_MODE 0 "OFF" 1 "2WS" 2 "4WS Auto" 3 "4WS" 4 "Crab"  ;
VAL_ 1557 GD_ID_4WS_CURRENT_MODE 0 "OFF" 1 "2WS" 2 "4WS Auto" 3 "4WS" 4 "Crab" 5 "Calibrating"  ;
VAL_ 1557 GD_ID_4WS_ACTIVE_CURRENT_LOOP 0 "LEFT_COIL" 1 "RIGHT_COIL" 2 "BOTH" 3 "NEITHER"  ;
VAL_ 1557 GD_ID_4WS_START_CURRENT_CALIB_COMMAND 4 "START_CALIBRATION" 5 "ABORT_CALIBRATION"  ;
VAL_ 1557 GD_ID_4WS_START_CURRENT_CALIB_STATUS 0 "COMPLETE" 1 "CENTER_WHEELS" 2 "CALIBRATE_LEFT" 3 "CALIBRATE_RIGHT" 65281 "BAD_CALIB" 65282 "RECENTER_TIMEOUT" 65283 "LEFT_OUTSIDE_LIMITS" 65284 "RIGHT_OUTSIDE_LIMITS" 65285 "LEFT_WRONG_DIRECTION" 65286 "RIGHT_WRONG_DIRECTION" 65287 "INTERNAL_INTERRUPTION" 65288 "EXTERNAL_INTERRUPTION"  ;
VAL_ 1557 GD_ID_4WS_REAR_ANGLE_CALIB_COMMAND 52224 "START_CALIBRATION" 56576 "ABORT_CALIBRATION"  ;
VAL_ 1557 GD_ID_4WS_REAR_ANGLE_CALIB_STATUS 0 "COMPLETED" 1 "RECORD_CENTER" 2 "COMMAND_4WS" 3 "COMMAND_LEFT" 4 "RECORD_LEFT" 5 "COMMAND_RIGHT" 6 "RECORD_RIGHT" 7 "RECENTER" 8 "INTERRUPTED" 65280 "BAD_STORED_CALIBS" 65281 "BAD_CENTER_VALUE" 65282 "COULD_NOT_ENTER_4WS" 65283 "WHEEL_NOT_LEFT" 65284 "BAD_LEFT_VALUE" 65285 "WHEEL_NOT_RIGHT" 65286 "BAD_RIGHT_VALUE" 65287 "COULD_NOT_RECENTER"  ;
VAL_ 1557 GD_ID_4WS_JOG_ANGLE_Status 0 "Left" 1 "Right"  ;
VAL_ 1557 GD_ID_4WS_UI_FRONT_ANGLE_Status 0 "Left" 1 "Right"  ;
VAL_ 1557 GD_ID_4WS_UI_REAR_ANGLE_Status 0 "Left" 1 "Right"  ;
VAL_ 1557 GD_ID_4WS_CURRENT_CONTROL_KP_Status 0 "Not used" 1 "Used"  ;
VAL_ 1557 GD_ID_4WS_CURRENT_CONTROL_KI_Status 0 "Not used" 1 "Used"  ;
VAL_ 1557 GD_ID_4WS_REAR_ANGLE_TARGET_Status 0 "Not used" 1 "Used"  ;
VAL_ 1557 GD_ID_4WS_ANGLE_CONTROL_KP_Status 0 "Not used" 1 "Used"  ;
VAL_ 1557 GD_ID_4WS_ANGLE_CONTROL_KI_Status 0 "Not used" 1 "Used"  ;
VAL_ 1557 GD_ID_4WS_TARGET_CURRENT_Status 0 "Left" 1 "Right"  ;
VAL_ 1557 GD_ID_4WS_CURRENT_CONTROL_KC_Status 0 "Not used" 1 "Used"  ;
VAL_ 1557 GD_ID_4WS_UNFILTERED_REAR_ANGLE_Status 0 "Left" 1 "Right"  ;
SG_MUL_VAL_ 1557 GD_ID_SCT_VALVE_POSITION DataIndex 12353-12353;
SG_MUL_VAL_ 1557 GD_ID_SCT_VALVE_CALIB_COMMAND DataIndex 12366-12366;
SG_MUL_VAL_ 1557 GD_ID_SCT_VALVE_CALIB_STATUS DataIndex 12367-12367;
SG_MUL_VAL_ 1557 GD_ID_SCT_PILOTVALVE_STATUS_Status DataIndex 12368-12368;
SG_MUL_VAL_ 1557 GD_ID_SCT_PILOTVALVE_STATUS DataIndex 12368-12368;
SG_MUL_VAL_ 1557 GD_ID_SCT_OLAY_STEER_FACTOR DataIndex 12388-12388;
SG_MUL_VAL_ 1557 GD_ID_SCT_HEADLAND_CMD_Status DataIndex 12416-12416;
SG_MUL_VAL_ 1557 GD_ID_SCT_HEADLAND_CMD DataIndex 12416-12416;
SG_MUL_VAL_ 1557 GD_ID_SCT_3RDPARTY_READY_STATUS_Status DataIndex 12417-12417;
SG_MUL_VAL_ 1557 GD_ID_SCT_3RDPARTY_READY_STATUS DataIndex 12417-12417;
SG_MUL_VAL_ 1557 GD_ID_SCT_3RDPARTY_POSITION_STATUS_Status DataIndex 12418-12418;
SG_MUL_VAL_ 1557 GD_ID_SCT_3RDPARTY_POSITION_STATUS DataIndex 12418-12418;
SG_MUL_VAL_ 1557 GD_ID_SCT_3RDPARTY_CANCEL_REQUEST_Status DataIndex 12419-12419;
SG_MUL_VAL_ 1557 GD_ID_SCT_3RDPARTY_CANCEL_REQUEST DataIndex 12419-12419;
SG_MUL_VAL_ 1557 GD_ID_SCT_3RDPARTY_COMMAND_GUIDANCE_Status DataIndex 12420-12420;
SG_MUL_VAL_ 1557 GD_ID_SCT_3RDPARTY_COMMAND_GUIDANCE DataIndex 12420-12420;
SG_MUL_VAL_ 1557 GD_ID_SCT_TSD_MIN_SPEED_FORWARD DataIndex 12544-12544;
SG_MUL_VAL_ 1557 GD_ID_SCT_TSD_MAX_SPEED_FORWARD DataIndex 12545-12545;
SG_MUL_VAL_ 1557 GD_ID_SCT_TSD_MIN_MACHINE_RADIUS DataIndex 12546-12546;
SG_MUL_VAL_ 1557 GD_ID_SCT_TSD_MAX_ACQUISITION_ANGLE DataIndex 12547-12547;
SG_MUL_VAL_ 1557 GD_ID_SCT_GUIDANCE_CONFIGURATION_DATA_Status DataIndex 12560-12560;
SG_MUL_VAL_ 1557 GD_ID_SCT_GUIDANCE_CONFIGURATION_DATA DataIndex 12560-12560;
SG_MUL_VAL_ 1557 GD_ID_SCT_STEERING_MODE_Status DataIndex 12568-12568;
SG_MUL_VAL_ 1557 GD_ID_SCT_STEERING_MODE DataIndex 12568-12568;
SG_MUL_VAL_ 1557 GD_ID_SCT_SECONDARY_WAS_RAW_VALUE_Status DataIndex 12569-12569;
SG_MUL_VAL_ 1557 GD_ID_SCT_SECONDARY_WAS_RAW_VALUE DataIndex 12569-12569;
SG_MUL_VAL_ 1557 GD_ID_SCT_SECONDARY_WAS_SENSOR_ANGLE_Status DataIndex 12570-12570;
SG_MUL_VAL_ 1557 GD_ID_SCT_SECONDARY_WAS_SENSOR_ANGLE DataIndex 12570-12570;
SG_MUL_VAL_ 1557 GD_ID_SCT_SECONDARY_WAS_MEDIAN_ANGLE_Status DataIndex 12571-12571;
SG_MUL_VAL_ 1557 GD_ID_SCT_SECONDARY_WAS_MEDIAN_ANGLE DataIndex 12571-12571;
SG_MUL_VAL_ 1557 GD_ID_SCT_SECONDARY_WAS_MEDIAN_ANGLE_MAX_Status DataIndex 12572-12572;
SG_MUL_VAL_ 1557 GD_ID_SCT_SECONDARY_WAS_MEDIAN_ANGLE_MAX DataIndex 12572-12572;
SG_MUL_VAL_ 1557 GD_ID_SCT_ALS_X_OFFSET_Status DataIndex 12573-12573;
SG_MUL_VAL_ 1557 GD_ID_SCT_ALS_X_OFFSET DataIndex 12573-12573;
SG_MUL_VAL_ 1557 GD_ID_SCT_ALS_Y_OFFSET_Status DataIndex 12574-12574;
SG_MUL_VAL_ 1557 GD_ID_SCT_ALS_Y_OFFSET DataIndex 12574-12574;
SG_MUL_VAL_ 1557 GD_ID_SCT_ADDITIONAL_WORKING_HEIGHT DataIndex 12575-12575;
SG_MUL_VAL_ 1557 GD_ID_SCT_VEHICLE_CURRENT_PAYLOAD_Status DataIndex 12576-12576;
SG_MUL_VAL_ 1557 GD_ID_SCT_VEHICLE_CURRENT_PAYLOAD DataIndex 12576-12576;
SG_MUL_VAL_ 1557 GD_ID_SCT_ISO_STATE DataIndex 12598-12598;
SG_MUL_VAL_ 1557 GD_ID_SCT_VEHICLE_SPEED_Status DataIndex 12599-12599;
SG_MUL_VAL_ 1557 GD_ID_SCT_VEHICLE_SPEED DataIndex 12599-12599;
SG_MUL_VAL_ 1557 GD_ID_SCT_VEHICLE_MOVEMENT_Status DataIndex 12600-12600;
SG_MUL_VAL_ 1557 GD_ID_SCT_VEHICLE_MOVEMENT DataIndex 12600-12600;
SG_MUL_VAL_ 1557 GD_ID_SCT_PARKING_BRAKE_Status DataIndex 12601-12601;
SG_MUL_VAL_ 1557 GD_ID_SCT_PARKING_BRAKE DataIndex 12601-12601;
SG_MUL_VAL_ 1557 GD_ID_SCT_CONTROL_MSG_TERMINAL DataIndex 12608-12608;
SG_MUL_VAL_ 1557 GD_ID_SCT_CONTROL_MSG_GUIDEANCE DataIndex 12609-12609;
SG_MUL_VAL_ 1557 GD_ID_SCT_MODIFIED_REFERENCE_POINT_HEIGHT DataIndex 12610-12610;
SG_MUL_VAL_ 1557 GD_ID_SCT_MODIFIED_GNSS_ANTENNA_X_OFFSET DataIndex 12611-12611;
SG_MUL_VAL_ 1557 GD_ID_SCT_MODIFIED_GNSS_ANTENNA_Y_OFFSET DataIndex 12612-12612;
SG_MUL_VAL_ 1557 GD_ID_SCT_MODIFIED_GNSS_ANTENNA_Z_OFFSET DataIndex 12613-12613;
SG_MUL_VAL_ 1557 GD_ID_SCT_MODIFIED_TRACK_WIDTH DataIndex 12614-12614;
SG_MUL_VAL_ 1557 GD_ID_SCT_MODIFIED_MOUNTING_ERROR_Y_OFFSET DataIndex 12615-12615;
SG_MUL_VAL_ 1557 GD_ID_SCT_TRACTOR_SN_TYPE DataIndex 12736-12736;
SG_MUL_VAL_ 1557 GD_ID_SCT_TRACTOR_SN_GROUP DataIndex 12737-12737;
SG_MUL_VAL_ 1557 GD_ID_SCT_TRACTOR_SN_NUMBER DataIndex 12738-12738;
SG_MUL_VAL_ 1557 GD_ID_SCT_ERROR_ACKNOWLEDGE_Status DataIndex 12782-12782;
SG_MUL_VAL_ 1557 GD_ID_SCT_ERROR_ACKNOWLEDGE DataIndex 12782-12782;
SG_MUL_VAL_ 1557 GD_ID_SCT_ACTIVATE_DIAGNOSTICS DataIndex 12784-12784;
SG_MUL_VAL_ 1557 GD_ID_SCT_SAFETY_VERSION_Status DataIndex 12788-12788;
SG_MUL_VAL_ 1557 GD_ID_SCT_SAFETY_VERSION DataIndex 12788-12788;
SG_MUL_VAL_ 1557 GD_ID_SCT_LIB_SAFETY_VERSION DataIndex 12789-12789;
SG_MUL_VAL_ 1557 GD_ID_SCT_RECIPE_ACCESS_SETPOINT DataIndex 12792-12792;
SG_MUL_VAL_ 1557 GD_ID_SCT_TI_ACCESS_SETPOINT DataIndex 12793-12793;
SG_MUL_VAL_ 1557 GD_ID_SCT_TI_ACCESS_STATE DataIndex 12794-12794;
SG_MUL_VAL_ 1557 GD_ID_SCT_TI_ACCESS_STATE_KL15 DataIndex 12795-12795;
SG_MUL_VAL_ 1557 GD_ID_SCT_TI_SUB_STATE DataIndex 12797-12797;
SG_MUL_VAL_ 1557 GD_ID_SCT_ErrorManagement_Status DataIndex 12782-12782;
SG_MUL_VAL_ 1557 GD_ID_SCT_ErrorManagement DataIndex 12782-12782;
SG_MUL_VAL_ 1557 GD_ID_SCT_LifeMessage DataIndex 12799-12799;

SG_MUL_VAL_ 1557 GD_ID_Engine_Rpm DataIndex 12800-12800;
SG_MUL_VAL_ 1557 GD_ID_Engine_Load DataIndex 12801-12801;
SG_MUL_VAL_ 1557 GD_ID_Engine_Coolant_Temp_Status DataIndex 12802-12802;
SG_MUL_VAL_ 1557 GD_ID_Engine_Coolant_Temp DataIndex 12802-12802;
SG_MUL_VAL_ 1557 GD_ID_Engine_Air_Intake_Temp DataIndex 12803-12803;
SG_MUL_VAL_ 1557 GD_ID_Engine_Battery_Power_Status DataIndex 12804-12804;
SG_MUL_VAL_ 1557 GD_ID_Engine_Battery_Power DataIndex 12804-12804;
SG_MUL_VAL_ 1557 GD_ID_Engine_Air_Intake_Pressure DataIndex 12805-12805;
SG_MUL_VAL_ 1557 GD_ID_Engine_Oil_Pressure DataIndex 12806-12806;
SG_MUL_VAL_ 1557 GD_ID_Engine_Rpm_Setpoint_Status DataIndex 12807-12807;
SG_MUL_VAL_ 1557 GD_ID_Engine_Rpm_Setpoint DataIndex 12807-12807;
SG_MUL_VAL_ 1557 GD_ID_Engine_Standing_Still_Status DataIndex 12808-12808;
SG_MUL_VAL_ 1557 GD_ID_Engine_Standing_Still DataIndex 12808-12808;
SG_MUL_VAL_ 1557 GD_ID_Engine_Oil_Pressure_Low_Status DataIndex 12809-12809;
SG_MUL_VAL_ 1557 GD_ID_Engine_Oil_Pressure_Low DataIndex 12809-12809;
SG_MUL_VAL_ 1557 GD_ID_Engine_Oil_Service_Interval_Status DataIndex 12810-12810;
SG_MUL_VAL_ 1557 GD_ID_Engine_Oil_Service_Interval DataIndex 12810-12810;
SG_MUL_VAL_ 1557 GD_ID_Engine_Hours DataIndex 12811-12811;
SG_MUL_VAL_ 1557 GD_ID_Engine_Amber_Warning_Lamp_Status DataIndex 12812-12812;
SG_MUL_VAL_ 1557 GD_ID_Engine_Amber_Warning_Lamp DataIndex 12812-12812;
SG_MUL_VAL_ 1557 GD_ID_Engine_Red_Stop_Lamp_Status DataIndex 12813-12813;
SG_MUL_VAL_ 1557 GD_ID_Engine_Red_Stop_Lamp DataIndex 12813-12813;
SG_MUL_VAL_ 1557 GD_ID_Alt_Low_Idle DataIndex 12814-12814;
SG_MUL_VAL_ 1557 GD_ID_Engine_Audible_Warning_Status DataIndex 12815-12815;
SG_MUL_VAL_ 1557 GD_ID_Engine_Audible_Warning DataIndex 12815-12815;
SG_MUL_VAL_ 1557 GD_ID_Ambient_Temp DataIndex 12816-12816;
SG_MUL_VAL_ 1557 GD_ID_Ecu_Temp DataIndex 12817-12817;
SG_MUL_VAL_ 1557 GD_ID_Fuel_Rate DataIndex 12820-12820;
SG_MUL_VAL_ 1557 GD_ID_Trip_Fuel DataIndex 12821-12821;
SG_MUL_VAL_ 1557 GD_ID_Trip_DEF DataIndex 12822-12822;
SG_MUL_VAL_ 1557 GD_ID_DEF_Level DataIndex 12823-12823;
SG_MUL_VAL_ 1557 GD_ID_Water_In_Fuel_Status DataIndex 12824-12824;
SG_MUL_VAL_ 1557 GD_ID_Water_In_Fuel DataIndex 12824-12824;
SG_MUL_VAL_ 1557 GD_ID_Engine_Malfunction_Lamp_Status DataIndex 12825-12825;
SG_MUL_VAL_ 1557 GD_ID_Engine_Malfunction_Lamp DataIndex 12825-12825;
SG_MUL_VAL_ 1557 GD_ID_DEF_Level_Warning_Status DataIndex 12826-12826;
SG_MUL_VAL_ 1557 GD_ID_DEF_Level_Warning DataIndex 12826-12826;
SG_MUL_VAL_ 1557 GD_ID_Engine_WaitToStart_Status DataIndex 12827-12827;
SG_MUL_VAL_ 1557 GD_ID_Engine_WaitToStart DataIndex 12827-12827;
SG_MUL_VAL_ 1557 GD_ID_Engine_Operating_State DataIndex 12828-12828;
SG_MUL_VAL_ 1557 GD_ID_Engine_Start_Enable_Status DataIndex 12829-12829;
SG_MUL_VAL_ 1557 GD_ID_Engine_Start_Enable DataIndex 12829-12829;
SG_MUL_VAL_ 1557 GD_ID_Implement_Transport_State_Status DataIndex 12830-12830;
SG_MUL_VAL_ 1557 GD_ID_Implement_Transport_State DataIndex 12830-12830;
SG_MUL_VAL_ 1557 GD_ID_Implement_Work_State_Status DataIndex 12831-12831;
SG_MUL_VAL_ 1557 GD_ID_Implement_Work_State DataIndex 12831-12831;
SG_MUL_VAL_ 1557 GD_ID_Implement_Actual_Working_Width DataIndex 12832-12832;
SG_MUL_VAL_ 1557 GD_ID_Implement_Actual_Flow DataIndex 12833-12833;
SG_MUL_VAL_ 1557 GD_ID_Implement_ReadyForFieldWork_Status DataIndex 12834-12834;
SG_MUL_VAL_ 1557 GD_ID_Implement_ReadyForFieldWork DataIndex 12834-12834;
SG_MUL_VAL_ 1557 GD_ID_WheelBasedDistance_km DataIndex 12840-12840;
SG_MUL_VAL_ 1557 GD_ID_WheelBasedDistance_m DataIndex 12841-12841;
SG_MUL_VAL_ 1557 GD_ID_GroundBasedDistance_km DataIndex 12842-12842;
SG_MUL_VAL_ 1557 GD_ID_GroundBasedDistance_m DataIndex 12843-12843;
SG_MUL_VAL_ 1557 GD_ID_SelectedSpeedDistance_km DataIndex 12844-12844;
SG_MUL_VAL_ 1557 GD_ID_SelectedSpeedDistance_m DataIndex 12845-12845;
SG_MUL_VAL_ 1557 GD_ID_MachineSelectedSpeed DataIndex 12846-12846;
SG_MUL_VAL_ 1557 GD_ID_WBZ_MACHINE_SELECTED_SOURCE DataIndex 12847-12847;
SG_MUL_VAL_ 1557 GD_ID_WBZ_MAX_ENG_RPM DataIndex 12848-12848;
SG_MUL_VAL_ 1557 GD_ID_Working_Time_SecMin_VD DataIndex 12850-12850;
SG_MUL_VAL_ 1557 GD_ID_Working_Time_Hours_VD DataIndex 12851-12851;
SG_MUL_VAL_ 1557 GD_ID_Worked_Area_Ha_VD DataIndex 12852-12852;
SG_MUL_VAL_ 1557 GD_ID_Worked_Area_0001Ha_VD DataIndex 12853-12853;
SG_MUL_VAL_ 1557 GD_ID_Used_Fuel_VD DataIndex 12854-12854;
SG_MUL_VAL_ 1557 GD_ID_Remaining_Time_SecMin_VD DataIndex 12855-12855;
SG_MUL_VAL_ 1557 GD_ID_Remaining_Time_Hours_VD DataIndex 12856-12856;
SG_MUL_VAL_ 1557 GD_ID_Remaining_Area_Ha_VD DataIndex 12857-12857;
SG_MUL_VAL_ 1557 GD_ID_Remaining_Area_0001Ha_VD DataIndex 12858-12858;
SG_MUL_VAL_ 1557 GD_ID_Required_Fuel_VD DataIndex 12859-12859;
SG_MUL_VAL_ 1557 GD_ID_Field_Size_Ha_VD DataIndex 12860-12860;
SG_MUL_VAL_ 1557 GD_ID_Field_Size_0001Ha_VD DataIndex 12861-12861;
SG_MUL_VAL_ 1557 GD_ID_Reset_VD_Status DataIndex 12862-12862;
SG_MUL_VAL_ 1557 GD_ID_Reset_VD DataIndex 12862-12862;
SG_MUL_VAL_ 1557 GD_Iso_IsoState_state_RW DataIndex 12870-12870;
SG_MUL_VAL_ 1557 GD_ID_WBZ_TERMINAL_PAGE_SIZE DataIndex 12871-12871;
SG_MUL_VAL_ 1557 GD_ID_WBZ_ENG_DEF_LVL_LAMP_Status DataIndex 12878-12878;
SG_MUL_VAL_ 1557 GD_ID_WBZ_ENG_DEF_LVL_LAMP DataIndex 12878-12878;
SG_MUL_VAL_ 1557 GD_ID_WBZ_ENG_DEF_MIL_LAMP_Status DataIndex 12879-12879;
SG_MUL_VAL_ 1557 GD_ID_WBZ_ENG_DEF_MIL_LAMP DataIndex 12879-12879;
SG_MUL_VAL_ 1557 GD_ID_IgnitionState_Status DataIndex 12880-12880;
SG_MUL_VAL_ 1557 GD_ID_IgnitionState DataIndex 12880-12880;
SG_MUL_VAL_ 1557 GD_ID_WBZ_ENG_FAN_RPM DataIndex 12881-12881;
SG_MUL_VAL_ 1557 GD_ID_WBZ_ENG_FUEL_TEMP DataIndex 12882-12882;
SG_MUL_VAL_ 1557 GD_ID_WBZ_ENG_AUXIO1_01 DataIndex 12883-12883;
SG_MUL_VAL_ 1557 GD_ID_WBZ_ENG_FAN_DUTY_CYCLE DataIndex 12884-12884;
SG_MUL_VAL_ 1557 GD_ID_WBZ_DEF_TEMP DataIndex 12885-12885;
SG_MUL_VAL_ 1557 GD_ID_WBZ_EXHAUST_TEMP DataIndex 12886-12886;
SG_MUL_VAL_ 1557 GD_ID_WBZ_FUEL_PRESSURE DataIndex 12887-12887;
SG_MUL_VAL_ 1557 GD_ID_WBZ_CURVATURE_SETPOINT DataIndex 12888-12888;
SG_MUL_VAL_ 1557 GD_ID_WBZ_CURVATURE_ENABLE_Status DataIndex 12889-12889;
SG_MUL_VAL_ 1557 GD_ID_WBZ_CURVATURE_ENABLE DataIndex 12889-12889;
SG_MUL_VAL_ 1557 GD_ID_WBZ_ENG_START_CMD_Status DataIndex 12890-12890;
SG_MUL_VAL_ 1557 GD_ID_WBZ_ENG_START_CMD DataIndex 12890-12890;
SG_MUL_VAL_ 1557 GD_ID_WBZ_THIRD_PARTY_MANUS_Status DataIndex 12891-12891;
SG_MUL_VAL_ 1557 GD_ID_WBZ_THIRD_PARTY_MANUS DataIndex 12891-12891;
SG_MUL_VAL_ 1557 GD_ID_WBZ_NEW_LEADER_ACL_Status DataIndex 12892-12892;
SG_MUL_VAL_ 1557 GD_ID_WBZ_NEW_LEADER_ACL DataIndex 12892-12892;
SG_MUL_VAL_ 1557 GD_ID_WBZ_AUXIO1_01_FI02 DataIndex 12901-12901;
SG_MUL_VAL_ 1557 GD_ID_WBZ_AUXIO1_02_FI02 DataIndex 12902-12902;
SG_MUL_VAL_ 1557 GD_ID_WBZ_AUXIO1_03_FI02 DataIndex 12903-12903;
SG_MUL_VAL_ 1557 GD_ID_WBZ_AUXIO1_04_FI02 DataIndex 12904-12904;
SG_MUL_VAL_ 1557 GD_ID_WBZ_AUXIO1_05_FI02 DataIndex 12905-12905;
SG_MUL_VAL_ 1557 GD_ID_WBZ_AUXIO1_06_FI02 DataIndex 12906-12906;
SG_MUL_VAL_ 1557 GD_ID_WBZ_AUXIO1_07_FI02 DataIndex 12907-12907;
SG_MUL_VAL_ 1557 GD_ID_WBZ_AUXIO1_08_FI02 DataIndex 12908-12908;
SG_MUL_VAL_ 1557 GD_ID_WBZ_AUXIO1_09_FI02 DataIndex 12909-12909;
SG_MUL_VAL_ 1557 GD_ID_WBZ_AUXIO1_10_FI02 DataIndex 12910-12910;
SG_MUL_VAL_ 1557 GD_ID_WBZ_AUXIO1_11_FI02 DataIndex 12911-12911;
SG_MUL_VAL_ 1557 GD_ID_WBZ_AUXIO1_12_FI02 DataIndex 12912-12912;
SG_MUL_VAL_ 1557 GD_ID_WBZ_AUXIO2_17_FI02 DataIndex 12917-12917;
SG_MUL_VAL_ 1557 GD_ID_WBZ_AUXIO2_18_FI02 DataIndex 12918-12918;
SG_MUL_VAL_ 1557 GD_ID_WBZ_AUXIO1_01_FI00 DataIndex 12919-12919;
SG_MUL_VAL_ 1557 GD_ID_WBZ_AUXIO1_02_FI00 DataIndex 12920-12920;
SG_MUL_VAL_ 1557 GD_ID_WBZ_AUXIO1_03_FI00 DataIndex 12921-12921;
SG_MUL_VAL_ 1557 GD_ID_WBZ_AUXIO1_04_FI00 DataIndex 12922-12922;
SG_MUL_VAL_ 1557 GD_ID_WBZ_AUXIO1_05_FI00 DataIndex 12923-12923;
SG_MUL_VAL_ 1557 GD_ID_WBZ_AUXIO1_06_FI00 DataIndex 12924-12924;
SG_MUL_VAL_ 1557 GD_ID_WBZ_AUXIO1_07_FI00 DataIndex 12925-12925;
SG_MUL_VAL_ 1557 GD_ID_WBZ_AUXIO1_08_FI00 DataIndex 12926-12926;
SG_MUL_VAL_ 1557 GD_ID_WBZ_AUXIO1_09_FI00 DataIndex 12927-12927;
SG_MUL_VAL_ 1557 GD_ID_WBZ_AUXIO1_10_FI00 DataIndex 12928-12928;
SG_MUL_VAL_ 1557 GD_ID_WBZ_AUXIO1_11_FI00 DataIndex 12929-12929;
SG_MUL_VAL_ 1557 GD_ID_WBZ_AUXIO1_12_FI00 DataIndex 12930-12930;
SG_MUL_VAL_ 1557 GD_ID_WBZ_AUXIO1_13_FI00 DataIndex 12931-12931;
SG_MUL_VAL_ 1557 GD_ID_WBZ_AUXIO1_14_FI00 DataIndex 12932-12932;
SG_MUL_VAL_ 1557 GD_ID_WBZ_AUXIO1_15_FI00 DataIndex 12933-12933;
SG_MUL_VAL_ 1557 GD_ID_WBZ_AUXIO1_16_FI00 DataIndex 12934-12934;
SG_MUL_VAL_ 1557 GD_ID_WBZ_AUXIO1_CH2 DataIndex 12935-12935;
SG_MUL_VAL_ 1557 GD_ID_WBZ_AUXIO2_17_FI00 DataIndex 12936-12936;
SG_MUL_VAL_ 1557 GD_ID_WBZ_AUXIO2_18_FI00 DataIndex 12937-12937;
SG_MUL_VAL_ 1557 GD_ID_WBZ_AUXIO2_21_FI00 DataIndex 12940-12940;
SG_MUL_VAL_ 1557 GD_ID_WBZ_AUXIO2_22_FI00 DataIndex 12941-12941;
SG_MUL_VAL_ 1557 GD_ID_WBZ_AUXIO2_26_FI00 DataIndex 12945-12945;
SG_MUL_VAL_ 1557 GD_ID_WBZ_AUXIO2_27_FI00 DataIndex 12946-12946;
SG_MUL_VAL_ 1557 GD_ID_WBZ_AUXIO2_28_FI00 DataIndex 12947-12947;
SG_MUL_VAL_ 1557 GD_ID_WBZ_AUXIO2_29_FI00 DataIndex 12948-12948;
SG_MUL_VAL_ 1557 GD_ID_WBZ_AUXIO2_30_FI00 DataIndex 12949-12949;
SG_MUL_VAL_ 1557 GD_ID_WBZ_AUXIO2_31_FI00 DataIndex 12950-12950;
SG_MUL_VAL_ 1557 GD_ID_WBZ_AUXIO2_32_FI00 DataIndex 12951-12951;
SG_MUL_VAL_ 1557 GD_ID_WBZ_AUXIO1_01_FI01 DataIndex 12952-12952;
SG_MUL_VAL_ 1557 GD_ID_WBZ_AUXIO1_02_FI01 DataIndex 12953-12953;
SG_MUL_VAL_ 1557 GD_ID_WBZ_AUXIO1_03_FI01 DataIndex 12954-12954;
SG_MUL_VAL_ 1557 GD_ID_WBZ_AUXIO1_04_FI01 DataIndex 12955-12955;
SG_MUL_VAL_ 1557 GD_ID_WBZ_AUXIO1_05_FI01 DataIndex 12956-12956;
SG_MUL_VAL_ 1557 GD_ID_WBZ_AUXIO1_06_FI01 DataIndex 12957-12957;
SG_MUL_VAL_ 1557 GD_ID_WBZ_AUXIO1_07_FI01 DataIndex 12958-12958;
SG_MUL_VAL_ 1557 GD_ID_WBZ_AUXIO1_08_FI01 DataIndex 12959-12959;
SG_MUL_VAL_ 1557 GD_ID_WBZ_AUXIO1_09_FI01 DataIndex 12960-12960;
SG_MUL_VAL_ 1557 GD_ID_WBZ_AUXIO1_10_FI01 DataIndex 12961-12961;
SG_MUL_VAL_ 1557 GD_ID_WBZ_AUXIO1_11_FI01 DataIndex 12962-12962;
SG_MUL_VAL_ 1557 GD_ID_WBZ_AUXIO1_12_FI01 DataIndex 12963-12963;
SG_MUL_VAL_ 1557 GD_ID_WBZ_AUXIO1_13_FI01 DataIndex 12964-12964;
SG_MUL_VAL_ 1557 GD_ID_WBZ_AUXIO1_14_FI01 DataIndex 12965-12965;
SG_MUL_VAL_ 1557 GD_ID_WBZ_AUXIO1_15_FI01 DataIndex 12966-12966;
SG_MUL_VAL_ 1557 GD_ID_WBZ_AUXIO1_16_FI01 DataIndex 12967-12967;
SG_MUL_VAL_ 1557 GD_ID_WBZ_AUXIO2_17_FI01 DataIndex 12969-12969;
SG_MUL_VAL_ 1557 GD_ID_WBZ_AUXIO2_18_FI01 DataIndex 12970-12970;
SG_MUL_VAL_ 1557 GD_ID_WBZ_AUXIO2_21_FI01 DataIndex 12973-12973;
SG_MUL_VAL_ 1557 GD_ID_WBZ_AUXIO2_22_FI01 DataIndex 12974-12974;
SG_MUL_VAL_ 1557 GD_ID_WBZ_AUXIO2_26_FI01 DataIndex 12978-12978;
SG_MUL_VAL_ 1557 GD_ID_WBZ_AUXIO2_27_FI01 DataIndex 12979-12979;
SG_MUL_VAL_ 1557 GD_ID_WBZ_AUXIO2_28_FI01 DataIndex 12980-12980;
SG_MUL_VAL_ 1557 GD_ID_WBZ_AUXIO2_29_FI01 DataIndex 12981-12981;
SG_MUL_VAL_ 1557 GD_ID_WBZ_AUXIO2_30_FI01 DataIndex 12982-12982;
SG_MUL_VAL_ 1557 GD_ID_WBZ_AUXIO2_31_FI01 DataIndex 12983-12983;
SG_MUL_VAL_ 1557 GD_ID_WBZ_AUXIO2_32_FI01 DataIndex 12984-12984;
SG_MUL_VAL_ 1557 GD_ID_WBZ_AUXIO2_21_FI02 DataIndex 12985-12985;
SG_MUL_VAL_ 1557 GD_ID_WBZ_AUXIO2_22_FI02 DataIndex 12986-12986;
SG_MUL_VAL_ 1557 GD_ID_WBZ_TI_ACCESS DataIndex 13000-13000;
SG_MUL_VAL_ 1557 GD_ID_Unknown_Engine_Error_Part1 DataIndex 13052-13052;
SG_MUL_VAL_ 1557 GD_ID_Unknown_Engine_Error_Part2 DataIndex 13053-13053;
SG_MUL_VAL_ 1557 GD_ID_WBZ_DPF_WARNING_LAMP_Status DataIndex 13120-13120;
SG_MUL_VAL_ 1557 GD_ID_WBZ_DPF_WARNING_LAMP DataIndex 13120-13120;
SG_MUL_VAL_ 1557 GD_ID_WBZ_DPF_HEST_LAMP_Status DataIndex 13121-13121;
SG_MUL_VAL_ 1557 GD_ID_WBZ_DPF_HEST_LAMP DataIndex 13121-13121;
SG_MUL_VAL_ 1557 GD_ID_WBZ_DPF_SOOT_ASH DataIndex 13123-13123;
SG_MUL_VAL_ 1557 GD_ID_WBZ_DPF_HOURS_SINCE_REGEN DataIndex 13124-13124;
SG_MUL_VAL_ 1557 GD_ID_WBZ_DPF_MINUTES_SINCE_REGEN DataIndex 13125-13125;
SG_MUL_VAL_ 1557 GD_ID_WBZ_DPF_STATI DataIndex 13126-13126;
SG_MUL_VAL_ 1557 GD_ID_WBZ_DPF_INHIBITED_STATI DataIndex 13128-13128;
SG_MUL_VAL_ 1557 GD_ID_WBZ_DPF_CONTROL_REGEN DataIndex 13129-13129;
SG_MUL_VAL_ 1557 GD_ID_WBZ_DPF_ENABLE_REGEN_Status DataIndex 13130-13130;
SG_MUL_VAL_ 1557 GD_ID_WBZ_DPF_ENABLE_REGEN DataIndex 13130-13130;
SG_MUL_VAL_ 1557 GD_ID_WBZ_ErrorManagement_Status DataIndex 13294-13294;
SG_MUL_VAL_ 1557 GD_ID_WBZ_ErrorManagement DataIndex 13294-13294;
SG_MUL_VAL_ 1557 GD_ID_WBZ_LifeMessage DataIndex 13311-13311;

SG_MUL_VAL_ 1557 GD_ID_SystemBrigthness DataIndex 13376-13376;
SG_MUL_VAL_ 1557 GD_ID_SystemBrightness_Errors DataIndex 13440-13440;
SG_MUL_VAL_ 1557 GD_ID_SBL_ErrorManagement_Status DataIndex 13806-13806;
SG_MUL_VAL_ 1557 GD_ID_SBL_ErrorManagement DataIndex 13806-13806;
SG_MUL_VAL_ 1557 GD_ID_SBL_LifeMessage DataIndex 13823-13823;

SG_MUL_VAL_ 1557 GD_ID_Current_Track_Width DataIndex 13824-13824;
SG_MUL_VAL_ 1557 GD_ID_TA_Min_Track_Width DataIndex 13825-13825;
SG_MUL_VAL_ 1557 GD_ID_Max_Track_Width DataIndex 13826-13826;
SG_MUL_VAL_ 1557 GD_ID_Calib_State_Track_Width_Status DataIndex 13827-13827;
SG_MUL_VAL_ 1557 GD_ID_Calib_State_Track_Width DataIndex 13827-13827;
SG_MUL_VAL_ 1557 GD_ID_TA_Front_Axle_Width DataIndex 13828-13828;
SG_MUL_VAL_ 1557 GD_ID_TA_Front_Track_Width DataIndex 13829-13829;
SG_MUL_VAL_ 1557 GD_ID_TA_Rear_Axle_Width DataIndex 13830-13830;
SG_MUL_VAL_ 1557 GD_ID_TA_Rear_Track_Width DataIndex 13831-13831;
SG_MUL_VAL_ 1557 GD_ID_Track_Adjust_Errors_Status DataIndex 13832-13832;
SG_MUL_VAL_ 1557 GD_ID_Track_Adjust_Errors DataIndex 13832-13832;
SG_MUL_VAL_ 1557 GD_ID_TA_Calibration_Command DataIndex 13833-13833;
SG_MUL_VAL_ 1557 GD_ID_TA_Calibration_State DataIndex 13834-13834;
SG_MUL_VAL_ 1557 GD_ID_TA_MANUAL_IN_Status DataIndex 13835-13835;
SG_MUL_VAL_ 1557 GD_ID_TA_MANUAL_IN DataIndex 13835-13835;
SG_MUL_VAL_ 1557 GD_ID_TA_MANUAL_OUT_Status DataIndex 13836-13836;
SG_MUL_VAL_ 1557 GD_ID_TA_MANUAL_OUT DataIndex 13836-13836;
SG_MUL_VAL_ 1557 GD_ID_TA_Actual_Front_In_R_Status DataIndex 13839-13839;
SG_MUL_VAL_ 1557 GD_ID_TA_Actual_Front_In_R DataIndex 13839-13839;
SG_MUL_VAL_ 1557 GD_ID_TA_Actual_Front_Out_R_Status DataIndex 13840-13840;
SG_MUL_VAL_ 1557 GD_ID_TA_Actual_Front_Out_R DataIndex 13840-13840;
SG_MUL_VAL_ 1557 GD_ID_TA_Actual_Rear_In_R_Status DataIndex 13841-13841;
SG_MUL_VAL_ 1557 GD_ID_TA_Actual_Rear_In_R DataIndex 13841-13841;
SG_MUL_VAL_ 1557 GD_ID_TA_Actual_Rear_Out_R_Status DataIndex 13842-13842;
SG_MUL_VAL_ 1557 GD_ID_TA_Actual_Rear_Out_R DataIndex 13842-13842;
SG_MUL_VAL_ 1557 GD_ID_TA_Actual_Front_In_Status DataIndex 13843-13843;
SG_MUL_VAL_ 1557 GD_ID_TA_Actual_Front_In DataIndex 13843-13843;
SG_MUL_VAL_ 1557 GD_ID_TA_Actual_Front_Out_Status DataIndex 13844-13844;
SG_MUL_VAL_ 1557 GD_ID_TA_Actual_Front_Out DataIndex 13844-13844;
SG_MUL_VAL_ 1557 GD_ID_TA_Actual_Rear_In_Status DataIndex 13845-13845;
SG_MUL_VAL_ 1557 GD_ID_TA_Actual_Rear_In DataIndex 13845-13845;
SG_MUL_VAL_ 1557 GD_ID_TA_Actual_Rear_Out_Status DataIndex 13846-13846;
SG_MUL_VAL_ 1557 GD_ID_TA_Actual_Rear_Out DataIndex 13846-13846;
SG_MUL_VAL_ 1557 GD_ID_Track_Adjust_Equipped_Status DataIndex 13847-13847;
SG_MUL_VAL_ 1557 GD_ID_Track_Adjust_Equipped DataIndex 13847-13847;
SG_MUL_VAL_ 1557 GD_ID_TA_Min_Tire_Track_Width DataIndex 13848-13848;
SG_MUL_VAL_ 1557 GD_ID_Current_Axle_Width DataIndex 13849-13849;
SG_MUL_VAL_ 1557 GD_ID_TA_Operation_State_Status DataIndex 13850-13850;
SG_MUL_VAL_ 1557 GD_ID_TA_Operation_State DataIndex 13850-13850;
SG_MUL_VAL_ 1557 GD_ID_TA_In_Tolerance_Status DataIndex 13851-13851;
SG_MUL_VAL_ 1557 GD_ID_TA_In_Tolerance DataIndex 13851-13851;
SG_MUL_VAL_ 1557 GD_ID_TA_Auto_Enable_A_Status DataIndex 13852-13852;
SG_MUL_VAL_ 1557 GD_ID_TA_Auto_Enable_A DataIndex 13852-13852;
SG_MUL_VAL_ 1557 GD_ID_TA_Auto_Enable_B_Status DataIndex 13853-13853;
SG_MUL_VAL_ 1557 GD_ID_TA_Auto_Enable_B DataIndex 13853-13853;
SG_MUL_VAL_ 1557 GD_ID_TA_Auto_Enable_Dual_Status DataIndex 13854-13854;
SG_MUL_VAL_ 1557 GD_ID_TA_Auto_Enable_Dual DataIndex 13854-13854;
SG_MUL_VAL_ 1557 GD_ID_TA_Setpoint_A DataIndex 13855-13855;
SG_MUL_VAL_ 1557 GD_ID_TA_Setpoint_B DataIndex 13856-13856;
SG_MUL_VAL_ 1557 GD_ID_TA_Setpoint_Dual_Front DataIndex 13857-13857;
SG_MUL_VAL_ 1557 GD_ID_TA_Setpoint_Dual_Rear DataIndex 13858-13858;
SG_MUL_VAL_ 1557 GD_ID_TA_Equipped_Status DataIndex 13864-13864;
SG_MUL_VAL_ 1557 GD_ID_TA_Equipped DataIndex 13864-13864;
SG_MUL_VAL_ 1557 GD_ID_TA_FL_POSITION DataIndex 13874-13874;
SG_MUL_VAL_ 1557 GD_ID_TA_FR_POSITION DataIndex 13875-13875;
SG_MUL_VAL_ 1557 GD_ID_TA_RL_POSITION DataIndex 13876-13876;
SG_MUL_VAL_ 1557 GD_ID_TA_RR_POSITION DataIndex 13877-13877;
SG_MUL_VAL_ 1557 GD_ID_TA_Setpoint_A_Rear_Status DataIndex 13878-13878;
SG_MUL_VAL_ 1557 GD_ID_TA_Setpoint_A_Rear DataIndex 13878-13878;
SG_MUL_VAL_ 1557 GD_ID_TA_Setpoint_B_Rear_Status DataIndex 13879-13879;
SG_MUL_VAL_ 1557 GD_ID_TA_Setpoint_B_Rear DataIndex 13879-13879;
SG_MUL_VAL_ 1557 GD_ID_TA_TARGET_TRACKWIDTH_FL DataIndex 13880-13880;
SG_MUL_VAL_ 1557 GD_ID_TA_TARGET_TRACKWIDTH_FR DataIndex 13881-13881;
SG_MUL_VAL_ 1557 GD_ID_TA_TARGET_TRACKWIDTH_RL DataIndex 13882-13882;
SG_MUL_VAL_ 1557 GD_ID_TA_TARGET_TRACKWIDTH_RR DataIndex 13883-13883;
SG_MUL_VAL_ 1557 GD_ID_TA_ADDITIONAL_WIDTH_FL DataIndex 13884-13884;
SG_MUL_VAL_ 1557 GD_ID_TA_ADDITIONAL_WIDTH_FR DataIndex 13885-13885;
SG_MUL_VAL_ 1557 GD_ID_TA_ADDITIONAL_WIDTH_RL DataIndex 13886-13886;
SG_MUL_VAL_ 1557 GD_ID_TA_ADDITIONAL_WIDTH_RR DataIndex 13887-13887;
SG_MUL_VAL_ 1557 GD_ID_TA_ErrorManagement_Status DataIndex 14318-14318;
SG_MUL_VAL_ 1557 GD_ID_TA_ErrorManagement DataIndex 14318-14318;
SG_MUL_VAL_ 1557 GD_ID_TA_LifeMessage DataIndex 14335-14335;

SG_MUL_VAL_ 1557 GD_ID_RG3_HYDRAULIC_LEVEL DataIndex 15360-15360;
SG_MUL_VAL_ 1557 GD_ID_RG3_TURN_SCT_TO_OFF_Status DataIndex 15361-15361;
SG_MUL_VAL_ 1557 GD_ID_RG3_TURN_SCT_TO_OFF DataIndex 15361-15361;
SG_MUL_VAL_ 1557 GD_ID_RG3_HVAC_COMPRESSOR_Status DataIndex 15362-15362;
SG_MUL_VAL_ 1557 GD_ID_RG3_HVAC_COMPRESSOR DataIndex 15362-15362;
SG_MUL_VAL_ 1557 GD_ID_RG3_HVAC_INPUT_VOLTAGE DataIndex 15363-15363;
SG_MUL_VAL_ 1557 GD_ID_RG3_FRONT_SYS_PUMP_COMMAND_Status DataIndex 15364-15364;
SG_MUL_VAL_ 1557 GD_ID_RG3_FRONT_SYS_PUMP_COMMAND DataIndex 15364-15364;
SG_MUL_VAL_ 1557 GD_ID_RG3_FRONT_SYS_PUMP_ACTUAL DataIndex 15365-15365;
SG_MUL_VAL_ 1557 GD_ID_RG3_REAR_SYS_PUMP_COMMAND_Status DataIndex 15366-15366;
SG_MUL_VAL_ 1557 GD_ID_RG3_REAR_SYS_PUMP_COMMAND DataIndex 15366-15366;
SG_MUL_VAL_ 1557 GD_ID_RG3_REAR_SYS_PUMP_ACTUAL DataIndex 15367-15367;
SG_MUL_VAL_ 1557 GD_ID_RG3_TI_ACCESS DataIndex 15460-15460;
SG_MUL_VAL_ 1557 GD_ID_RG3_OPERATOR_PRESENCE_Status DataIndex 15860-15860;
SG_MUL_VAL_ 1557 GD_ID_RG3_OPERATOR_PRESENCE DataIndex 15860-15860;
SG_MUL_VAL_ 1557 GD_ID_RG3_ErrorManagement_Status DataIndex 15854-15854;
SG_MUL_VAL_ 1557 GD_ID_RG3_ErrorManagement DataIndex 15854-15854;
SG_MUL_VAL_ 1557 GD_ID_RG3_LifeMessage DataIndex 15871-15871;

SG_MUL_VAL_ 1557 GD_ID_EMM_SIGNAL_LN00_ERROR_W_Status DataIndex 15872-15872;
SG_MUL_VAL_ 1557 GD_ID_EMM_SIGNAL_LN00_ERROR_W DataIndex 15872-15872;
SG_MUL_VAL_ 1557 GD_ID_EMM_SIGNAL_LN01_ERROR_W_Status DataIndex 15873-15873;
SG_MUL_VAL_ 1557 GD_ID_EMM_SIGNAL_LN01_ERROR_W DataIndex 15873-15873;
SG_MUL_VAL_ 1557 GD_ID_EMM_SIGNAL_LN02_ERROR_W_Status DataIndex 15874-15874;
SG_MUL_VAL_ 1557 GD_ID_EMM_SIGNAL_LN02_ERROR_W DataIndex 15874-15874;
SG_MUL_VAL_ 1557 GD_ID_EMM_SIGNAL_LN03_ERROR_W_Status DataIndex 15875-15875;
SG_MUL_VAL_ 1557 GD_ID_EMM_SIGNAL_LN03_ERROR_W DataIndex 15875-15875;
SG_MUL_VAL_ 1557 GD_ID_EMM_SIGNAL_LN04_ERROR_W_Status DataIndex 15876-15876;
SG_MUL_VAL_ 1557 GD_ID_EMM_SIGNAL_LN04_ERROR_W DataIndex 15876-15876;
SG_MUL_VAL_ 1557 GD_ID_EMM_SIGNAL_LN05_ERROR_W_Status DataIndex 15877-15877;
SG_MUL_VAL_ 1557 GD_ID_EMM_SIGNAL_LN05_ERROR_W DataIndex 15877-15877;
SG_MUL_VAL_ 1557 GD_ID_EMM_SIGNAL_LN06_ERROR_W_Status DataIndex 15878-15878;
SG_MUL_VAL_ 1557 GD_ID_EMM_SIGNAL_LN06_ERROR_W DataIndex 15878-15878;
SG_MUL_VAL_ 1557 GD_ID_EMM_SIGNAL_LN07_ERROR_W_Status DataIndex 15879-15879;
SG_MUL_VAL_ 1557 GD_ID_EMM_SIGNAL_LN07_ERROR_W DataIndex 15879-15879;
SG_MUL_VAL_ 1557 GD_ID_EMM_SIGNAL_LN08_ERROR_W_Status DataIndex 15880-15880;
SG_MUL_VAL_ 1557 GD_ID_EMM_SIGNAL_LN08_ERROR_W DataIndex 15880-15880;
SG_MUL_VAL_ 1557 GD_ID_EMM_SIGNAL_LN09_ERROR_W_Status DataIndex 15881-15881;
SG_MUL_VAL_ 1557 GD_ID_EMM_SIGNAL_LN09_ERROR_W DataIndex 15881-15881;
SG_MUL_VAL_ 1557 GD_ID_EMM_SIGNAL_LN10_ERROR_W_Status DataIndex 15882-15882;
SG_MUL_VAL_ 1557 GD_ID_EMM_SIGNAL_LN10_ERROR_W DataIndex 15882-15882;
SG_MUL_VAL_ 1557 GD_ID_EMM_SIGNAL_LN11_ERROR_W_Status DataIndex 15883-15883;
SG_MUL_VAL_ 1557 GD_ID_EMM_SIGNAL_LN11_ERROR_W DataIndex 15883-15883;
SG_MUL_VAL_ 1557 GD_ID_EMM_SIGNAL_LN12_ERROR_W_Status DataIndex 15884-15884;
SG_MUL_VAL_ 1557 GD_ID_EMM_SIGNAL_LN12_ERROR_W DataIndex 15884-15884;
SG_MUL_VAL_ 1557 GD_ID_EMM_SIGNAL_LN13_ERROR_W_Status DataIndex 15885-15885;
SG_MUL_VAL_ 1557 GD_ID_EMM_SIGNAL_LN13_ERROR_W DataIndex 15885-15885;
SG_MUL_VAL_ 1557 GD_ID_EMM_SIGNAL_LN14_ERROR_W_Status DataIndex 15886-15886;
SG_MUL_VAL_ 1557 GD_ID_EMM_SIGNAL_LN14_ERROR_W DataIndex 15886-15886;
SG_MUL_VAL_ 1557 GD_ID_EMM_SIGNAL_LN15_ERROR_W_Status DataIndex 15887-15887;
SG_MUL_VAL_ 1557 GD_ID_EMM_SIGNAL_LN15_ERROR_W DataIndex 15887-15887;
SG_MUL_VAL_ 1557 GD_ID_EMM_SIGNAL_LN16_ERROR_W_Status DataIndex 15888-15888;
SG_MUL_VAL_ 1557 GD_ID_EMM_SIGNAL_LN16_ERROR_W DataIndex 15888-15888;
SG_MUL_VAL_ 1557 GD_ID_EMM_SIGNAL_LN17_ERROR_W_Status DataIndex 15889-15889;
SG_MUL_VAL_ 1557 GD_ID_EMM_SIGNAL_LN17_ERROR_W DataIndex 15889-15889;
SG_MUL_VAL_ 1557 GD_ID_EMM_SIGNAL_LN18_ERROR_W_Status DataIndex 15890-15890;
SG_MUL_VAL_ 1557 GD_ID_EMM_SIGNAL_LN18_ERROR_W DataIndex 15890-15890;
SG_MUL_VAL_ 1557 GD_ID_EMM_SIGNAL_LN19_ERROR_W_Status DataIndex 15891-15891;
SG_MUL_VAL_ 1557 GD_ID_EMM_SIGNAL_LN19_ERROR_W DataIndex 15891-15891;
SG_MUL_VAL_ 1557 GD_ID_EMM_SIGNAL_LN20_ERROR_W_Status DataIndex 15892-15892;
SG_MUL_VAL_ 1557 GD_ID_EMM_SIGNAL_LN20_ERROR_W DataIndex 15892-15892;
SG_MUL_VAL_ 1557 GD_ID_EMM_SIGNAL_LN21_ERROR_W_Status DataIndex 15893-15893;
SG_MUL_VAL_ 1557 GD_ID_EMM_SIGNAL_LN21_ERROR_W DataIndex 15893-15893;
SG_MUL_VAL_ 1557 GD_ID_EMM_SIGNAL_LN22_ERROR_W_Status DataIndex 15894-15894;
SG_MUL_VAL_ 1557 GD_ID_EMM_SIGNAL_LN22_ERROR_W DataIndex 15894-15894;
SG_MUL_VAL_ 1557 GD_ID_EMM_SIGNAL_LN23_ERROR_W_Status DataIndex 15895-15895;
SG_MUL_VAL_ 1557 GD_ID_EMM_SIGNAL_LN23_ERROR_W DataIndex 15895-15895;
SG_MUL_VAL_ 1557 GD_ID_EMM_SIGNAL_LN24_ERROR_W_Status DataIndex 15896-15896;
SG_MUL_VAL_ 1557 GD_ID_EMM_SIGNAL_LN24_ERROR_W DataIndex 15896-15896;
SG_MUL_VAL_ 1557 GD_ID_EMM_SIGNAL_LN25_ERROR_W_Status DataIndex 15897-15897;
SG_MUL_VAL_ 1557 GD_ID_EMM_SIGNAL_LN25_ERROR_W DataIndex 15897-15897;
SG_MUL_VAL_ 1557 GD_ID_EMM_SIGNAL_LN26_ERROR_W_Status DataIndex 15898-15898;
SG_MUL_VAL_ 1557 GD_ID_EMM_SIGNAL_LN26_ERROR_W DataIndex 15898-15898;
SG_MUL_VAL_ 1557 GD_ID_EMM_SIGNAL_LN27_ERROR_W_Status DataIndex 15899-15899;
SG_MUL_VAL_ 1557 GD_ID_EMM_SIGNAL_LN27_ERROR_W DataIndex 15899-15899;
SG_MUL_VAL_ 1557 GD_ID_EMM_SIGNAL_LN28_ERROR_W_Status DataIndex 15900-15900;
SG_MUL_VAL_ 1557 GD_ID_EMM_SIGNAL_LN28_ERROR_W DataIndex 15900-15900;
SG_MUL_VAL_ 1557 GD_ID_EMM_SIGNAL_LN29_ERROR_W_Status DataIndex 15901-15901;
SG_MUL_VAL_ 1557 GD_ID_EMM_SIGNAL_LN29_ERROR_W DataIndex 15901-15901;
SG_MUL_VAL_ 1557 GD_ID_EMM_SIGNAL_LN30_ERROR_W_Status DataIndex 15902-15902;
SG_MUL_VAL_ 1557 GD_ID_EMM_SIGNAL_LN30_ERROR_W DataIndex 15902-15902;
SG_MUL_VAL_ 1557 GD_ID_EMM_SIGNAL_LN31_ERROR_W_Status DataIndex 15903-15903;
SG_MUL_VAL_ 1557 GD_ID_EMM_SIGNAL_LN31_ERROR_W DataIndex 15903-15903;
SG_MUL_VAL_ 1557 GD_ID_EMM_SIGNAL_LN32_ERROR_W_Status DataIndex 15904-15904;
SG_MUL_VAL_ 1557 GD_ID_EMM_SIGNAL_LN32_ERROR_W DataIndex 15904-15904;
SG_MUL_VAL_ 1557 GD_ID_EMM_SIGNAL_LN33_ERROR_W_Status DataIndex 15905-15905;
SG_MUL_VAL_ 1557 GD_ID_EMM_SIGNAL_LN33_ERROR_W DataIndex 15905-15905;
SG_MUL_VAL_ 1557 GD_ID_EMM_SIGNAL_LN34_ERROR_W_Status DataIndex 15906-15906;
SG_MUL_VAL_ 1557 GD_ID_EMM_SIGNAL_LN34_ERROR_W DataIndex 15906-15906;
SG_MUL_VAL_ 1557 GD_ID_EMM_SIGNAL_LN35_ERROR_W_Status DataIndex 15907-15907;
SG_MUL_VAL_ 1557 GD_ID_EMM_SIGNAL_LN35_ERROR_W DataIndex 15907-15907;
SG_MUL_VAL_ 1557 GD_ID_EMM_SIGNAL_LN36_ERROR_W_Status DataIndex 15908-15908;
SG_MUL_VAL_ 1557 GD_ID_EMM_SIGNAL_LN36_ERROR_W DataIndex 15908-15908;
SG_MUL_VAL_ 1557 GD_ID_EMM_SIGNAL_LN37_ERROR_W_Status DataIndex 15909-15909;
SG_MUL_VAL_ 1557 GD_ID_EMM_SIGNAL_LN37_ERROR_W DataIndex 15909-15909;
SG_MUL_VAL_ 1557 GD_ID_EMM_SIGNAL_LN38_ERROR_W_Status DataIndex 15910-15910;
SG_MUL_VAL_ 1557 GD_ID_EMM_SIGNAL_LN38_ERROR_W DataIndex 15910-15910;
SG_MUL_VAL_ 1557 GD_ID_EMM_SIGNAL_LN39_ERROR_W_Status DataIndex 15911-15911;
SG_MUL_VAL_ 1557 GD_ID_EMM_SIGNAL_LN39_ERROR_W DataIndex 15911-15911;
SG_MUL_VAL_ 1557 GD_ID_EMM_SIGNAL_LN40_ERROR_W_Status DataIndex 15912-15912;
SG_MUL_VAL_ 1557 GD_ID_EMM_SIGNAL_LN40_ERROR_W DataIndex 15912-15912;
SG_MUL_VAL_ 1557 GD_ID_EMM_SIGNAL_LN41_ERROR_W_Status DataIndex 15913-15913;
SG_MUL_VAL_ 1557 GD_ID_EMM_SIGNAL_LN41_ERROR_W DataIndex 15913-15913;
SG_MUL_VAL_ 1557 GD_ID_EMM_SIGNAL_LN42_ERROR_W_Status DataIndex 15914-15914;
SG_MUL_VAL_ 1557 GD_ID_EMM_SIGNAL_LN42_ERROR_W DataIndex 15914-15914;
SG_MUL_VAL_ 1557 GD_ID_EMM_SIGNAL_LN43_ERROR_W_Status DataIndex 15915-15915;
SG_MUL_VAL_ 1557 GD_ID_EMM_SIGNAL_LN43_ERROR_W DataIndex 15915-15915;
SG_MUL_VAL_ 1557 GD_ID_EMM_SIGNAL_LN44_ERROR_W_Status DataIndex 15916-15916;
SG_MUL_VAL_ 1557 GD_ID_EMM_SIGNAL_LN44_ERROR_W DataIndex 15916-15916;
SG_MUL_VAL_ 1557 GD_ID_EMM_SIGNAL_LN45_ERROR_W_Status DataIndex 15917-15917;
SG_MUL_VAL_ 1557 GD_ID_EMM_SIGNAL_LN45_ERROR_W DataIndex 15917-15917;
SG_MUL_VAL_ 1557 GD_ID_EMM_SIGNAL_LN46_ERROR_W_Status DataIndex 15918-15918;
SG_MUL_VAL_ 1557 GD_ID_EMM_SIGNAL_LN46_ERROR_W DataIndex 15918-15918;
SG_MUL_VAL_ 1557 GD_ID_EMM_SIGNAL_LN47_ERROR_W_Status DataIndex 15919-15919;
SG_MUL_VAL_ 1557 GD_ID_EMM_SIGNAL_LN47_ERROR_W DataIndex 15919-15919;
SG_MUL_VAL_ 1557 GD_ID_EMM_SIGNAL_LN48_ERROR_W_Status DataIndex 15920-15920;
SG_MUL_VAL_ 1557 GD_ID_EMM_SIGNAL_LN48_ERROR_W DataIndex 15920-15920;
SG_MUL_VAL_ 1557 GD_ID_EMM_SIGNAL_LN49_ERROR_W_Status DataIndex 15921-15921;
SG_MUL_VAL_ 1557 GD_ID_EMM_SIGNAL_LN49_ERROR_W DataIndex 15921-15921;
SG_MUL_VAL_ 1557 GD_ID_EMM_SIGNAL_LN50_ERROR_W_Status DataIndex 15922-15922;
SG_MUL_VAL_ 1557 GD_ID_EMM_SIGNAL_LN50_ERROR_W DataIndex 15922-15922;
SG_MUL_VAL_ 1557 GD_ID_EMM_SIGNAL_LN51_ERROR_W_Status DataIndex 15923-15923;
SG_MUL_VAL_ 1557 GD_ID_EMM_SIGNAL_LN51_ERROR_W DataIndex 15923-15923;
SG_MUL_VAL_ 1557 GD_ID_EMM_SIGNAL_LN52_ERROR_W_Status DataIndex 15924-15924;
SG_MUL_VAL_ 1557 GD_ID_EMM_SIGNAL_LN52_ERROR_W DataIndex 15924-15924;
SG_MUL_VAL_ 1557 GD_ID_EMM_SIGNAL_LN53_ERROR_W_Status DataIndex 15925-15925;
SG_MUL_VAL_ 1557 GD_ID_EMM_SIGNAL_LN53_ERROR_W DataIndex 15925-15925;
SG_MUL_VAL_ 1557 GD_ID_EMM_SIGNAL_LN54_ERROR_W_Status DataIndex 15926-15926;
SG_MUL_VAL_ 1557 GD_ID_EMM_SIGNAL_LN54_ERROR_W DataIndex 15926-15926;
SG_MUL_VAL_ 1557 GD_ID_EMM_SIGNAL_LN55_ERROR_W_Status DataIndex 15927-15927;
SG_MUL_VAL_ 1557 GD_ID_EMM_SIGNAL_LN55_ERROR_W DataIndex 15927-15927;
SG_MUL_VAL_ 1557 GD_ID_EMM_SIGNAL_LN56_ERROR_W_Status DataIndex 15928-15928;
SG_MUL_VAL_ 1557 GD_ID_EMM_SIGNAL_LN56_ERROR_W DataIndex 15928-15928;
SG_MUL_VAL_ 1557 GD_ID_EMM_SIGNAL_LN57_ERROR_W_Status DataIndex 15929-15929;
SG_MUL_VAL_ 1557 GD_ID_EMM_SIGNAL_LN57_ERROR_W DataIndex 15929-15929;
SG_MUL_VAL_ 1557 GD_ID_EMM_SIGNAL_LN58_ERROR_W_Status DataIndex 15930-15930;
SG_MUL_VAL_ 1557 GD_ID_EMM_SIGNAL_LN58_ERROR_W DataIndex 15930-15930;
SG_MUL_VAL_ 1557 GD_ID_EMM_SIGNAL_LN59_ERROR_W_Status DataIndex 15931-15931;
SG_MUL_VAL_ 1557 GD_ID_EMM_SIGNAL_LN59_ERROR_W DataIndex 15931-15931;
SG_MUL_VAL_ 1557 GD_ID_EMM_SIGNAL_LN60_ERROR_W_Status DataIndex 15932-15932;
SG_MUL_VAL_ 1557 GD_ID_EMM_SIGNAL_LN60_ERROR_W DataIndex 15932-15932;
SG_MUL_VAL_ 1557 GD_ID_EMM_SIGNAL_LN61_ERROR_W_Status DataIndex 15933-15933;
SG_MUL_VAL_ 1557 GD_ID_EMM_SIGNAL_LN61_ERROR_W DataIndex 15933-15933;
SG_MUL_VAL_ 1557 GD_ID_EMM_SIGNAL_LN62_ERROR_W_Status DataIndex 15934-15934;
SG_MUL_VAL_ 1557 GD_ID_EMM_SIGNAL_LN62_ERROR_W DataIndex 15934-15934;
SG_MUL_VAL_ 1557 GD_ID_EMM_SIGNAL_LN63_ERROR_W_Status DataIndex 15935-15935;
SG_MUL_VAL_ 1557 GD_ID_EMM_SIGNAL_LN63_ERROR_W DataIndex 15935-15935;
SG_MUL_VAL_ 1557 GD_ID_EMM_TERMINAL_TRANSFER_R_Status DataIndex 15938-15938;
SG_MUL_VAL_ 1557 GD_ID_EMM_TERMINAL_TRANSFER_R DataIndex 15938-15938;
SG_MUL_VAL_ 1557 GD_ID_EMM_ACM_TRANSFER_R_Status DataIndex 15939-15939;
SG_MUL_VAL_ 1557 GD_ID_EMM_ACM_TRANSFER_R DataIndex 15939-15939;
SG_MUL_VAL_ 1557 GD_ID_EMM_TERMINAL_ACKNOWLEDGE_W_Status DataIndex 15970-15970;
SG_MUL_VAL_ 1557 GD_ID_EMM_TERMINAL_ACKNOWLEDGE_W DataIndex 15970-15970;
SG_MUL_VAL_ 1557 GD_ID_EMM_REQUEST_ENVVAR_W DataIndex 16000-16000;
SG_MUL_VAL_ 1557 GD_ID_EMM_ENV_VAR_VALUE1 DataIndex 16001-16001;
SG_MUL_VAL_ 1557 GD_ID_EMM_ENV_VAR_VALUE2 DataIndex 16002-16002;
SG_MUL_VAL_ 1557 GD_ID_EMM_ENV_VAR_VALUE3 DataIndex 16003-16003;
SG_MUL_VAL_ 1557 GD_ID_EMM_ENV_VAR_VALUE4 DataIndex 16004-16004;
SG_MUL_VAL_ 1557 GD_ID_EMM_ENV_VAR_VALUE5 DataIndex 16005-16005;
SG_MUL_VAL_ 1557 GD_ID_EMM_ENV_VAR_OPERATING_HOUR DataIndex 16006-16006;
SG_MUL_VAL_ 1557 GD_ID_EMM_ENV_VAR_ERROR_COUNTER DataIndex 16007-16007;
SG_MUL_VAL_ 1557 GD_ID_EMM_ENV_VAR_DATE1 DataIndex 16008-16008;
SG_MUL_VAL_ 1557 GD_ID_EMM_ENV_VAR_DATE2 DataIndex 16009-16009;
SG_MUL_VAL_ 1557 GD_ID_EMM_ENV_VAR_TIME1 DataIndex 16010-16010;
SG_MUL_VAL_ 1557 GD_ID_EMM_ENV_VAR_TIME2 DataIndex 16011-16011;
SG_MUL_VAL_ 1557 GD_ID_EMM_ENV_VAR_STATUS DataIndex 16012-16012;
SG_MUL_VAL_ 1557 GD_ID_EMM_DEBUG_SET_RESET_ERROR DataIndex 16127-16127;
SG_MUL_VAL_ 1557 GD_ID_EMM_STATUS_R DataIndex 16128-16128;
SG_MUL_VAL_ 1557 GD_ID_EMM_ERR_LOG_DELETED_Status DataIndex 16172-16172;
SG_MUL_VAL_ 1557 GD_ID_EMM_ERR_LOG_DELETED DataIndex 16172-16172;
SG_MUL_VAL_ 1557 GD_ID_EMM_ERR_ACTIVE_Status DataIndex 16222-16222;
SG_MUL_VAL_ 1557 GD_ID_EMM_ERR_ACTIVE DataIndex 16222-16222;
SG_MUL_VAL_ 1557 GD_ID_EMM_ErrorManagement_Status DataIndex 16366-16366;
SG_MUL_VAL_ 1557 GD_ID_EMM_ErrorManagement DataIndex 16366-16366;
SG_MUL_VAL_ 1557 GD_ID_EMM_LifeMessage DataIndex 16383-16383;

SG_MUL_VAL_ 1557 GD_ID_PICTO_ErrorManagement_Status DataIndex 15854-15854;
SG_MUL_VAL_ 1557 GD_ID_PICTO_ErrorManagement DataIndex 15854-15854;
SG_MUL_VAL_ 1557 GD_ID_PICTO_LifeMessage DataIndex 15871-15871;

SG_MUL_VAL_ 1557 GD_ID_EFC_REQ_PWM_PCT DataIndex 26113-26113;
SG_MUL_VAL_ 1557 GD_ID_EFC_TARGET_FAN_SPD DataIndex 26114-26114;
SG_MUL_VAL_ 1557 GD_ID_EFC_COOLING_DEMAND DataIndex 26115-26115;
SG_MUL_VAL_ 1557 GD_ID_EFC_USE_EC_Status DataIndex 26122-26122;
SG_MUL_VAL_ 1557 GD_ID_EFC_USE_EC DataIndex 26122-26122;
SG_MUL_VAL_ 1557 GD_ID_EFC_FACTOR_EC DataIndex 26123-26123;
SG_MUL_VAL_ 1557 GD_ID_EFC_MAX_TEMP_EC DataIndex 26124-26124;
SG_MUL_VAL_ 1557 GD_ID_EFC_MIN_TEMP_EC DataIndex 26125-26125;
SG_MUL_VAL_ 1557 GD_ID_EFC_USE_EF_Status DataIndex 26126-26126;
SG_MUL_VAL_ 1557 GD_ID_EFC_USE_EF DataIndex 26126-26126;
SG_MUL_VAL_ 1557 GD_ID_EFC_FACTOR_EF DataIndex 26127-26127;
SG_MUL_VAL_ 1557 GD_ID_EFC_MAX_TEMP_EF DataIndex 26128-26128;
SG_MUL_VAL_ 1557 GD_ID_EFC_MIN_TEMP_EF DataIndex 26129-26129;
SG_MUL_VAL_ 1557 GD_ID_EFC_USE_EM_Status DataIndex 26130-26130;
SG_MUL_VAL_ 1557 GD_ID_EFC_USE_EM DataIndex 26130-26130;
SG_MUL_VAL_ 1557 GD_ID_EFC_FACTOR_EM DataIndex 26131-26131;
SG_MUL_VAL_ 1557 GD_ID_EFC_MAX_TEMP_EM DataIndex 26132-26132;
SG_MUL_VAL_ 1557 GD_ID_EFC_MIN_TEMP_EM DataIndex 26133-26133;
SG_MUL_VAL_ 1557 GD_ID_EFC_USE_HO_Status DataIndex 26134-26134;
SG_MUL_VAL_ 1557 GD_ID_EFC_USE_HO DataIndex 26134-26134;
SG_MUL_VAL_ 1557 GD_ID_EFC_FACTOR_HO DataIndex 26135-26135;
SG_MUL_VAL_ 1557 GD_ID_EFC_MAX_TEMP_HO DataIndex 26136-26136;
SG_MUL_VAL_ 1557 GD_ID_EFC_MIN_TEMP_HO DataIndex 26137-26137;
SG_MUL_VAL_ 1557 GD_ID_EFC_USE_TO_Status DataIndex 26138-26138;
SG_MUL_VAL_ 1557 GD_ID_EFC_USE_TO DataIndex 26138-26138;
SG_MUL_VAL_ 1557 GD_ID_EFC_FACTOR_TO DataIndex 26139-26139;
SG_MUL_VAL_ 1557 GD_ID_EFC_MAX_TEMP_TO DataIndex 26140-26140;
SG_MUL_VAL_ 1557 GD_ID_EFC_MIN_TEMP_TO DataIndex 26141-26141;
SG_MUL_VAL_ 1557 GD_ID_EFC_USE_AC_Status DataIndex 26142-26142;
SG_MUL_VAL_ 1557 GD_ID_EFC_USE_AC DataIndex 26142-26142;
SG_MUL_VAL_ 1557 GD_ID_EFC_FACTOR_AC DataIndex 26143-26143;
SG_MUL_VAL_ 1557 GD_ID_EFC_PWM_OVERRIDE_Status DataIndex 26144-26144;
SG_MUL_VAL_ 1557 GD_ID_EFC_PWM_OVERRIDE DataIndex 26144-26144;
SG_MUL_VAL_ 1557 GD_ID_EFC_TARGET_SPD_OVERRIDE_Status DataIndex 26145-26145;
SG_MUL_VAL_ 1557 GD_ID_EFC_TARGET_SPD_OVERRIDE DataIndex 26145-26145;
SG_MUL_VAL_ 1557 GD_ID_EFC_TARGET_FAN_WING_ANGLE_Status DataIndex 26146-26146;
SG_MUL_VAL_ 1557 GD_ID_EFC_TARGET_FAN_WING_ANGLE DataIndex 26146-26146;
SG_MUL_VAL_ 1557 GD_ID_EFC_ACTUAL_FAN_WING_ANGLE DataIndex 26147-26147;
SG_MUL_VAL_ 1557 GD_ID_EFC_TARGET_COOLANT_TEMP DataIndex 26148-26148;
SG_MUL_VAL_ 1557 GD_ID_EFC_TARGET_MANIFOLD_TEMP DataIndex 26149-26149;
SG_MUL_VAL_ 1557 GD_ID_EFC_COOLANT_I_GAIN DataIndex 26150-26150;
SG_MUL_VAL_ 1557 GD_ID_EFC_COOLANT_P_A_GAIN DataIndex 26151-26151;
SG_MUL_VAL_ 1557 GD_ID_EFC_COOLANT_P_B_GAIN DataIndex 26152-26152;
SG_MUL_VAL_ 1557 GD_ID_EFC_COOLANT_P_C_GAIN DataIndex 26153-26153;
SG_MUL_VAL_ 1557 GD_ID_EFC_MANIFOLD_I_GAIN DataIndex 26154-26154;
SG_MUL_VAL_ 1557 GD_ID_EFC_MANIFOLD_P_A_GAIN DataIndex 26155-26155;
SG_MUL_VAL_ 1557 GD_ID_EFC_MANIFOLD_P_B_GAIN DataIndex 26156-26156;
SG_MUL_VAL_ 1557 GD_ID_EFC_MANIFOLD_P_C_GAIN DataIndex 26157-26157;
SG_MUL_VAL_ 1557 GD_ID_EFC_INLET_VALVE_P_GAIN DataIndex 26158-26158;
SG_MUL_VAL_ 1557 GD_ID_EFC_INLET_VALVE_I_TIME DataIndex 26159-26159;
SG_MUL_VAL_ 1557 GD_ID_EFC_INLET_ACTIVATION_CYCLES DataIndex 26160-26160;
SG_MUL_VAL_ 1557 GD_ID_EFC_INLET_GRADIENT_TRESHOLD DataIndex 26161-26161;
SG_MUL_VAL_ 1557 GD_ID_EFC_INLET_MAX_ENERGIZE_TIME DataIndex 26162-26162;
SG_MUL_VAL_ 1557 GD_ID_EFC_OUTLET_VALVE_P_GAIN DataIndex 26163-26163;
SG_MUL_VAL_ 1557 GD_ID_EFC_OUTLET_VALVE_I_TIME DataIndex 26164-26164;
SG_MUL_VAL_ 1557 GD_ID_EFC_OUTLET_ACTIVATION_CYCLES DataIndex 26165-26165;
SG_MUL_VAL_ 1557 GD_ID_EFC_OUTLET_GRADIENT_TRESHOLD DataIndex 26166-26166;
SG_MUL_VAL_ 1557 GD_ID_EFC_OUTLET_MAX_ENERGIZE_TIME DataIndex 26167-26167;
SG_MUL_VAL_ 1557 GD_ID_EFC_STARTUP_STATE DataIndex 26168-26168;
SG_MUL_VAL_ 1557 GD_ID_EFC_FAN_ANGLE_WINNER DataIndex 26169-26169;
SG_MUL_VAL_ 1557 GD_ID_EFC_REVERSE_LOCK_REASONS DataIndex 26170-26170;
SG_MUL_VAL_ 1557 GD_ID_EFC_ERROR_REASONS DataIndex 26171-26171;
SG_MUL_VAL_ 1557 GD_ID_EFC_REVERSE_STATE_Status DataIndex 26172-26172;
SG_MUL_VAL_ 1557 GD_ID_EFC_REVERSE_STATE DataIndex 26172-26172;
SG_MUL_VAL_ 1557 GD_ID_EFC_REVERSIBLE_FAN_RPM DataIndex 26173-26173;
SG_MUL_VAL_ 1557 GD_ID_EFC_INLET_PAUSE_TIME DataIndex 26174-26174;
SG_MUL_VAL_ 1557 GD_ID_EFC_INLET_PAUSE_TIME_EXTENSION DataIndex 26175-26175;
SG_MUL_VAL_ 1557 GD_ID_EFC_OUTLET_PAUSE_TIME DataIndex 26176-26176;
SG_MUL_VAL_ 1557 GD_ID_EFC_OUTLET_PAUSE_TIME_EXTENSION DataIndex 26177-26177;
SG_MUL_VAL_ 1557 GD_ID_EFC_START_MANUAL_REVERSING DataIndex 26178-26178;
SG_MUL_VAL_ 1557 GD_ID_EFC_STOP_REVERSING DataIndex 26179-26179;
SG_MUL_VAL_ 1557 GD_ID_EFC_ENABLE_AUTOMATIC_REVERSING DataIndex 26180-26180;
SG_MUL_VAL_ 1557 GD_ID_EFC_BLOW_OUT_DURATION DataIndex 26181-26181;
SG_MUL_VAL_ 1557 GD_ID_EFC_BLOW_OUT_PERIOD DataIndex 26182-26182;
SG_MUL_VAL_ 1557 GD_ID_EFC_ANGLE_SENSOR_VOLTAGE DataIndex 26183-26183;
SG_MUL_VAL_ 1557 GD_ID_EFC_BLOW_OUT_DURATION_MIN DataIndex 26184-26184;
SG_MUL_VAL_ 1557 GD_ID_EFC_BLOW_OUT_DURATION_MAX DataIndex 26185-26185;
SG_MUL_VAL_ 1557 GD_ID_EFC_BLOW_OUT_PERIOD_MIN DataIndex 26186-26186;
SG_MUL_VAL_ 1557 GD_ID_EFC_BLOW_OUT_PERIOD_MAX DataIndex 26187-26187;
SG_MUL_VAL_ 1557 GD_ID_EFC_ErrorManagement_Status DataIndex 26606-26606;
SG_MUL_VAL_ 1557 GD_ID_EFC_ErrorManagement DataIndex 26606-26606;
SG_MUL_VAL_ 1557 GD_ID_EFC_LifeMessage DataIndex 26623-26623;

SG_MUL_VAL_ 1557 GD_ID_ECAD_LOGIC_STATE DataIndex 26624-26624;
SG_MUL_VAL_ 1557 GD_ID_ECAD_VALVE_STATE DataIndex 26625-26625;
SG_MUL_VAL_ 1557 GD_ID_ECAD_GOVENOR_VALVE_Status DataIndex 26626-26626;
SG_MUL_VAL_ 1557 GD_ID_ECAD_GOVENOR_VALVE DataIndex 26626-26626;
SG_MUL_VAL_ 1557 GD_ID_ECAD_REGEN_VALVE_Status DataIndex 26627-26627;
SG_MUL_VAL_ 1557 GD_ID_ECAD_REGEN_VALVE DataIndex 26627-26627;
SG_MUL_VAL_ 1557 GD_ID_ECAD_AIR_VOLUME DataIndex 26628-26628;
SG_MUL_VAL_ 1557 GD_ID_ECAD_REGEN_VOLUME DataIndex 26629-26629;
SG_MUL_VAL_ 1557 GD_ID_ECAD_REGEN_TARGET DataIndex 26630-26630;
SG_MUL_VAL_ 1557 GD_ID_ECAD_COMPRESSOR_RPM DataIndex 26631-26631;
SG_MUL_VAL_ 1557 GD_ID_ECAD_AIR_FLOW DataIndex 26632-26632;
SG_MUL_VAL_ 1557 GD_ID_ECAD_REGEN_FLOW DataIndex 26633-26633;
SG_MUL_VAL_ 1557 GD_ID_ECAD_REGEN_FLOW_SCALED DataIndex 26634-26634;
SG_MUL_VAL_ 1557 GD_ID_ECAD_NET_FLOW DataIndex 26635-26635;
SG_MUL_VAL_ 1557 GD_ID_ECAD_HEATER_Status DataIndex 26636-26636;
SG_MUL_VAL_ 1557 GD_ID_ECAD_HEATER DataIndex 26636-26636;
SG_MUL_VAL_ 1557 GD_ID_ECAD_ErrorManagement_Status DataIndex 27118-27118;
SG_MUL_VAL_ 1557 GD_ID_ECAD_ErrorManagement DataIndex 27118-27118;
SG_MUL_VAL_ 1557 GD_ID_ECAD_LifeMessage DataIndex 27135-27135;

SG_MUL_VAL_ 1557 GD_ID_4WS_REQUESTED_MODE DataIndex 28161-28161;
SG_MUL_VAL_ 1557 GD_ID_4WS_CURRENT_MODE DataIndex 28162-28162;
SG_MUL_VAL_ 1557 GD_ID_4WS_JOG_LEFT_Status DataIndex 28166-28166;
SG_MUL_VAL_ 1557 GD_ID_4WS_JOG_LEFT DataIndex 28166-28166;
SG_MUL_VAL_ 1557 GD_ID_4WS_JOG_RIGHT_Status DataIndex 28167-28167;
SG_MUL_VAL_ 1557 GD_ID_4WS_JOG_RIGHT DataIndex 28167-28167;
SG_MUL_VAL_ 1557 GD_ID_4WS_JOG_CLEAR_Status DataIndex 28168-28168;
SG_MUL_VAL_ 1557 GD_ID_4WS_JOG_CLEAR DataIndex 28168-28168;
SG_MUL_VAL_ 1557 GD_ID_4WS_JOG_ANGLE_Status DataIndex 28169-28169;
SG_MUL_VAL_ 1557 GD_ID_4WS_JOG_ANGLE DataIndex 28169-28169;
SG_MUL_VAL_ 1557 GD_ID_4WS_UI_FRONT_ANGLE_Status DataIndex 28175-28175;
SG_MUL_VAL_ 1557 GD_ID_4WS_UI_FRONT_ANGLE DataIndex 28175-28175;
SG_MUL_VAL_ 1557 GD_ID_4WS_UI_REAR_ANGLE_Status DataIndex 28176-28176;
SG_MUL_VAL_ 1557 GD_ID_4WS_UI_REAR_ANGLE DataIndex 28176-28176;
SG_MUL_VAL_ 1557 GD_ID_4WS_MACHINE_REAR_ANGLE DataIndex 28178-28178;
SG_MUL_VAL_ 1557 GD_ID_4WS_REAR_ANGLE_SETPOINT DataIndex 28179-28179;
SG_MUL_VAL_ 1557 GD_ID_4WS_REAR_ANGLE_SENSOR_VALUE DataIndex 28180-28180;
SG_MUL_VAL_ 1557 GD_ID_4WS_CURRENT_CONTROL_KP_Status DataIndex 28183-28183;
SG_MUL_VAL_ 1557 GD_ID_4WS_CURRENT_CONTROL_KP DataIndex 28183-28183;
SG_MUL_VAL_ 1557 GD_ID_4WS_CURRENT_CONTROL_KI_Status DataIndex 28184-28184;
SG_MUL_VAL_ 1557 GD_ID_4WS_CURRENT_CONTROL_KI DataIndex 28184-28184;
SG_MUL_VAL_ 1557 GD_ID_4WS_REAR_ANGLE_TARGET_Status DataIndex 28185-28185;
SG_MUL_VAL_ 1557 GD_ID_4WS_REAR_ANGLE_TARGET DataIndex 28185-28185;
SG_MUL_VAL_ 1557 GD_ID_4WS_LEFT_PWM_Status DataIndex 28186-28186;
SG_MUL_VAL_ 1557 GD_ID_4WS_LEFT_PWM DataIndex 28186-28186;
SG_MUL_VAL_ 1557 GD_ID_4WS_RIGHT_PWM_Status DataIndex 28187-28187;
SG_MUL_VAL_ 1557 GD_ID_4WS_RIGHT_PWM DataIndex 28187-28187;
SG_MUL_VAL_ 1557 GD_ID_4WS_RIGHT_VALVE_COIL_CURRENT DataIndex 28191-28191;
SG_MUL_VAL_ 1557 GD_ID_4WS_LEFT_VALVE_COIL_CURRENT DataIndex 28192-28192;
SG_MUL_VAL_ 1557 GD_ID_4WS_ANGLE_CONTROL_KP_Status DataIndex 28193-28193;
SG_MUL_VAL_ 1557 GD_ID_4WS_ANGLE_CONTROL_KP DataIndex 28193-28193;
SG_MUL_VAL_ 1557 GD_ID_4WS_ANGLE_CONTROL_KI_Status DataIndex 28194-28194;
SG_MUL_VAL_ 1557 GD_ID_4WS_ANGLE_CONTROL_KI DataIndex 28194-28194;
SG_MUL_VAL_ 1557 GD_ID_4WS_TARGET_CURRENT_Status DataIndex 28195-28195;
SG_MUL_VAL_ 1557 GD_ID_4WS_TARGET_CURRENT DataIndex 28195-28195;
SG_MUL_VAL_ 1557 GD_ID_4WS_CURRENT_CONTROL_KC_Status DataIndex 28196-28196;
SG_MUL_VAL_ 1557 GD_ID_4WS_CURRENT_CONTROL_KC DataIndex 28196-28196;
SG_MUL_VAL_ 1557 GD_ID_4WS_COMMAND_CURRENT_Status DataIndex 28201-28201;
SG_MUL_VAL_ 1557 GD_ID_4WS_COMMAND_CURRENT DataIndex 28201-28201;
SG_MUL_VAL_ 1557 GD_ID_4WS_ACTIVE_CURRENT_LOOP DataIndex 28202-28202;
SG_MUL_VAL_ 1557 GD_ID_4WS_UNFILTERED_REAR_ANGLE_Status DataIndex 28203-28203;
SG_MUL_VAL_ 1557 GD_ID_4WS_UNFILTERED_REAR_ANGLE DataIndex 28203-28203;
SG_MUL_VAL_ 1557 GD_ID_4WS_START_CURRENT_CALIB_COMMAND DataIndex 28210-28210;
SG_MUL_VAL_ 1557 GD_ID_4WS_START_CURRENT_CALIB_STATUS DataIndex 28211-28211;
SG_MUL_VAL_ 1557 GD_ID_4WS_REAR_ANGLE_CALIB_COMMAND DataIndex 28260-28260;
SG_MUL_VAL_ 1557 GD_ID_4WS_REAR_ANGLE_CALIB_STATUS DataIndex 28261-28261;
SG_MUL_VAL_ 1557 GD_ID_4WS_ErrorManagement_Status DataIndex 28654-28654;
SG_MUL_VAL_ 1557 GD_ID_4WS_ErrorManagement DataIndex 28654-28654;
SG_MUL_VAL_ 1557 GD_ID_4WS_LifeMessage DataIndex 28671-28671;

SG_MUL_VAL_ 1557 GD_ID_DASH_HAZARDS_LIGHT_Status DataIndex 1-1;
SG_MUL_VAL_ 1557 GD_ID_DASH_HAZARDS_LIGHT DataIndex 1-1;
SG_MUL_VAL_ 1557 GD_ID_DASH_BLINKER_TRAILER_1_Status DataIndex 2-2;
SG_MUL_VAL_ 1557 GD_ID_DASH_BLINKER_TRAILER_1 DataIndex 2-2;
SG_MUL_VAL_ 1557 GD_ID_DASH_BLINKER_TRAILER_2_Status DataIndex 3-3;
SG_MUL_VAL_ 1557 GD_ID_DASH_BLINKER_TRAILER_2 DataIndex 3-3;
SG_MUL_VAL_ 1557 GD_ID_DASH_BLINKER_LEFT_Status DataIndex 4-4;
SG_MUL_VAL_ 1557 GD_ID_DASH_BLINKER_LEFT DataIndex 4-4;
SG_MUL_VAL_ 1557 GD_ID_DASH_BLINKER_RIGHT_Status DataIndex 5-5;
SG_MUL_VAL_ 1557 GD_ID_DASH_BLINKER_RIGHT DataIndex 5-5;
SG_MUL_VAL_ 1557 GD_ID_DASH_HIGH_BEAM_LIGHT_Status DataIndex 6-6;
SG_MUL_VAL_ 1557 GD_ID_DASH_HIGH_BEAM_LIGHT DataIndex 6-6;
SG_MUL_VAL_ 1557 GD_ID_DASH_FORWARD_DRIVE_DIRECTION_ARROW DataIndex 7-7;
SG_MUL_VAL_ 1557 GD_ID_DASH_REVERSE_DRIVE_DIRECTION_ARROW DataIndex 8-8;
SG_MUL_VAL_ 1557 GD_ID_DASH_CRUISE_CONTROL_LIGHT_Status DataIndex 10-10;
SG_MUL_VAL_ 1557 GD_ID_DASH_CRUISE_CONTROL_LIGHT DataIndex 10-10;
SG_MUL_VAL_ 1557 GD_ID_DASH_4WD_LIGHT_Status DataIndex 11-11;
SG_MUL_VAL_ 1557 GD_ID_DASH_4WD_LIGHT DataIndex 11-11;
SG_MUL_VAL_ 1557 GD_ID_DASH_DIFFERENTIAL_LOCK_LIGHT_Status DataIndex 12-12;
SG_MUL_VAL_ 1557 GD_ID_DASH_DIFFERENTIAL_LOCK_LIGHT DataIndex 12-12;
SG_MUL_VAL_ 1557 GD_ID_DASH_BRAKE_PAD_WEAR_LIGHT_Status DataIndex 13-13;
SG_MUL_VAL_ 1557 GD_ID_DASH_BRAKE_PAD_WEAR_LIGHT DataIndex 13-13;
SG_MUL_VAL_ 1557 GD_ID_DASH_HYDRAULIC_OIL_TEMP DataIndex 14-14;
SG_MUL_VAL_ 1557 GD_ID_DASH_AIR_FILTER_POLUTION_Status DataIndex 15-15;
SG_MUL_VAL_ 1557 GD_ID_DASH_AIR_FILTER_POLUTION DataIndex 15-15;
SG_MUL_VAL_ 1557 GD_ID_DASH_BRAKE_FLUID_LEVEL_LIGHT_Status DataIndex 16-16;
SG_MUL_VAL_ 1557 GD_ID_DASH_BRAKE_FLUID_LEVEL_LIGHT DataIndex 16-16;
SG_MUL_VAL_ 1557 GD_ID_DASH_ENGINE_OIL_PRESSURE_Status DataIndex 17-17;
SG_MUL_VAL_ 1557 GD_ID_DASH_ENGINE_OIL_PRESSURE DataIndex 17-17;
SG_MUL_VAL_ 1557 GD_ID_DASH_CHARGE_AIR_TEMPERATURE DataIndex 18-18;
SG_MUL_VAL_ 1557 GD_ID_DASH_ENGINE_COOLANT_TEMPERATURE_BAR_GRAPH DataIndex 19-19;
SG_MUL_VAL_ 1557 GD_ID_DASH_FUEL_LEVEL_BAR_GRAPH DataIndex 20-20;
SG_MUL_VAL_ 1557 GD_ID_DASH_AIR_PRESSURE_LEVEL_1_BAR_GRAPH DataIndex 21-21;
SG_MUL_VAL_ 1557 GD_ID_DASH_AIR_PRESSURE_LEVEL_2 DataIndex 22-22;
SG_MUL_VAL_ 1557 GD_ID_DASH_DEF_LEVEL_BAR_GRAPH DataIndex 23-23;
SG_MUL_VAL_ 1557 GD_ID_DASH_ENGINE_SPEED DataIndex 24-24;
SG_MUL_VAL_ 1557 GD_ID_DASH_FRONT_PTO_SPEED DataIndex 25-25;
SG_MUL_VAL_ 1557 GD_ID_DASH_REAR_PTO_SPEED DataIndex 26-26;
SG_MUL_VAL_ 1557 GD_ID_DASH_THEORETICAL_VEHICLE_SPEED DataIndex 27-27;
SG_MUL_VAL_ 1557 GD_ID_DASH_ACTUAL_VEHICLE_SPEED DataIndex 28-28;
SG_MUL_VAL_ 1557 GD_ID_DASH_REAR_PTO_STATUS_Status DataIndex 29-29;
SG_MUL_VAL_ 1557 GD_ID_DASH_REAR_PTO_STATUS DataIndex 29-29;
SG_MUL_VAL_ 1557 GD_ID_DASH_REAR_PTO_POSITION DataIndex 30-30;
SG_MUL_VAL_ 1557 GD_ID_DASH_BUTTON_PRESSED_ENTER_Status DataIndex 31-31;
SG_MUL_VAL_ 1557 GD_ID_DASH_BUTTON_PRESSED_ENTER DataIndex 31-31;
SG_MUL_VAL_ 1557 GD_ID_DASH_BUTTON_PRESSED_ESC_Status DataIndex 32-32;
SG_MUL_VAL_ 1557 GD_ID_DASH_BUTTON_PRESSED_ESC DataIndex 32-32;
SG_MUL_VAL_ 1557 GD_ID_DASH_BUTTON_PRESSED_CURSOR_UP_Status DataIndex 33-33;
SG_MUL_VAL_ 1557 GD_ID_DASH_BUTTON_PRESSED_CURSOR_UP DataIndex 33-33;
SG_MUL_VAL_ 1557 GD_ID_DASH_BUTTON_PRESSED_CURSOR_DOWN_Status DataIndex 34-34;
SG_MUL_VAL_ 1557 GD_ID_DASH_BUTTON_PRESSED_CURSOR_DOWN DataIndex 34-34;
SG_MUL_VAL_ 1557 GD_ID_DASH_COLD_START_LIGHT_Status DataIndex 37-37;
SG_MUL_VAL_ 1557 GD_ID_DASH_COLD_START_LIGHT DataIndex 37-37;
SG_MUL_VAL_ 1557 GD_ID_DASH_SHOW_ENGINE_SPEED_SYMBOL_Status DataIndex 38-38;
SG_MUL_VAL_ 1557 GD_ID_DASH_SHOW_ENGINE_SPEED_SYMBOL DataIndex 38-38;
SG_MUL_VAL_ 1557 GD_ID_DASH_SHOW_FRONT_PTO_SPEED_SYMBOL_Status DataIndex 39-39;
SG_MUL_VAL_ 1557 GD_ID_DASH_SHOW_FRONT_PTO_SPEED_SYMBOL DataIndex 39-39;
SG_MUL_VAL_ 1557 GD_ID_DASH_SHOW_REAR_PTO_SPEED_SYMBOL_Status DataIndex 40-40;
SG_MUL_VAL_ 1557 GD_ID_DASH_SHOW_REAR_PTO_SPEED_SYMBOL DataIndex 40-40;
SG_MUL_VAL_ 1557 GD_ID_DASH_SHOW_ACTUAL_SPEED_SYMBOL_Status DataIndex 41-41;
SG_MUL_VAL_ 1557 GD_ID_DASH_SHOW_ACTUAL_SPEED_SYMBOL DataIndex 41-41;
SG_MUL_VAL_ 1557 GD_ID_DASH_SHOW_CRUISE_CONTROL_SPEED_SYMBOL_Status DataIndex 42-42;
SG_MUL_VAL_ 1557 GD_ID_DASH_SHOW_CRUISE_CONTROL_SPEED_SYMBOL DataIndex 42-42;
SG_MUL_VAL_ 1557 GD_ID_DASH_SHOW_KMPH_SYMBOL_Status DataIndex 43-43;
SG_MUL_VAL_ 1557 GD_ID_DASH_SHOW_KMPH_SYMBOL DataIndex 43-43;
SG_MUL_VAL_ 1557 GD_ID_DASH_SHOW_MPH_SYMBOL_Status DataIndex 44-44;
SG_MUL_VAL_ 1557 GD_ID_DASH_SHOW_MPH_SYMBOL DataIndex 44-44;
SG_MUL_VAL_ 1557 GD_ID_DASH_BACKLIGHT_INTENSITY DataIndex 45-45;
SG_MUL_VAL_ 1557 GD_ID_DASH_OPERATING_HOURS_Status DataIndex 46-46;
SG_MUL_VAL_ 1557 GD_ID_DASH_OPERATING_HOURS DataIndex 46-46;
SG_MUL_VAL_ 1557 GD_ID_DASH_TIME_MINUTES_AND_HOURS DataIndex 47-47;
SG_MUL_VAL_ 1557 GD_ID_DASH_TIME_SECONDS DataIndex 48-48;
SG_MUL_VAL_ 1557 GD_ID_DASH_TRANSMISSION_NEUTRAL_STATUS_Status DataIndex 50-50;
SG_MUL_VAL_ 1557 GD_ID_DASH_TRANSMISSION_NEUTRAL_STATUS DataIndex 50-50;
SG_MUL_VAL_ 1557 GD_ID_DASH_FILTER_CONTAMINATION_Status DataIndex 51-51;
SG_MUL_VAL_ 1557 GD_ID_DASH_FILTER_CONTAMINATION DataIndex 51-51;
SG_MUL_VAL_ 1557 GD_ID_DASH_SPARE_OUTPUT_1 DataIndex 52-52;
SG_MUL_VAL_ 1557 GD_ID_DASH_SPARE_OUTPUT_2 DataIndex 53-53;
SG_MUL_VAL_ 1557 GD_ID_DASH_ABS_TRAILER_LIGHT_Status DataIndex 54-54;
SG_MUL_VAL_ 1557 GD_ID_DASH_ABS_TRAILER_LIGHT DataIndex 54-54;
SG_MUL_VAL_ 1557 GD_ID_DASH_TRAILER_BRAKE_LIGHT_Status DataIndex 55-55;
SG_MUL_VAL_ 1557 GD_ID_DASH_TRAILER_BRAKE_LIGHT DataIndex 55-55;
SG_MUL_VAL_ 1557 GD_ID_DASH_REAR_FOG_LIGHT_Status DataIndex 56-56;
SG_MUL_VAL_ 1557 GD_ID_DASH_REAR_FOG_LIGHT DataIndex 56-56;
SG_MUL_VAL_ 1557 GD_ID_DASH_BUZZER_UNDERTONE_Status DataIndex 58-58;
SG_MUL_VAL_ 1557 GD_ID_DASH_BUZZER_UNDERTONE DataIndex 58-58;
SG_MUL_VAL_ 1557 GD_ID_DASH_BUZZER_LOUD_Status DataIndex 59-59;
SG_MUL_VAL_ 1557 GD_ID_DASH_BUZZER_LOUD DataIndex 59-59;
SG_MUL_VAL_ 1557 GD_ID_DASH_ABS_TRACTOR_LIGHT_Status DataIndex 60-60;
SG_MUL_VAL_ 1557 GD_ID_DASH_ABS_TRACTOR_LIGHT DataIndex 60-60;
SG_MUL_VAL_ 1557 GD_ID_DASH_SPARE_LIGHT_2_Status DataIndex 61-61;
SG_MUL_VAL_ 1557 GD_ID_DASH_SPARE_LIGHT_2 DataIndex 61-61;
SG_MUL_VAL_ 1557 GD_ID_DASH_DATE_YEAR DataIndex 70-70;
SG_MUL_VAL_ 1557 GD_ID_DASH_DATE_MONTH_DAY DataIndex 71-71;
SG_MUL_VAL_ 1557 GD_ID_DASH_LOCK_STATUS_Status DataIndex 72-72;
SG_MUL_VAL_ 1557 GD_ID_DASH_LOCK_STATUS DataIndex 72-72;
SG_MUL_VAL_ 1557 GD_ID_MFA_FunctionLighting DataIndex 1696-1696;
SG_MUL_VAL_ 1557 GD_ID_MFA_NightDesign DataIndex 1697-1697;
SG_MUL_VAL_ 1557 GD_ID_LCP_LUMINANCE_FUNC_RW DataIndex 8864-8864;
SG_MUL_VAL_ 1557 GD_ID_LCP_LUMINANCE_BACK_RW DataIndex 8865-8865;
SG_MUL_VAL_ 1557 GD_ID_LCP_DELAY_W_Status DataIndex 8928-8928;
SG_MUL_VAL_ 1557 GD_ID_LCP_DELAY_W DataIndex 8928-8928;
