VERSION "HIPBNYYYYYYYYYYYYYYYYYYYYYYYYYYYNNNNNNNNNN/4/%%%/4/'%**4NNN///"

NS_ :

BS_:

BU_: ecuDASH ecuCHS ecuNT01 ecuMFA ecuDIAGNOSE ecuVD03 ecuZE ecuLCP ecu ecuACM

BO_ 1557 msgCHS: 8 ecuCHS
 SG_ ServiceType M : 23|9@1+ (1,0) [0|0] "" Vector__XXX
 SG_ SendInfoTcrr m415 : 32|8@1+ (1,0) [0|0] "" Vector__XXX
 SG_ RecieverNodeNumber : 0|4@1+ (1,0) [0|0] "" Vector__XXX
 SG_ RecieverBusNumber : 4|4@1+ (1,0) [0|0] "" Vector__XXX
 SG_ PlausibilityCheck m359 : 35|1@1+ (1,0) [0|0] "" Vector__XXX
 SG_ LowerHysteresis m405 : 48|8@1+ (1,0) [0|0] "" Vector__XXX
 SG_ DataIndex m359M : 8|15@1+ (1,0) [0|0] "" Vector__XXX
 SG_ ErrorId m359 : 32|3@1+ (1,0) [0|0] "" Vector__XXX
 SG_ CanError m359 : 36|1@1+ (1,0) [0|0] "" Vector__XXX
 SG_ CalErrorState m359 : 37|1@1+ (1,0) [0|0] "" Vector__XXX
 SG_ BlockSize m399 : 32|16@1+ (1,0) [0|0] "bytes" Vector__XXX
 SG_ RequestType m399 : 55|1@1+ (1,0) [0|0] "" Vector__XXX
 SG_ DataByte1 m430 : 32|8@1+ (1,0) [0|0] "" Vector__XXX
 SG_ DataByte2 m430 : 40|8@1+ (1,0) [0|0] "" Vector__XXX
 SG_ DataByte3 m430 : 48|8@1+ (1,0) [0|0] "" Vector__XXX
 SG_ DataByte4 m430 : 56|8@1+ (1,0) [0|0] "" Vector__XXX
 SG_ CRC_ChecksumOrBlockSizeError m398 : 32|16@1+ (1,0) [0|0] "" Vector__XXX
 SG_ ControlType m398 : 48|8@1+ (1,0) [0|0] "" Vector__XXX
 SG_ ControlOrErrorCode m398 : 56|8@1+ (1,0) [0|0] "" Vector__XXX
 SG_ GD_ID_DRIVE_AIR_PRESSURE m2049 : 40|16@1+ (1,0) [0|150] "psi" Vector__XXX
 SG_ GD_ID_DRIVE_HYDRAULICS_ENABLE_Status m2050 : 39|1@1+ (1,0) [0|0] "1/0" Vector__XXX
 SG_ GD_ID_DRIVE_HYDRAULICS_ENABLE m2050 : 40|16@1+ (1,0) [0|0] "" Vector__XXX
 SG_ GD_ID_DRIVE_REQUEST_HYD_ENABLE_OFF_Status m2051 : 39|1@1+ (1,0) [0|0] "1/0" Vector__XXX
 SG_ GD_ID_DRIVE_REQUEST_HYD_ENABLE_OFF m2051 : 40|16@1+ (1,0) [0|0] "" Vector__XXX
 SG_ GD_ID_DRIVE_BRAKE_PEDAL_POSITION_A m2052 : 40|16@1+ (1,0) [0|100] "mV" Vector__XXX
 SG_ GD_ID_DRIVE_BRAKE_PEDAL_POSITION_B m2053 : 40|16@1+ (1,0) [0|100] "mV" Vector__XXX
 SG_ GD_ID_DRIVE_BRAKE_PEDAL_POSITION m2054 : 40|16@1+ (0.1,0) [0|100] "%" Vector__XXX
 SG_ GD_ID_DRIVE_HYD_MOT_RPM_FR m2055 : 40|16@1- (1,0) [-10000|10000] "rpm" Vector__XXX
 SG_ GD_ID_DRIVE_HYD_MOT_RPM_RR m2056 : 40|16@1- (1,0) [-10000|10000] "rpm" Vector__XXX
 SG_ GD_ID_DRIVE_HYD_MOT_RPM_RL m2057 : 40|16@1- (1,0) [-10000|10000] "rpm" Vector__XXX
 SG_ GD_ID_DRIVE_HYD_MOT_RPM_FL m2058 : 40|16@1- (1,0) [-10000|10000] "rpm" Vector__XXX
 SG_ GD_ID_DRIVE_FORWARD_SS_DEFAULT_SPEED m2061 : 40|16@1+ (0.0036,0) [0|20] "km/h" Vector__XXX
 SG_ GD_ID_DRIVE_REVERSE_SS_DEFAULT_SPEED m2062 : 40|16@1+ (0.0036,0) [0|20] "km/h" Vector__XXX
 SG_ GD_ID_DRIVE_WHEEL_BASED_MACHINE_SPEED m2063 : 40|16@1- (0.0036,0) [-50|100] "km/h" Vector__XXX
 SG_ GD_ID_DRIVE_DANFOSS_IN_SV_STATE_COMMANDED_Status m2064 : 39|1@1+ (1,0) [0|0] "1/0" Vector__XXX
 SG_ GD_ID_DRIVE_DANFOSS_IN_SV_STATE_COMMANDED m2064 : 40|16@1+ (1,0) [0|0] "" Vector__XXX
 SG_ GD_ID_DRIVE_DANFOSS_OUT_SV_STATE_ACTUAL_Status m2065 : 39|1@1+ (1,0) [0|0] "1/0" Vector__XXX
 SG_ GD_ID_DRIVE_DANFOSS_OUT_SV_STATE_ACTUAL m2065 : 40|16@1+ (1,0) [0|0] "" Vector__XXX
 SG_ GD_ID_DRIVE_DANFOSS_IN_SV_SPEED m2066 : 40|16@1+ (0.0036,0) [0|100] "km/h" Vector__XXX
 SG_ GD_ID_DRIVE_DANFOSS_OUT_DRIVE_MODE_ACTUAL_Status m2067 : 39|1@1+ (1,0) [0|0] "1/0" Vector__XXX
 SG_ GD_ID_DRIVE_DANFOSS_OUT_DRIVE_MODE_ACTUAL m2067 : 40|16@1+ (1,0) [0|0] "" Vector__XXX
 SG_ GD_ID_DRIVE_DANFOSS_IN_DRIVE_MODE_COMMANDED_Status m2068 : 39|1@1+ (1,0) [0|0] "1/0" Vector__XXX
 SG_ GD_ID_DRIVE_DANFOSS_IN_DRIVE_MODE_COMMANDED m2068 : 40|16@1+ (1,0) [0|0] "" Vector__XXX
 SG_ GD_ID_DRIVE_SV_1_Status m2069 : 39|1@1+ (1,0) [0|0] "1/0" Vector__XXX
 SG_ GD_ID_DRIVE_SV_1 m2069 : 40|16@1+ (0.0036,0) [0|100] "km/h" Vector__XXX
 SG_ GD_ID_DRIVE_SV_2_Status m2070 : 39|1@1+ (1,0) [0|0] "1/0" Vector__XXX
 SG_ GD_ID_DRIVE_SV_2 m2070 : 40|16@1+ (0.0036,0) [0|100] "km/h" Vector__XXX
 SG_ GD_ID_DRIVE_SV_STATE m2071 : 40|16@1+ (1,0) [0|4] "" Vector__XXX
 SG_ GD_ID_DRIVE_MAX_ENGINE_DROP m2072 : 40|16@1+ (0.01,0) [1|20] "%" Vector__XXX
 SG_ GD_ID_DRIVE_CALIB_STATE_BRAKE_PEDAL_Status m2076 : 39|1@1+ (1,0) [0|0] "1/0" Vector__XXX
 SG_ GD_ID_DRIVE_CALIB_STATE_BRAKE_PEDAL m2076 : 40|16@1+ (1,0) [0|0] "TRUE/FALSE" Vector__XXX
 SG_ GD_ID_DRIVE_MAX_SV_SPEED m2077 : 40|16@1+ (0.01,0) [0|100] "km/h" Vector__XXX
 SG_ GD_ID_DRIVE_PRESSURE_A m2078 : 40|16@1+ (0.01,0) [0|700] "bar" Vector__XXX
 SG_ GD_ID_DRIVE_PRESSURE_B m2079 : 40|16@1+ (0.01,0) [0|700] "bar" Vector__XXX
 SG_ GD_ID_DRIVE_CHARGE_PRESSURE m2080 : 40|16@1+ (0.01,0) [0|700] "bar" Vector__XXX
 SG_ GD_ID_DRIVE_DASH_DISPLAYED_ENGINE_SPEED m2084 : 40|16@1+ (1,0) [0|10000] "rpm" Vector__XXX
 SG_ GD_ID_DRIVE_FRONT_STEER_ANGLE m2085 : 40|16@1- (0.01,0) [-50|50] "deg" Vector__XXX
 SG_ GD_ID_DRIVE_DANFOSS_OUT_PARKBRK_REQUEST_Status m2086 : 39|1@1+ (1,0) [0|0] "1/0" Vector__XXX
 SG_ GD_ID_DRIVE_DANFOSS_OUT_PARKBRK_REQUEST m2086 : 40|16@1+ (1,0) [0|0] "" Vector__XXX
 SG_ GD_ID_DRIVE_DANFOSS_OUT_CCO_VALVE_REQUEST_Status m2087 : 39|1@1+ (1,0) [0|0] "1/0" Vector__XXX
 SG_ GD_ID_DRIVE_DANFOSS_OUT_CCO_VALVE_REQUEST m2087 : 40|16@1+ (1,0) [0|0] "" Vector__XXX
 SG_ GD_ID_DRIVE_CCO_VALVE_COMMAND_Status m2088 : 39|1@1+ (1,0) [0|0] "1/0" Vector__XXX
 SG_ GD_ID_DRIVE_CCO_VALVE_COMMAND m2088 : 40|16@1+ (1,0) [0|0] "" Vector__XXX
 SG_ GD_ID_DRIVE_TIRE_RCI m2092 : 40|16@1+ (1,0) [34|50] "RCI" Vector__XXX
 SG_ GD_ID_DRIVE_DASH_DISPLAYED_MACHINE_SPEED2 m2094 : 40|16@1+ (0.01,0) [0|100] "km/h" Vector__XXX
 SG_ GD_ID_DRIVE_CARGO_OVER_WEIGHT_Status m2095 : 39|1@1+ (1,0) [0|0] "1/0" Vector__XXX
 SG_ GD_ID_DRIVE_CARGO_OVER_WEIGHT m2095 : 40|16@1+ (1,0) [0|150] "psi" Vector__XXX
 SG_ GD_ID_DRIVE_ROGATOR_MACHINE_CONFIGURATION m2096 : 40|16@1+ (1,0) [0|3] "" Vector__XXX
 SG_ GD_ID_DRIVE_TIRE_ROLLING_CIRCUMFERENCE m2097 : 40|16@1+ (1,0) [0|10000] "mm" Vector__XXX
 SG_ GD_ID_DRIVE_BRAKE_LIGHT_COMMAND_Status m2098 : 39|1@1+ (1,0) [0|0] "1/0" Vector__XXX
 SG_ GD_ID_DRIVE_BRAKE_LIGHT_COMMAND m2098 : 40|16@1+ (1,0) [0|0] "" Vector__XXX
 SG_ GD_ID_DRIVE_TARGET_MACHINE_SPEED m2099 : 40|16@1- (0.0036,0) [-50|100] "km/h" Vector__XXX
 SG_ GD_ID_DRIVE_MAX_MACHINE_SPEED m2100 : 40|16@1+ (0.0036,0) [0|100] "km/h" Vector__XXX
 SG_ GD_ID_DRIVE_EXPECTED_MACHINE_SPEED m2101 : 40|16@1- (0.0036,0) [-50|100] "km/h" Vector__XXX
 SG_ GD_ID_DRIVE_CALIB_BRAKE_PEDAL_START_Status m2111 : 39|1@1+ (1,0) [0|0] "1/0" Vector__XXX
 SG_ GD_ID_DRIVE_CALIB_BRAKE_PEDAL_START m2111 : 40|16@1+ (1,0) [0|0] "TRUE/n.a." Vector__XXX
 SG_ GD_ID_DRIVE_CALIB_BRAKE_PEDAL_ACTIVE_Status m2112 : 39|1@1+ (1,0) [0|0] "1/0" Vector__XXX
 SG_ GD_ID_DRIVE_CALIB_BRAKE_PEDAL_ACTIVE m2112 : 40|16@1+ (1,0) [0|0] "ON/OFF" Vector__XXX
 SG_ GD_ID_DRIVE_CALIB_BRAKE_PEDAL_DOWN_Status m2113 : 39|1@1+ (1,0) [0|0] "1/0" Vector__XXX
 SG_ GD_ID_DRIVE_CALIB_BRAKE_PEDAL_DOWN m2113 : 40|16@1+ (1,0) [0|0] "TRUE/n.a." Vector__XXX
 SG_ GD_ID_DRIVE_CALIB_BRAKE_PEDAL_DOWN_RET_Status m2114 : 39|1@1+ (1,0) [0|0] "1/0" Vector__XXX
 SG_ GD_ID_DRIVE_CALIB_BRAKE_PEDAL_DOWN_RET m2114 : 40|16@1+ (1,0) [0|0] "TRUE/n.a." Vector__XXX
 SG_ GD_ID_DRIVE_CALIB_BRAKE_PEDAL_UP_Status m2115 : 39|1@1+ (1,0) [0|0] "1/0" Vector__XXX
 SG_ GD_ID_DRIVE_CALIB_BRAKE_PEDAL_UP m2115 : 40|16@1+ (1,0) [0|0] "TRUE/n.a." Vector__XXX
 SG_ GD_ID_DRIVE_CALIB_BRAKE_PEDAL_UP_RET_Status m2116 : 39|1@1+ (1,0) [0|0] "1/0" Vector__XXX
 SG_ GD_ID_DRIVE_CALIB_BRAKE_PEDAL_UP_RET m2116 : 40|16@1+ (1,0) [0|0] "TRUE/n.a." Vector__XXX
 SG_ GD_ID_DRIVE_CALIB_BRAKE_PEDAL_ACCEPT_Status m2117 : 39|1@1+ (1,0) [0|0] "1/0" Vector__XXX
 SG_ GD_ID_DRIVE_CALIB_BRAKE_PEDAL_ACCEPT m2117 : 40|16@1+ (1,0) [0|0] "TRUE/n.a." Vector__XXX
 SG_ GD_ID_DRIVE_CALIB_BRAKE_PEDAL_DECLINE_Status m2118 : 39|1@1+ (1,0) [0|0] "1/0" Vector__XXX
 SG_ GD_ID_DRIVE_CALIB_BRAKE_PEDAL_DECLINE m2118 : 40|16@1+ (1,0) [0|0] "TRUE/n.a." Vector__XXX
 SG_ GD_ID_DRIVE_CALIB_BRAKE_PEDAL_PROCESSED_Status m2119 : 39|1@1+ (1,0) [0|0] "1/0" Vector__XXX
 SG_ GD_ID_DRIVE_CALIB_BRAKE_PEDAL_PROCESSED m2119 : 40|16@1+ (1,0) [0|0] "TRUE/n.a." Vector__XXX
 SG_ GD_ID_DRIVE_CALIB_BRAKE_PEDAL_ERROR_Status m2120 : 39|1@1+ (1,0) [0|0] "1/0" Vector__XXX
 SG_ GD_ID_DRIVE_CALIB_BRAKE_PEDAL_ERROR m2120 : 40|16@1+ (1,0) [0|0] "TRUE/n.a." Vector__XXX
 SG_ GD_ID_DRIVE_FIELD_STREET_STATE m2121 : 40|16@1+ (1,0) [0|2] "" Vector__XXX
 SG_ GD_ID_DRIVE_DTM_ENALBED_IN_MANUAL_Status m2122 : 39|1@1+ (1,0) [0|0] "1/0" Vector__XXX
 SG_ GD_ID_DRIVE_DTM_ENALBED_IN_MANUAL m2122 : 40|16@1+ (1,0) [0|0] "" Vector__XXX
 SG_ GD_ID_DRIVE_STATE m2123 : 40|16@1+ (1,0) [0|2] "" Vector__XXX
 SG_ GD_ID_DRIVE_DTM_MIN_RPM m2124 : 40|16@1+ (0.125,0) [1000|1950] "rpm" Vector__XXX
 SG_ GD_ID_DRIVE_DTM_MAX_RPM m2125 : 40|16@1+ (0.125,0) [0|10000] "rpm" Vector__XXX
 SG_ GD_ID_DRIVE_DRIVEPUMP_A_COMCURRENT m2126 : 40|16@1+ (1,0) [0|3000] "mA" Vector__XXX
 SG_ GD_ID_DRIVE_DRIVEPUMP_B_COMCURRENT m2127 : 40|16@1+ (1,0) [0|3000] "mA" Vector__XXX
 SG_ GD_ID_DRIVE_HYD_MOT_FR_COMCURRENT m2128 : 40|16@1+ (1,0) [0|3000] "mA" Vector__XXX
 SG_ GD_ID_DRIVE_HYD_MOT_RR_COMCURRENT m2129 : 40|16@1+ (1,0) [0|3000] "mA" Vector__XXX
 SG_ GD_ID_DRIVE_HYD_MOT_RL_COMCURRENT m2130 : 40|16@1+ (1,0) [0|3000] "mA" Vector__XXX
 SG_ GD_ID_DRIVE_HYD_MOT_FL_COMCURRENT m2131 : 40|16@1+ (1,0) [0|3000] "mA" Vector__XXX
 SG_ GD_ID_DRIVE_HYDRAULIC_OIl_TEMP m2133 : 40|16@1+ (1,0) [25|150] "C" Vector__XXX
 SG_ GD_ID_DRIVE_FUEL_LEVEL m2135 : 40|16@1+ (0.1,0) [0|100] "%" Vector__XXX
 SG_ GD_ID_DRIVE_PARKBRAKE_COMMAND_Status m2137 : 39|1@1+ (1,0) [0|0] "1/0" Vector__XXX
 SG_ GD_ID_DRIVE_PARKBRAKE_COMMAND m2137 : 40|16@1+ (1,0) [0|0] "" Vector__XXX
 SG_ GD_ID_DRIVE_OPERATION_MODE m2138 : 40|16@1+ (1,0) [0|64] "" Vector__XXX
 SG_ GD_ID_DRIVE_DRIVEPUMP_A_FEEDBACK_CURRENT m2139 : 40|16@1+ (1,0) [0|3000] "mA" Vector__XXX
 SG_ GD_ID_DRIVE_DRIVEPUMP_B_FEEDBACK_CURRENT m2140 : 40|16@1+ (1,0) [0|3000] "mA" Vector__XXX
 SG_ GD_ID_DRIVE_HYD_MOT_FR_FEEDBACK_CURRENT m2141 : 40|16@1+ (1,0) [0|3000] "mA" Vector__XXX
 SG_ GD_ID_DRIVE_HYD_MOT_RR_FEEDBACK_CURRENT m2142 : 40|16@1+ (1,0) [0|3000] "mA" Vector__XXX
 SG_ GD_ID_DRIVE_HYD_MOT_RL_FEEDBACK_CURRENT m2143 : 40|16@1+ (1,0) [0|3000] "mA" Vector__XXX
 SG_ GD_ID_DRIVE_HYD_MOT_FL_FEEDBACK_CURRENT m2144 : 40|16@1+ (1,0) [0|3000] "mA" Vector__XXX
 SG_ GD_ID_DRIVE_RADAR_SPEED m2150 : 40|16@1+ (0.0036,0) [0|100] "kph" Vector__XXX
 SG_ GD_ID_DRIVE_DASH_DISPLAYED_PARK_BRAKE_LED_Status m2175 : 39|1@1+ (1,0) [0|0] "1/0" Vector__XXX
 SG_ GD_ID_DRIVE_DASH_DISPLAYED_PARK_BRAKE_LED m2175 : 40|16@1+ (1,0) [0|0] "" Vector__XXX
 SG_ GD_ID_DRIVE_CURRENT_GEAR m2192 : 40|16@1- (1,-125) [-125|255] "gear" Vector__XXX
 SG_ GD_ID_DRIVE_SELECTED_GEAR m2193 : 40|16@1- (1,-125) [-125|255] "gear" Vector__XXX
 SG_ GD_ID_DRIVE_DRIVE_PEDAL_POSITION m2194 : 40|16@1+ (0.01,0) [0|100] "%" Vector__XXX
 SG_ GD_ID_DRIVE_DASH_DISPLAYED_MACHINE_SPEED1 m2207 : 40|16@1+ (0.01,0) [0|100] "km/h" Vector__XXX
 SG_ GD_ID_DRIVE_DTM_COMMANDED_RPM m2258 : 40|16@1+ (0.125,0) [1000|1950] "rpm" Vector__XXX
 SG_ GD_ID_DRIVE_DISPLAY_UNITS_Status m2300 : 39|1@1+ (1,0) [0|0] "1/0" Vector__XXX
 SG_ GD_ID_DRIVE_DISPLAY_UNITS m2300 : 40|16@1+ (1,0) [0|1] "enum" Vector__XXX
 SG_ GD_ID_DRIVE_RESET_DEFAULT_PROFILES_Status m2348 : 39|1@1+ (1,0) [0|0] "1/0" Vector__XXX
 SG_ GD_ID_DRIVE_RESET_DEFAULT_PROFILES m2348 : 40|16@1+ (1,0) [0|0] "" Vector__XXX
 SG_ GD_ID_DRIVE_LEVER_ACCEL_PROFILE m2349 : 40|16@1+ (1,0) [1|4] "Enum" Vector__XXX
 SG_ GD_ID_DRIVE_LEVER_DECEL_PROFILE m2350 : 40|16@1+ (1,0) [1|4] "Enum" Vector__XXX
 SG_ GD_ID_DRIVE_PEDAL_ACCEL_PROFILE m2351 : 40|16@1+ (1,0) [1|4] "Enum" Vector__XXX
 SG_ GD_ID_DRIVE_PEDAL_DECEL_PROFILE m2352 : 40|16@1+ (1,0) [1|4] "Enum" Vector__XXX
 SG_ GD_ID_DRIVE_SV_ACCELDECEL_PROFILE m2353 : 40|16@1+ (1,0) [1|4] "Enum" Vector__XXX
 SG_ GD_ID_DRIVE_SHUTTLE_ACCELDECEL_PROFILE m2355 : 40|16@1+ (1,0) [1|4] "Enum" Vector__XXX
 SG_ GD_ID_DRIVE_DANFOSS_IN_OUTFAULTS m2373 : 40|16@1+ (1,0) [0|2048] "" Vector__XXX
 SG_ GD_ID_ASC_RAMP_RL_DECTM m2374 : 40|16@1+ (1,0) [0|65535] "" Vector__XXX
 SG_ GD_ID_ASC_PID_FL_KIUP_ASC m2375 : 40|16@1+ (1,0) [0|65535] "" Vector__XXX
 SG_ GD_ID_ASC_PID_FL_KIDOWN_ASC m2376 : 40|16@1+ (1,0) [0|65535] "" Vector__XXX
 SG_ GD_ID_ASC_PID_FL_KPUP_ASC m2377 : 40|16@1+ (1,0) [0|65535] "" Vector__XXX
 SG_ GD_ID_ASC_PID_FL_KPDOWN_ASC m2378 : 40|16@1+ (1,0) [0|65535] "" Vector__XXX
 SG_ GD_ID_ASC_PID_FL_KDUP_ASC m2379 : 40|16@1+ (1,0) [0|65535] "" Vector__XXX
 SG_ GD_ID_ASC_PID_FL_IRED m2380 : 40|16@1- (1,0) [-32768|32767] "" Vector__XXX
 SG_ GD_ID_ASC_INCHING_INCHMODE m2381 : 40|16@1+ (1,0) [0|65535] "" Vector__XXX
 SG_ GD_ID_ASC_INCHING_TVOLINCH m2382 : 40|16@1+ (1,0) [0|1] "" Vector__XXX
 SG_ GD_ID_ASC_REFSPDDISABLE_ABS_MINREFSPD_MMSEC m2383 : 40|16@1+ (1,0) [0|65535] "" Vector__XXX
 SG_ GD_ID_ASC_REFSPDDISABLE_ASC_MINREFSPD_MMSEC m2384 : 40|16@1+ (1,0) [0|65535] "" Vector__XXX
 SG_ GD_ID_ASC_REFSPDDISABLE_ABS_DECRAMP60K m2385 : 40|16@1+ (1,0) [0|65535] "" Vector__XXX
 SG_ GD_ID_ASC_FFPROFILES_REVBRAKINGFRONT_Y4_PTC2 m2386 : 40|16@1+ (1,0) [0|65535] "" Vector__XXX
 SG_ GD_ID_ASC_FFPROFILES_REVBRAKINGFRONT_Y5_PTC2 m2387 : 40|16@1+ (1,0) [0|65535] "" Vector__XXX
 SG_ GD_ID_ASC_FFPROFILES_REVBRAKINGFRONT_Y6_PTC2 m2388 : 40|16@1+ (1,0) [0|65535] "" Vector__XXX
 SG_ GD_ID_ASC_FFPROFILES_FWDBRAKINGREAR_Y5_PTC2_LD m2389 : 40|16@1+ (1,0) [0|65535] "" Vector__XXX
 SG_ GD_ID_ASC_FFPROFILES_FWDBRAKINGREAR_Y5_PTC2 m2390 : 40|16@1+ (1,0) [0|65535] "" Vector__XXX
 SG_ GD_ID_ASC_FFPROFILES_FWDBRAKINGREAR_Y6_PTC2_LD m2391 : 40|16@1+ (1,0) [0|65535] "" Vector__XXX
 SG_ GD_ID_ASC_FFPROFILES_FWDBRAKINGREAR_Y6_PTC2 m2392 : 40|16@1+ (1,0) [0|65535] "" Vector__XXX
 SG_ GD_ID_ASC_CORE_ASC_MINTOLERANCE_PCT2 m2393 : 40|16@1+ (1,0) [0|65535] "" Vector__XXX
 SG_ GD_ID_ASC_PID_RL_KDUP_ASC m2394 : 40|16@1+ (1,0) [0|65535] "" Vector__XXX
 SG_ GD_ID_ASC_PID_RL_KPUP_ASC m2395 : 40|16@1+ (1,0) [0|65535] "" Vector__XXX
 SG_ GD_ID_ASC_PID_RL_KPDN_ASC m2396 : 40|16@1+ (1,0) [0|65535] "" Vector__XXX
 SG_ GD_ID_ASC_PID_RL_KIUP_ASC m2397 : 40|16@1+ (1,0) [0|65535] "" Vector__XXX
 SG_ GD_ID_ASC_PID_RL_KIDN_ASC m2398 : 40|16@1+ (1,0) [0|65535] "" Vector__XXX
 SG_ GD_ID_ASC_PID_RL_IRED m2399 : 40|16@1+ (1,0) [0|65535] "" Vector__XXX
 SG_ GD_ID_BRK_Y5 m2400 : 40|16@1- (1,0) [-32768|32767] "" Vector__XXX
 SG_ GD_ID_ENGADJLD_FILTERTM_MS m2401 : 40|16@1+ (1,0) [0|65535] "" Vector__XXX
 SG_ GD_ID_ENGADJLD_Y4 m2402 : 40|16@1- (1,0) [-32768|32767] "" Vector__XXX
 SG_ GD_ID_MV_I_INT_I_GAIN m2403 : 40|16@1- (1,0) [-32768|32767] "" Vector__XXX
 SG_ GD_ID_MISC_PR_PERACT_Y3 m2404 : 40|16@1+ (1,0) [0|65535] "" Vector__XXX
 SG_ GD_ID_MISC_PR_PERACT_Y4 m2405 : 40|16@1+ (1,0) [0|65535] "" Vector__XXX
 SG_ GD_ID_MISC_PR_PERACT_Y5 m2406 : 40|16@1+ (1,0) [0|65535] "" Vector__XXX
 SG_ GD_ID_ASC_Core_ABS_Ang_Y1_ptc2 m2407 : 40|16@1+ (1,0) [0|65535] "" Vector__XXX
 SG_ GD_ID_ASC_Core_ABS_Ang_Y2_ptc2 m2408 : 40|16@1+ (1,0) [0|65535] "" Vector__XXX
 SG_ GD_ID_ASC_Core_ABS_Ang_Y3_ptc2 m2409 : 40|16@1+ (1,0) [0|65535] "" Vector__XXX
 SG_ GD_ID_ASC_Core_ABS_Ang_Y4_ptc2 m2410 : 40|16@1+ (1,0) [0|65535] "" Vector__XXX
 SG_ GD_ID_ASC_Core_ABS_Ang_Y5_ptc2 m2411 : 40|16@1+ (1,0) [0|65535] "" Vector__XXX
 SG_ GD_ID_ASC_Core_ABS_MinTolerance_pct2 m2412 : 40|16@1+ (1,0) [0|65535] "" Vector__XXX
 SG_ GD_ID_ASC_Core_ASC_Ang_Y1_ptc2 m2413 : 40|16@1+ (1,0) [0|65535] "" Vector__XXX
 SG_ GD_ID_ASC_Core_ASC_Ang_Y2_ptc2 m2414 : 40|16@1+ (1,0) [0|65535] "" Vector__XXX
 SG_ GD_ID_ASC_Core_ASC_Ang_Y3_ptc2 m2415 : 40|16@1+ (1,0) [0|65535] "" Vector__XXX
 SG_ GD_ID_ASC_Core_ASC_Ang_Y4_ptc2 m2416 : 40|16@1+ (1,0) [0|65535] "" Vector__XXX
 SG_ GD_ID_ASC_Core_ASC_Ang_Y5_ptc2 m2417 : 40|16@1+ (1,0) [0|65535] "" Vector__XXX
 SG_ GD_ID_DRIVE_PEDAL_CAL_COMMAND_Status m2458 : 39|1@1+ (1,0) [0|0] "1/0" Vector__XXX
 SG_ GD_ID_DRIVE_PEDAL_CAL_COMMAND m2458 : 40|16@1+ (1,0) [0|65535] "" Vector__XXX
 SG_ GD_ID_DRIVE_PEDAL_CAL_STATE_Status m2459 : 39|1@1+ (1,0) [0|0] "1/0" Vector__XXX
 SG_ GD_ID_DRIVE_PEDAL_CAL_STATE m2459 : 40|16@1+ (1,0) [0|65535] "" Vector__XXX
 SG_ GD_ID_DRIVE_BRAKE_PEDAL_CAL_COMMAND_Status m2460 : 39|1@1+ (1,0) [0|0] "1/0" Vector__XXX
 SG_ GD_ID_DRIVE_BRAKE_PEDAL_CAL_COMMAND m2460 : 40|16@1+ (1,0) [0|65535] "" Vector__XXX
 SG_ GD_ID_DRIVE_BRAKE_PEDAL_CAL_STATE_Status m2461 : 39|1@1+ (1,0) [0|0] "1/0" Vector__XXX
 SG_ GD_ID_DRIVE_BRAKE_PEDAL_CAL_STATE m2461 : 40|16@1+ (1,0) [0|65535] "" Vector__XXX
 SG_ GD_ID_DRIVE_WAS_CAL_COMMAND_Status m2462 : 39|1@1+ (1,0) [0|0] "1/0" Vector__XXX
 SG_ GD_ID_DRIVE_WAS_CAL_COMMAND m2462 : 40|16@1+ (1,0) [0|65535] "" Vector__XXX
 SG_ GD_ID_DRIVE_WAS_CAL_STATE_Status m2463 : 39|1@1+ (1,0) [0|0] "1/0" Vector__XXX
 SG_ GD_ID_DRIVE_WAS_CAL_STATE m2463 : 40|16@1+ (1,0) [0|65535] "" Vector__XXX
 SG_ GD_ID_DRIVE_HYDRO_CAL_COMMAND_Status m2464 : 39|1@1+ (1,0) [0|0] "1/0" Vector__XXX
 SG_ GD_ID_DRIVE_HYDRO_CAL_COMMAND m2464 : 40|16@1+ (1,0) [0|65535] "" Vector__XXX
 SG_ GD_ID_DRIVE_HYDRO_CAL_STATE_Status m2465 : 39|1@1+ (1,0) [0|0] "1/0" Vector__XXX
 SG_ GD_ID_DRIVE_HYDRO_CAL_STATE m2465 : 40|16@1+ (1,0) [0|65535] "" Vector__XXX
 SG_ GD_ID_DRIVE_WHEEL_SPEED_CALIBRATION_COMMAND_Status m2468 : 39|1@1+ (1,0) [0|0] "1/0" Vector__XXX
 SG_ GD_ID_DRIVE_WHEEL_SPEED_CALIBRATION_COMMAND m2468 : 40|16@1+ (1,0) [0|65535] "" Vector__XXX
 SG_ GD_ID_DRIVE_WHEEL_SPEED_CALIBRATION_STATE_Status m2469 : 39|1@1+ (1,0) [0|0] "1/0" Vector__XXX
 SG_ GD_ID_DRIVE_WHEEL_SPEED_CALIBRATION_STATE m2469 : 40|16@1+ (1,0) [0|65535] "" Vector__XXX
 SG_ GD_ID_DRIVE_WHEEL_SPEED_CALIBRATION_USER_DISTANCE_Status m2470 : 39|1@1+ (1,0) [0|0] "1/0" Vector__XXX
 SG_ GD_ID_DRIVE_WHEEL_SPEED_CALIBRATION_USER_DISTANCE m2470 : 40|16@1+ (0.1,0) [0|65535] "m" Vector__XXX
 SG_ GD_ID_DRIVE_RADAR_CALIBRATION_COMMAND_Status m2471 : 39|1@1+ (1,0) [0|0] "1/0" Vector__XXX
 SG_ GD_ID_DRIVE_RADAR_CALIBRATION_COMMAND m2471 : 40|16@1+ (1,0) [0|65535] "" Vector__XXX
 SG_ GD_ID_DRIVE_RADAR_CALIBRATION_STATE_Status m2472 : 39|1@1+ (1,0) [0|0] "1/0" Vector__XXX
 SG_ GD_ID_DRIVE_RADAR_CALIBRATION_STATE m2472 : 40|16@1+ (1,0) [0|65535] "" Vector__XXX
 SG_ GD_ID_DRIVE_RADAR_CALIBRATION_USER_DISTANCE_Status m2473 : 39|1@1+ (1,0) [0|0] "1/0" Vector__XXX
 SG_ GD_ID_DRIVE_RADAR_CALIBRATION_USER_DISTANCE m2473 : 40|16@1+ (0.1,0) [0|65535] "m" Vector__XXX
 SG_ GD_ID_DRIVE_COMBO_CALIBRATION_COMMAND_Status m2474 : 39|1@1+ (1,0) [0|0] "1/0" Vector__XXX
 SG_ GD_ID_DRIVE_COMBO_CALIBRATION_COMMAND m2474 : 40|16@1+ (1,0) [0|65535] "" Vector__XXX
 SG_ GD_ID_DRIVE_COMBO_CALIBRATION_STATE_Status m2475 : 39|1@1+ (1,0) [0|0] "1/0" Vector__XXX
 SG_ GD_ID_DRIVE_COMBO_CALIBRATION_STATE m2475 : 40|16@1+ (1,0) [0|65535] "" Vector__XXX
 SG_ GD_ID_DRIVE_COMBO_CALIBRATION_USER_DISTANCE_Status m2476 : 39|1@1+ (1,0) [0|0] "1/0" Vector__XXX
 SG_ GD_ID_DRIVE_COMBO_CALIBRATION_USER_DISTANCE m2476 : 40|16@1+ (0.1,0) [0|65535] "m" Vector__XXX
 SG_ GD_ID_DRIVE_DRIVEPUMP_A_START_CAL_CURRENT_STORED m2498 : 40|16@1+ (1,0) [0|3000] "mA" Vector__XXX
 SG_ GD_ID_DRIVE_DRIVEPUMP_A_END_CAL_CURRENT_STORED m2499 : 40|16@1+ (1,0) [0|3000] "mA" Vector__XXX
 SG_ GD_ID_DRIVE_DRIVEPUMP_B_START_CAL_CURRENT_STORED m2500 : 40|16@1+ (1,0) [0|3000] "mA" Vector__XXX
 SG_ GD_ID_DRIVE_DRIVEPUMP_B_END_CAL_CURRENT_STORED m2501 : 40|16@1+ (1,0) [0|3000] "mA" Vector__XXX
 SG_ GD_ID_DRIVE_MOTOR_FL_START_CAL_CURRENT_STORED m2502 : 40|16@1+ (1,0) [0|3000] "mA" Vector__XXX
 SG_ GD_ID_DRIVE_MOTOR_FL_END_CAL_CURRENT_STORED m2503 : 40|16@1+ (1,0) [0|3000] "mA" Vector__XXX
 SG_ GD_ID_DRIVE_MOTOR_FR_START_CAL_CURRENT_STORED m2504 : 40|16@1+ (1,0) [0|3000] "mA" Vector__XXX
 SG_ GD_ID_DRIVE_MOTOR_FR_END_CAL_CURRENT_STORED m2505 : 40|16@1+ (1,0) [0|3000] "mA" Vector__XXX
 SG_ GD_ID_DRIVE_MOTOR_RL_START_CAL_CURRENT_STORED m2506 : 40|16@1+ (1,0) [0|3000] "mA" Vector__XXX
 SG_ GD_ID_DRIVE_MOTOR_RL_END_CAL_CURRENT_STORED m2507 : 40|16@1+ (1,0) [0|3000] "mA" Vector__XXX
 SG_ GD_ID_DRIVE_MOTOR_RR_START_CAL_CURRENT_STORED m2508 : 40|16@1+ (1,0) [0|3000] "mA" Vector__XXX
 SG_ GD_ID_DRIVE_MOTOR_RR_END_CAL_CURRENT_STORED m2509 : 40|16@1+ (1,0) [0|3000] "mA" Vector__XXX
 SG_ GD_ID_DRIVE_DRIVEPUMP_A_START_CAL_CURRENT_NEW m2510 : 40|16@1+ (1,0) [0|3000] "mA" Vector__XXX
 SG_ GD_ID_DRIVE_DRIVEPUMP_A_END_CAL_CURRENT_NEW m2511 : 40|16@1+ (1,0) [0|3000] "mA" Vector__XXX
 SG_ GD_ID_DRIVE_DRIVEPUMP_B_START_CAL_CURRENT_NEW m2512 : 40|16@1+ (1,0) [0|3000] "mA" Vector__XXX
 SG_ GD_ID_DRIVE_DRIVEPUMP_B_END_CAL_CURRENT_NEW m2513 : 40|16@1+ (1,0) [0|3000] "mA" Vector__XXX
 SG_ GD_ID_DRIVE_MOTOR_FL_START_CAL_CURRENT_NEW m2514 : 40|16@1+ (1,0) [0|3000] "mA" Vector__XXX
 SG_ GD_ID_DRIVE_MOTOR_FL_END_CAL_CURRENT_NEW m2515 : 40|16@1+ (1,0) [0|3000] "mA" Vector__XXX
 SG_ GD_ID_DRIVE_MOTOR_FR_START_CAL_CURRENT_NEW m2516 : 40|16@1+ (1,0) [0|3000] "mA" Vector__XXX
 SG_ GD_ID_DRIVE_MOTOR_FR_END_CAL_CURRENT_NEW m2517 : 40|16@1+ (1,0) [0|3000] "mA" Vector__XXX
 SG_ GD_ID_DRIVE_MOTOR_RL_START_CAL_CURRENT_NEW m2518 : 40|16@1+ (1,0) [0|3000] "mA" Vector__XXX
 SG_ GD_ID_DRIVE_MOTOR_RL_END_CAL_CURRENT_NEW m2519 : 40|16@1+ (1,0) [0|3000] "mA" Vector__XXX
 SG_ GD_ID_DRIVE_MOTOR_RR_START_CAL_CURRENT_NEW m2520 : 40|16@1+ (1,0) [0|3000] "mA" Vector__XXX
 SG_ GD_ID_DRIVE_MOTOR_RR_END_CAL_CURRENT_NEW m2521 : 40|16@1+ (1,0) [0|3000] "mA" Vector__XXX
 SG_ GD_ID_DRIVE_DANFOSS_CAL_REQUEST m2523 : 40|16@1+ (1,0) [0|31] "" Vector__XXX
 SG_ GD_ID_DRIVE_WHEEL_BASED_MACHINE_SPEED_KPH m2525 : 40|16@1- (0.1,0) [-50|50] "km/h" Vector__XXX
 SG_ GD_ID_DRIVE_NORMALIZED_WHEEL_SPEED_FL m2526 : 40|16@1- (0.1,0) [-50|50] "km/h" Vector__XXX
 SG_ GD_ID_DRIVE_NORMALIZED_WHEEL_SPEED_FR m2527 : 40|16@1- (0.1,0) [-50|50] "km/h" Vector__XXX
 SG_ GD_ID_DRIVE_NORMALIZED_WHEEL_SPEED_RL m2528 : 40|16@1- (0.1,0) [-50|50] "km/h" Vector__XXX
 SG_ GD_ID_DRIVE_NORMALIZED_WHEEL_SPEED_RR m2529 : 40|16@1- (0.1,0) [-50|50] "km/h" Vector__XXX
 SG_ GD_ID_DRIVE_AIRBAG_DEFLATE_Status m2530 : 39|1@1+ (1,0) [0|0] "1/0" Vector__XXX
 SG_ GD_ID_DRIVE_AIRBAG_DEFLATE m2530 : 40|16@1+ (1,0) [0|3000] "mA" Vector__XXX
 SG_ GD_ID_DRIVE_ERRORMANAGEMENT_Status m2542 : 39|1@1+ (1,0) [0|0] "1/0" Vector__XXX
 SG_ GD_ID_DRIVE_ERRORMANAGEMENT m2542 : 40|16@1+ (1,0) [0|255] "" Vector__XXX
 SG_ GD_ID_DRIVE_LIFEMESSAGE m2559 : 40|16@1+ (1,0) [0|65535] "ms" Vector__XXX

 SG_ GD_ID_SCT_ENABLE m12288 : 40|16@1+ (1,0) [0|65535] "" Vector__XXX
 SG_ GD_ID_SCT_MODUL_OUT_STATUS m12289 : 40|16@1+ (1,0) [0|65535] "" Vector__XXX
 SG_ GD_ID_SCT_MODUL_IN_STATUS m12290 : 40|16@1+ (1,0) [0|65535] "" Vector__XXX
 SG_ GD_ID_SCT_STATUSDISPLAY_TERMINAL m12298 : 40|16@1+ (1,0) [0|2] "" Vector__XXX
 SG_ GD_ID_SCT_TURNING_OFF_REASON m12303 : 40|16@1+ (1,0) [0|65535] "" Vector__XXX
 SG_ GD_ID_SCT_STATE m12304 : 40|16@1+ (1,0) [0|65535] "" Vector__XXX
 SG_ GD_ID_SCT_VOTED_ACTIVE_CLASS_1 m12305 : 40|16@1+ (1,0) [0|1] "" Vector__XXX
 SG_ GD_ID_SCT_VOTED_ACTIVE_CLASS_2 m12306 : 40|16@1+ (1,0) [0|3] "" Vector__XXX
 SG_ GD_ID_SCT_SETPOINT_Status m12312 : 39|1@1+ (1,0) [0|0] "1/0" Vector__XXX
 SG_ GD_ID_SCT_SETPOINT m12312 : 40|16@1- (0.01,0) [-90|90] "deg" Vector__XXX
 SG_ GD_ID_SCT_SETPOINT_FEELER_GUIDANCE_Status m12313 : 39|1@1+ (1,0) [0|0] "1/0" Vector__XXX
 SG_ GD_ID_SCT_SETPOINT_FEELER_GUIDANCE m12313 : 40|16@1- (0.01,0) [-90|90] "deg" Vector__XXX
 SG_ GD_ID_SCT_SETPOINT_CURVATURE_Status m12314 : 39|1@1+ (1,-8032) [0|0] "1/0" Vector__XXX
 SG_ GD_ID_SCT_SETPOINT_CURVATURE m12314 : 40|16@1- (0.25,-8032) [-8032|803175] "1/km" Vector__XXX
 SG_ GD_ID_SCT_SETPOINT_CURVATURE_TIM_Status m12315 : 39|1@1+ (1,-8032) [0|0] "1/0" Vector__XXX
 SG_ GD_ID_SCT_SETPOINT_CURVATURE_TIM m12315 : 40|16@1- (0.25,-8032) [-8032|803175] "1/km" Vector__XXX
 SG_ GD_ID_SCT_SETPOINT_CURVATURE_FEELER_GUIDANCE_Status m12316 : 39|1@1+ (1,-8032) [0|0] "1/0" Vector__XXX
 SG_ GD_ID_SCT_SETPOINT_CURVATURE_FEELER_GUIDANCE m12316 : 40|16@1- (0.25,-8032) [-8032|803175] "1/km" Vector__XXX
 SG_ GD_ID_SCT_WAS_RAW_VALUE m12320 : 40|16@1+ (0.001,0) [0|24510] "mA" Vector__XXX
 SG_ GD_ID_SCT_WAS_SCALED_VALUE m12321 : 40|16@1- (1,0) [-32768|32767] "" Vector__XXX
 SG_ GD_ID_SCT_WAS_SENSOR_ANGLE m12322 : 40|16@1- (0.01,0) [-90|90] "deg" Vector__XXX
 SG_ GD_ID_SCT_WAS_MEDIAN_ANGLE m12323 : 40|16@1- (0.01,0) [-90|90] "deg" Vector__XXX
 SG_ GD_ID_SCT_WAS_MEDIAN_ANGLE_MAX m12324 : 40|16@1- (0.01,0) [-90|90] "deg" Vector__XXX
 SG_ GD_ID_SCT_WAS_VIRTUAL_ANGLE m12325 : 40|16@1- (0.01,0) [-90|90] "deg" Vector__XXX
 SG_ GD_ID_SCT_WAS_MEDIAN_CURVATURE m12328 : 40|16@1- (0.25,-8032) [-8032|803175] "1/km" Vector__XXX
 SG_ GD_ID_SCT_WAS_MEDIAN_CURVATURE_MAX m12329 : 40|16@1- (0.25,-8032) [-8032|803175] "1/km" Vector__XXX
 SG_ GD_ID_SCT_WAS_CALIB_COMMAND m12334 : 40|16@1+ (1,0) [0|254] "" Vector__XXX
 SG_ GD_ID_SCT_WAS_CALIB_STATUS m12335 : 40|16@1+ (1,0) [0|254] "" Vector__XXX
 SG_ GD_ID_SCT_SWS_RAW_VALUE_Status m12336 : 39|1@1+ (1,0) [0|0] "1/0" Vector__XXX
 SG_ GD_ID_SCT_SWS_RAW_VALUE m12336 : 40|16@1+ (1,0) [0|24510] "uA" Vector__XXX
 SG_ GD_ID_SCT_SWS_LIMITED_ANGLE_Status m12338 : 39|1@1+ (1,0) [0|0] "1/0" Vector__XXX
 SG_ GD_ID_SCT_SWS_LIMITED_ANGLE m12338 : 40|16@1- (0.1,0) [-180|180] "degrees" Vector__XXX
 SG_ GD_ID_SCT_SWS_CONTINUED_ANGLE_Status m12339 : 39|1@1+ (1,0) [0|0] "1/0" Vector__XXX
 SG_ GD_ID_SCT_SWS_CONTINUED_ANGLE m12339 : 40|16@1- (0.1,0) [-3276|3276] "degrees" Vector__XXX
 SG_ GD_ID_SCT_SWS_ROTATIONAL_SPEED m12340 : 40|16@1- (0.1,0) [-360|360] "deg/sec" Vector__XXX
 SG_ GD_ID_SCT_VALVE_SETPOINT m12352 : 40|16@1- (0.4,0) [-100|100] "%" Vector__XXX
 SG_ GD_ID_SCT_VALVE_POSITION m12353 : 40|16@1- (1,0) [-125|125] "%" Vector__XXX
 SG_ GD_ID_SCT_VALVE_CALIB_COMMAND m12366 : 40|16@1+ (1,0) [0|254] "" Vector__XXX
 SG_ GD_ID_SCT_VALVE_CALIB_STATUS m12367 : 40|16@1+ (1,0) [0|254] "" Vector__XXX
 SG_ GD_ID_SCT_PILOTVALVE_STATUS_Status m12368 : 39|1@1+ (1,0) [0|0] "1/0" Vector__XXX
 SG_ GD_ID_SCT_PILOTVALVE_STATUS m12368 : 40|16@1+ (1,0) [0|3000] "mA" Vector__XXX
 SG_ GD_ID_SCT_OLAY_STEER_FACTOR m12388 : 40|16@1+ (1,0) [0|80] "" Vector__XXX
 SG_ GD_ID_SCT_HEADLAND_CMD_Status m12416 : 39|1@1+ (1,0) [0|0] "1/0" Vector__XXX
 SG_ GD_ID_SCT_HEADLAND_CMD m12416 : 40|16@1+ (1,0) [0|1] "" Vector__XXX
 SG_ GD_ID_SCT_3RDPARTY_READY_STATUS_Status m12417 : 39|1@1+ (1,0) [0|0] "1/0" Vector__XXX
 SG_ GD_ID_SCT_3RDPARTY_READY_STATUS m12417 : 40|16@1+ (1,0) [0|0] "" Vector__XXX
 SG_ GD_ID_SCT_3RDPARTY_POSITION_STATUS_Status m12418 : 39|1@1+ (1,0) [0|0] "1/0" Vector__XXX
 SG_ GD_ID_SCT_3RDPARTY_POSITION_STATUS m12418 : 40|16@1+ (1,0) [0|0] "" Vector__XXX
 SG_ GD_ID_SCT_3RDPARTY_CANCEL_REQUEST_Status m12419 : 39|1@1+ (1,0) [0|0] "1/0" Vector__XXX
 SG_ GD_ID_SCT_3RDPARTY_CANCEL_REQUEST m12419 : 40|16@1+ (1,0) [0|0] "" Vector__XXX
 SG_ GD_ID_SCT_3RDPARTY_COMMAND_GUIDANCE_Status m12420 : 39|1@1+ (1,0) [0|0] "1/0" Vector__XXX
 SG_ GD_ID_SCT_3RDPARTY_COMMAND_GUIDANCE m12420 : 40|16@1+ (1,0) [0|0] "" Vector__XXX
 SG_ GD_ID_SCT_TSD_MIN_SPEED_FORWARD m12544 : 40|16@1+ (0.001,0) [0|65535] "m/sec" Vector__XXX
 SG_ GD_ID_SCT_TSD_MAX_SPEED_FORWARD m12545 : 40|16@1+ (0.001,0) [0|65535] "m/sec" Vector__XXX
 SG_ GD_ID_SCT_TSD_MIN_MACHINE_RADIUS m12546 : 40|16@1+ (1,0) [0|65535] "mm" Vector__XXX
 SG_ GD_ID_SCT_TSD_MAX_ACQUISITION_ANGLE m12547 : 40|16@1+ (1,0) [0|90] "degrees" Vector__XXX
 SG_ GD_ID_SCT_GUIDANCE_CONFIGURATION_DATA_Status m12560 : 39|1@1+ (1,0) [0|0] "1/0" Vector__XXX
 SG_ GD_ID_SCT_GUIDANCE_CONFIGURATION_DATA m12560 : 40|16@1+ (1,0) [0|65535] "" Vector__XXX
 SG_ GD_ID_SCT_STEERING_MODE_Status m12568 : 39|1@1+ (1,0) [0|0] "1/0" Vector__XXX
 SG_ GD_ID_SCT_STEERING_MODE m12568 : 40|16@1+ (1,0) [0|65535] "" Vector__XXX
 SG_ GD_ID_SCT_SECONDARY_WAS_RAW_VALUE_Status m12569 : 39|1@1+ (1,0) [0|0] "1/0" Vector__XXX
 SG_ GD_ID_SCT_SECONDARY_WAS_RAW_VALUE m12569 : 40|16@1+ (1,0) [0|24510] "uA" Vector__XXX
 SG_ GD_ID_SCT_SECONDARY_WAS_SENSOR_ANGLE_Status m12570 : 39|1@1+ (1,0) [0|0] "1/0" Vector__XXX
 SG_ GD_ID_SCT_SECONDARY_WAS_SENSOR_ANGLE m12570 : 40|16@1- (0.01,0) [-90|90] "degrees" Vector__XXX
 SG_ GD_ID_SCT_SECONDARY_WAS_MEDIAN_ANGLE_Status m12571 : 39|1@1+ (1,0) [0|0] "1/0" Vector__XXX
 SG_ GD_ID_SCT_SECONDARY_WAS_MEDIAN_ANGLE m12571 : 40|16@1- (0.01,0) [-90|90] "degrees" Vector__XXX
 SG_ GD_ID_SCT_SECONDARY_WAS_MEDIAN_ANGLE_MAX_Status m12572 : 39|1@1+ (1,0) [0|0] "1/0" Vector__XXX
 SG_ GD_ID_SCT_SECONDARY_WAS_MEDIAN_ANGLE_MAX m12572 : 40|16@1- (0.01,0) [-90|90] "degrees" Vector__XXX
 SG_ GD_ID_SCT_ALS_X_OFFSET_Status m12573 : 39|1@1+ (1,0) [0|0] "1/0" Vector__XXX
 SG_ GD_ID_SCT_ALS_X_OFFSET m12573 : 40|16@1- (1,0) [-10000|10000] "mm" Vector__XXX
 SG_ GD_ID_SCT_ALS_Y_OFFSET_Status m12574 : 39|1@1+ (1,0) [0|0] "1/0" Vector__XXX
 SG_ GD_ID_SCT_ALS_Y_OFFSET m12574 : 40|16@1- (1,0) [-10000|10000] "mm" Vector__XXX
 SG_ GD_ID_SCT_ADDITIONAL_WORKING_HEIGHT m12575 : 40|16@1+ (1,0) [0|1] "" Vector__XXX
 SG_ GD_ID_SCT_VEHICLE_CURRENT_PAYLOAD_Status m12576 : 39|1@1+ (1,0) [0|0] "1/0" Vector__XXX
 SG_ GD_ID_SCT_VEHICLE_CURRENT_PAYLOAD m12576 : 40|16@1+ (1,0) [0|150] "%" Vector__XXX
 SG_ GD_ID_SCT_ISO_STATE m12598 : 40|16@1+ (1,0) [0|1] "" Vector__XXX
 SG_ GD_ID_SCT_VEHICLE_SPEED_Status m12599 : 39|1@1+ (1,0) [0|0] "1/0" Vector__XXX
 SG_ GD_ID_SCT_VEHICLE_SPEED m12599 : 40|16@1+ (0.01,0) [0|65535] "km/h" Vector__XXX
 SG_ GD_ID_SCT_VEHICLE_MOVEMENT_Status m12600 : 39|1@1+ (1,0) [0|0] "1/0" Vector__XXX
 SG_ GD_ID_SCT_VEHICLE_MOVEMENT m12600 : 40|16@1+ (1,0) [0|10000] "mm" Vector__XXX
 SG_ GD_ID_SCT_PARKING_BRAKE_Status m12601 : 39|1@1+ (1,0) [0|0] "1/0" Vector__XXX
 SG_ GD_ID_SCT_PARKING_BRAKE m12601 : 40|16@1+ (1,0) [0|65535] "" Vector__XXX
 SG_ GD_ID_SCT_CONTROL_MSG_TERMINAL m12608 : 40|16@1+ (1,0) [0|3] "" Vector__XXX
 SG_ GD_ID_SCT_CONTROL_MSG_GUIDEANCE m12609 : 40|16@1+ (1,0) [0|1] "" Vector__XXX
 SG_ GD_ID_SCT_MODIFIED_REFERENCE_POINT_HEIGHT m12610 : 40|16@1- (1,0) [-10000|10000] "mm" Vector__XXX
 SG_ GD_ID_SCT_MODIFIED_GNSS_ANTENNA_X_OFFSET m12611 : 40|16@1- (1,0) [-10000|10000] "mm" Vector__XXX
 SG_ GD_ID_SCT_MODIFIED_GNSS_ANTENNA_Y_OFFSET m12612 : 40|16@1- (1,0) [-10000|10000] "mm" Vector__XXX
 SG_ GD_ID_SCT_MODIFIED_GNSS_ANTENNA_Z_OFFSET m12613 : 40|16@1- (1,0) [-10000|10000] "mm" Vector__XXX
 SG_ GD_ID_SCT_MODIFIED_TRACK_WIDTH m12614 : 40|16@1+ (1,0) [0|10000] "mm" Vector__XXX
 SG_ GD_ID_SCT_MODIFIED_MOUNTING_ERROR_Y_OFFSET m12615 : 40|16@1- (1,0) [-100|100] "mm" Vector__XXX
 SG_ GD_ID_SCT_TRACTOR_SN_TYPE m12736 : 40|16@1+ (1,0) [0|999] "" Vector__XXX
 SG_ GD_ID_SCT_TRACTOR_SN_GROUP m12737 : 40|16@1+ (1,0) [0|99] "" Vector__XXX
 SG_ GD_ID_SCT_TRACTOR_SN_NUMBER m12738 : 40|16@1+ (1,0) [0|99999] "" Vector__XXX
 SG_ GD_ID_SCT_ERROR_ACKNOWLEDGE_Status m12782 : 39|1@1+ (1,0) [0|0] "1/0" Vector__XXX
 SG_ GD_ID_SCT_ERROR_ACKNOWLEDGE m12782 : 40|16@1+ (1,0) [0|255] "" Vector__XXX
 SG_ GD_ID_SCT_ACTIVATE_DIAGNOSTICS m12784 : 40|16@1+ (1,0) [0|65535] "" Vector__XXX
 SG_ GD_ID_SCT_SAFETY_VERSION_Status m12788 : 39|1@1+ (1,0) [0|0] "1/0" Vector__XXX
 SG_ GD_ID_SCT_SAFETY_VERSION m12788 : 40|16@1+ (1,0) [0|65535] "" Vector__XXX
 SG_ GD_ID_SCT_LIB_SAFETY_VERSION m12789 : 40|16@1+ (1,0) [0|65535] "" Vector__XXX
 SG_ GD_ID_SCT_RECIPE_ACCESS_SETPOINT m12792 : 40|16@1+ (1,0) [0|65535] "" Vector__XXX
 SG_ GD_ID_SCT_TI_ACCESS_SETPOINT m12793 : 40|16@1+ (1,0) [0|65535] "" Vector__XXX
 SG_ GD_ID_SCT_TI_ACCESS_STATE m12794 : 40|16@1+ (1,0) [0|65535] "" Vector__XXX
 SG_ GD_ID_SCT_TI_ACCESS_STATE_KL15 m12795 : 40|16@1+ (1,0) [0|65535] "" Vector__XXX
 SG_ GD_ID_SCT_TI_SUB_STATE m12797 : 40|16@1+ (1,0) [0|255] "" Vector__XXX
 SG_ GD_ID_SCT_ErrorManagement_Status m12782 : 39|1@1+ (1,0) [0|0] "1/0" Vector__XXX
 SG_ GD_ID_SCT_ErrorManagement m12782 : 40|16@1+ (1,0) [0|255] "" Vector__XXX
 SG_ GD_ID_SCT_LifeMessage m12799 : 40|16@1+ (1,0) [0|65535] "ms" Vector__XXX

 SG_ GD_ID_Engine_Rpm m12800 : 40|16@1+ (0.125,0) [0|32767] "1/min" Vector__XXX
 SG_ GD_ID_Engine_Load m12801 : 40|16@1+ (0.01,0) [0|10000] "%" Vector__XXX
 SG_ GD_ID_Engine_Coolant_Temp_Status m12802 : 39|1@1+ (1,0) [0|0] "1/0" Vector__XXX
 SG_ GD_ID_Engine_Coolant_Temp m12802 : 40|16@1- (1,0) [-40|130] "C" Vector__XXX
 SG_ GD_ID_Engine_Air_Intake_Temp m12803 : 40|16@1- (1,0) [-40|130] "C" Vector__XXX
 SG_ GD_ID_Engine_Battery_Power_Status m12804 : 39|1@1+ (1,0) [0|0] "1/0" Vector__XXX
 SG_ GD_ID_Engine_Battery_Power m12804 : 40|16@1+ (0.05,0) [0|32767] "V" Vector__XXX
 SG_ GD_ID_Engine_Air_Intake_Pressure m12805 : 40|16@1+ (0.01,0) [0|255] "bar" Vector__XXX
 SG_ GD_ID_Engine_Oil_Pressure m12806 : 40|16@1+ (0.01,0) [0|255] "bar" Vector__XXX
 SG_ GD_ID_Engine_Rpm_Setpoint_Status m12807 : 39|1@1+ (1,0) [0|0] "1/0" Vector__XXX
 SG_ GD_ID_Engine_Rpm_Setpoint m12807 : 40|16@1+ (0.125,0) [0|32767] "1/min" Vector__XXX
 SG_ GD_ID_Engine_Standing_Still_Status m12808 : 39|1@1+ (1,0) [0|0] "1/0" Vector__XXX
 SG_ GD_ID_Engine_Standing_Still m12808 : 40|16@1+ (1,0) [0|0] "STILL/RUNNING" Vector__XXX
 SG_ GD_ID_Engine_Oil_Pressure_Low_Status m12809 : 39|1@1+ (1,0) [0|0] "1/0" Vector__XXX
 SG_ GD_ID_Engine_Oil_Pressure_Low m12809 : 40|16@1+ (1,0) [0|0] "LOW/OK" Vector__XXX
 SG_ GD_ID_Engine_Oil_Service_Interval_Status m12810 : 39|1@1+ (1,0) [0|0] "1/0" Vector__XXX
 SG_ GD_ID_Engine_Oil_Service_Interval m12810 : 40|16@1+ (1,0) [0|0] "EXCEEDED/OK" Vector__XXX
 SG_ GD_ID_Engine_Hours m12811 : 40|16@1+ (1,0) [0|32767] "h" Vector__XXX
 SG_ GD_ID_Engine_Amber_Warning_Lamp_Status m12812 : 39|1@1+ (1,0) [0|0] "1/0" Vector__XXX
 SG_ GD_ID_Engine_Amber_Warning_Lamp m12812 : 40|16@1+ (1,0) [0|0] "ON/OFF" Vector__XXX
 SG_ GD_ID_Engine_Red_Stop_Lamp_Status m12813 : 39|1@1+ (1,0) [0|0] "1/0" Vector__XXX
 SG_ GD_ID_Engine_Red_Stop_Lamp m12813 : 40|16@1+ (1,0) [0|0] "ON/OFF" Vector__XXX
 SG_ GD_ID_Alt_Low_Idle m12814 : 40|16@1+ (1,0) [0|1] "ON/OFF" Vector__XXX
 SG_ GD_ID_Engine_Audible_Warning_Status m12815 : 39|1@1+ (1,0) [0|0] "1/0" Vector__XXX
 SG_ GD_ID_Engine_Audible_Warning m12815 : 40|16@1+ (1,0) [0|0] "ON/OFF" Vector__XXX
 SG_ GD_ID_Ambient_Temp m12816 : 40|16@1- (1,0) [-273|1775] "C" Vector__XXX
 SG_ GD_ID_Ecu_Temp m12817 : 40|16@1- (1,0) [-273|1775] "C" Vector__XXX
 SG_ GD_ID_Fuel_Rate m12820 : 40|16@1+ (0.05,0) [0|32767] "l/h" Vector__XXX
 SG_ GD_ID_Trip_Fuel m12821 : 40|16@1+ (0.05,0) [0|32767] "l" Vector__XXX
 SG_ GD_ID_Trip_DEF m12822 : 40|16@1+ (0.1,0) [0|32767] "l" Vector__XXX
 SG_ GD_ID_DEF_Level m12823 : 40|16@1+ (0.1,0) [0|1000] "%" Vector__XXX
 SG_ GD_ID_Water_In_Fuel_Status m12824 : 39|1@1+ (1,0) [0|0] "1/0" Vector__XXX
 SG_ GD_ID_Water_In_Fuel m12824 : 40|16@1+ (1,0) [0|0] "YES/NO" Vector__XXX
 SG_ GD_ID_Engine_Malfunction_Lamp_Status m12825 : 39|1@1+ (1,0) [0|0] "1/0" Vector__XXX
 SG_ GD_ID_Engine_Malfunction_Lamp m12825 : 40|16@1+ (1,0) [0|1] "ON/OFF/FLASH" Vector__XXX
 SG_ GD_ID_DEF_Level_Warning_Status m12826 : 39|1@1+ (1,0) [0|0] "1/0" Vector__XXX
 SG_ GD_ID_DEF_Level_Warning m12826 : 40|16@1+ (1,0) [0|1] "ON/OFF/FLASH" Vector__XXX
 SG_ GD_ID_Engine_WaitToStart_Status m12827 : 39|1@1+ (1,0) [0|0] "1/0" Vector__XXX
 SG_ GD_ID_Engine_WaitToStart m12827 : 40|16@1+ (1,0) [0|0] "ON/OFF" Vector__XXX
 SG_ GD_ID_Engine_Operating_State m12828 : 40|16@1+ (1,0) [0|15] "" Vector__XXX
 SG_ GD_ID_Engine_Start_Enable_Status m12829 : 39|1@1+ (1,0) [0|0] "1/0" Vector__XXX
 SG_ GD_ID_Engine_Start_Enable m12829 : 40|16@1+ (1,0) [0|0] "ON/OFF" Vector__XXX
 SG_ GD_ID_Implement_Transport_State_Status m12830 : 39|1@1+ (1,0) [0|0] "1/0" Vector__XXX
 SG_ GD_ID_Implement_Transport_State m12830 : 40|16@1+ (1,0) [0|0] "OK/Not" Vector__XXX
 SG_ GD_ID_Implement_Work_State_Status m12831 : 39|1@1+ (1,0) [0|0] "1/0" Vector__XXX
 SG_ GD_ID_Implement_Work_State m12831 : 40|16@1+ (1,0) [0|0] "ON/OFF" Vector__XXX
 SG_ GD_ID_Implement_Actual_Working_Width m12832 : 40|16@1+ (1,0) [0|65535] "mm" Vector__XXX
 SG_ GD_ID_Implement_Actual_Flow m12833 : 40|16@1+ (0.1,0) [0|65535] "l/s" Vector__XXX
 SG_ GD_ID_Implement_ReadyForFieldWork_Status m12834 : 39|1@1+ (1,0) [0|0] "1/0" Vector__XXX
 SG_ GD_ID_Implement_ReadyForFieldWork m12834 : 40|16@1+ (1,0) [0|0] "YES/NO" Vector__XXX
 SG_ GD_ID_WheelBasedDistance_km m12840 : 40|16@1+ (1,0) [0|65535] "km" Vector__XXX
 SG_ GD_ID_WheelBasedDistance_m m12841 : 40|16@1+ (1,0) [0|65535] "m" Vector__XXX
 SG_ GD_ID_GroundBasedDistance_km m12842 : 40|16@1+ (1,0) [0|65535] "km" Vector__XXX
 SG_ GD_ID_GroundBasedDistance_m m12843 : 40|16@1+ (1,0) [0|65535] "m" Vector__XXX
 SG_ GD_ID_SelectedSpeedDistance_km m12844 : 40|16@1+ (1,0) [0|65535] "km" Vector__XXX
 SG_ GD_ID_SelectedSpeedDistance_m m12845 : 40|16@1+ (1,0) [0|65535] "m" Vector__XXX
 SG_ GD_ID_MachineSelectedSpeed m12846 : 40|16@1+ (0.0036,0) [0|32767] "km/h" Vector__XXX
 SG_ GD_ID_WBZ_MACHINE_SELECTED_SOURCE m12847 : 40|16@1+ (1,0) [0|7] "enum" Vector__XXX
 SG_ GD_ID_WBZ_MAX_ENG_RPM m12848 : 40|16@1+ (0.1,0) [0|2500] "rpm" Vector__XXX
 SG_ GD_ID_Working_Time_SecMin_VD m12850 : 40|16@1+ (1,0) [0|59] "s/min" Vector__XXX
 SG_ GD_ID_Working_Time_Hours_VD m12851 : 40|16@1+ (1,0) [0|65535] "h" Vector__XXX
 SG_ GD_ID_Worked_Area_Ha_VD m12852 : 40|16@1+ (1,0) [0|65535] "ha" Vector__XXX
 SG_ GD_ID_Worked_Area_0001Ha_VD m12853 : 40|16@1+ (1,0) [0|9999] "ha" Vector__XXX
 SG_ GD_ID_Used_Fuel_VD m12854 : 40|16@1+ (0.1,0) [0|6553.5] "l" Vector__XXX
 SG_ GD_ID_Remaining_Time_SecMin_VD m12855 : 40|16@1+ (1,0) [0|59] "s/min" Vector__XXX
 SG_ GD_ID_Remaining_Time_Hours_VD m12856 : 40|16@1+ (1,0) [0|65535] "h" Vector__XXX
 SG_ GD_ID_Remaining_Area_Ha_VD m12857 : 40|16@1+ (1,0) [0|65535] "ha" Vector__XXX
 SG_ GD_ID_Remaining_Area_0001Ha_VD m12858 : 40|16@1+ (1,0) [0|9999] "ha" Vector__XXX
 SG_ GD_ID_Required_Fuel_VD m12859 : 40|16@1+ (0.1,0) [0|6553.5] "l" Vector__XXX
 SG_ GD_ID_Field_Size_Ha_VD m12860 : 40|16@1+ (1,0) [0|65535] "ha" Vector__XXX
 SG_ GD_ID_Field_Size_0001Ha_VD m12861 : 40|16@1+ (1,0) [0|9999] "ha" Vector__XXX
 SG_ GD_ID_Reset_VD_Status m12862 : 39|1@1+ (1,0) [0|0] "1/0" Vector__XXX
 SG_ GD_ID_Reset_VD m12862 : 40|16@1+ (1,0) [0|0] "ON/OFF" Vector__XXX
 SG_ GD_Iso_IsoState_state_RW m12870 : 40|16@1+ (1,0) [0|15] "ON/OFF" Vector__XXX
 SG_ GD_ID_WBZ_TERMINAL_PAGE_SIZE m12871 : 40|16@1+ (1,0) [0|3] "enum" Vector__XXX
 SG_ GD_ID_WBZ_ENG_DEF_LVL_LAMP_Status m12878 : 39|1@1+ (1,0) [0|0] "1/0" Vector__XXX
 SG_ GD_ID_WBZ_ENG_DEF_LVL_LAMP m12878 : 40|16@1+ (1,0) [0|1] "" Vector__XXX
 SG_ GD_ID_WBZ_ENG_DEF_MIL_LAMP_Status m12879 : 39|1@1+ (1,0) [0|0] "1/0" Vector__XXX
 SG_ GD_ID_WBZ_ENG_DEF_MIL_LAMP m12879 : 40|16@1+ (1,0) [0|1] "" Vector__XXX
 SG_ GD_ID_IgnitionState_Status m12880 : 39|1@1+ (1,0) [0|0] "1/0" Vector__XXX
 SG_ GD_ID_IgnitionState m12880 : 40|16@1+ (1,0) [0|0] "ON/OFF" Vector__XXX
 SG_ GD_ID_WBZ_ENG_FAN_RPM m12881 : 40|16@1+ (0.125,0) [0|32767] "RPM" Vector__XXX
 SG_ GD_ID_WBZ_ENG_FUEL_TEMP m12882 : 40|16@1- (1,0) [-40|210] "C" Vector__XXX
 SG_ GD_ID_WBZ_ENG_AUXIO1_01 m12883 : 40|16@1+ (1,0) [0|3] "" Vector__XXX
 SG_ GD_ID_WBZ_ENG_FAN_DUTY_CYCLE m12884 : 40|16@1+ (0.01,0) [0|10000] "%" Vector__XXX
 SG_ GD_ID_WBZ_DEF_TEMP m12885 : 40|16@1- (1,0) [-40|215] "C" Vector__XXX
 SG_ GD_ID_WBZ_EXHAUST_TEMP m12886 : 40|16@1- (0.03125,-273) [-273|1734.969] "C" Vector__XXX
 SG_ GD_ID_WBZ_FUEL_PRESSURE m12887 : 40|16@1+ (0.04,0) [0|10.2] "bar" Vector__XXX
 SG_ GD_ID_WBZ_CURVATURE_SETPOINT m12888 : 40|16@1- (0.25,-8032) [-8032|8031.75] "1/Km" Vector__XXX
 SG_ GD_ID_WBZ_CURVATURE_ENABLE_Status m12889 : 39|1@1+ (1,0) [0|0] "1/0" Vector__XXX
 SG_ GD_ID_WBZ_CURVATURE_ENABLE m12889 : 40|16@1+ (1,0) [0|0] "" Vector__XXX
 SG_ GD_ID_WBZ_ENG_START_CMD_Status m12890 : 39|1@1+ (1,0) [0|0] "1/0" Vector__XXX
 SG_ GD_ID_WBZ_ENG_START_CMD m12890 : 40|16@1+ (1,0) [0|0] "" Vector__XXX
 SG_ GD_ID_WBZ_THIRD_PARTY_MANUS_Status m12891 : 39|1@1+ (1,0) [0|0] "1/0" Vector__XXX
 SG_ GD_ID_WBZ_THIRD_PARTY_MANUS m12891 : 40|16@1+ (1,0) [0|32] "" Vector__XXX
 SG_ GD_ID_WBZ_NEW_LEADER_ACL_Status m12892 : 39|1@1+ (1,0) [0|0] "1/0" Vector__XXX
 SG_ GD_ID_WBZ_NEW_LEADER_ACL m12892 : 40|16@1+ (1,0) [0|0] "" Vector__XXX
 SG_ GD_ID_WBZ_AUXIO1_01_FI02 m12901 : 40|16@1+ (1,0) [0|3] "" Vector__XXX
 SG_ GD_ID_WBZ_AUXIO1_02_FI02 m12902 : 40|16@1+ (1,0) [0|3] "" Vector__XXX
 SG_ GD_ID_WBZ_AUXIO1_03_FI02 m12903 : 40|16@1+ (1,0) [0|3] "" Vector__XXX
 SG_ GD_ID_WBZ_AUXIO1_04_FI02 m12904 : 40|16@1+ (1,0) [0|3] "" Vector__XXX
 SG_ GD_ID_WBZ_AUXIO1_05_FI02 m12905 : 40|16@1+ (1,0) [0|3] "" Vector__XXX
 SG_ GD_ID_WBZ_AUXIO1_06_FI02 m12906 : 40|16@1+ (1,0) [0|3] "" Vector__XXX
 SG_ GD_ID_WBZ_AUXIO1_07_FI02 m12907 : 40|16@1+ (1,0) [0|3] "" Vector__XXX
 SG_ GD_ID_WBZ_AUXIO1_08_FI02 m12908 : 40|16@1+ (1,0) [0|3] "" Vector__XXX
 SG_ GD_ID_WBZ_AUXIO1_09_FI02 m12909 : 40|16@1+ (1,0) [0|3] "" Vector__XXX
 SG_ GD_ID_WBZ_AUXIO1_10_FI02 m12910 : 40|16@1+ (1,0) [0|3] "" Vector__XXX
 SG_ GD_ID_WBZ_AUXIO1_11_FI02 m12911 : 40|16@1+ (1,0) [0|3] "" Vector__XXX
 SG_ GD_ID_WBZ_AUXIO1_12_FI02 m12912 : 40|16@1+ (1,0) [0|3] "" Vector__XXX
 SG_ GD_ID_WBZ_AUXIO2_17_FI02 m12917 : 40|16@1+ (1,0) [0|3] "" Vector__XXX
 SG_ GD_ID_WBZ_AUXIO2_18_FI02 m12918 : 40|16@1+ (1,0) [0|3] "" Vector__XXX
 SG_ GD_ID_WBZ_AUXIO1_01_FI00 m12919 : 40|16@1+ (1,0) [0|3] "" Vector__XXX
 SG_ GD_ID_WBZ_AUXIO1_02_FI00 m12920 : 40|16@1+ (1,0) [0|3] "" Vector__XXX
 SG_ GD_ID_WBZ_AUXIO1_03_FI00 m12921 : 40|16@1+ (1,0) [0|3] "" Vector__XXX
 SG_ GD_ID_WBZ_AUXIO1_04_FI00 m12922 : 40|16@1+ (1,0) [0|3] "" Vector__XXX
 SG_ GD_ID_WBZ_AUXIO1_05_FI00 m12923 : 40|16@1+ (1,0) [0|3] "" Vector__XXX
 SG_ GD_ID_WBZ_AUXIO1_06_FI00 m12924 : 40|16@1+ (1,0) [0|3] "" Vector__XXX
 SG_ GD_ID_WBZ_AUXIO1_07_FI00 m12925 : 40|16@1+ (1,0) [0|3] "" Vector__XXX
 SG_ GD_ID_WBZ_AUXIO1_08_FI00 m12926 : 40|16@1+ (1,0) [0|3] "" Vector__XXX
 SG_ GD_ID_WBZ_AUXIO1_09_FI00 m12927 : 40|16@1+ (1,0) [0|3] "" Vector__XXX
 SG_ GD_ID_WBZ_AUXIO1_10_FI00 m12928 : 40|16@1+ (1,0) [0|3] "" Vector__XXX
 SG_ GD_ID_WBZ_AUXIO1_11_FI00 m12929 : 40|16@1+ (1,0) [0|3] "" Vector__XXX
 SG_ GD_ID_WBZ_AUXIO1_12_FI00 m12930 : 40|16@1+ (1,0) [0|3] "" Vector__XXX
 SG_ GD_ID_WBZ_AUXIO1_13_FI00 m12931 : 40|16@1+ (1,0) [0|3] "" Vector__XXX
 SG_ GD_ID_WBZ_AUXIO1_14_FI00 m12932 : 40|16@1+ (1,0) [0|3] "" Vector__XXX
 SG_ GD_ID_WBZ_AUXIO1_15_FI00 m12933 : 40|16@1+ (1,0) [0|3] "" Vector__XXX
 SG_ GD_ID_WBZ_AUXIO1_16_FI00 m12934 : 40|16@1+ (1,0) [0|3] "" Vector__XXX
 SG_ GD_ID_WBZ_AUXIO1_CH2 m12935 : 40|16@1+ (0.125,0) [0|8031.875] "RPM" Vector__XXX
 SG_ GD_ID_WBZ_AUXIO2_17_FI00 m12936 : 40|16@1+ (1,0) [0|3] "" Vector__XXX
 SG_ GD_ID_WBZ_AUXIO2_18_FI00 m12937 : 40|16@1+ (1,0) [0|3] "" Vector__XXX
 SG_ GD_ID_WBZ_AUXIO2_21_FI00 m12940 : 40|16@1+ (1,0) [0|3] "" Vector__XXX
 SG_ GD_ID_WBZ_AUXIO2_22_FI00 m12941 : 40|16@1+ (1,0) [0|3] "" Vector__XXX
 SG_ GD_ID_WBZ_AUXIO2_26_FI00 m12945 : 40|16@1+ (1,0) [0|3] "" Vector__XXX
 SG_ GD_ID_WBZ_AUXIO2_27_FI00 m12946 : 40|16@1+ (1,0) [0|3] "" Vector__XXX
 SG_ GD_ID_WBZ_AUXIO2_28_FI00 m12947 : 40|16@1+ (1,0) [0|3] "" Vector__XXX
 SG_ GD_ID_WBZ_AUXIO2_29_FI00 m12948 : 40|16@1+ (1,0) [0|3] "" Vector__XXX
 SG_ GD_ID_WBZ_AUXIO2_30_FI00 m12949 : 40|16@1+ (1,0) [0|3] "" Vector__XXX
 SG_ GD_ID_WBZ_AUXIO2_31_FI00 m12950 : 40|16@1+ (1,0) [0|3] "" Vector__XXX
 SG_ GD_ID_WBZ_AUXIO2_32_FI00 m12951 : 40|16@1+ (1,0) [0|3] "" Vector__XXX
 SG_ GD_ID_WBZ_AUXIO1_01_FI01 m12952 : 40|16@1+ (1,0) [0|3] "" Vector__XXX
 SG_ GD_ID_WBZ_AUXIO1_02_FI01 m12953 : 40|16@1+ (1,0) [0|3] "" Vector__XXX
 SG_ GD_ID_WBZ_AUXIO1_03_FI01 m12954 : 40|16@1+ (1,0) [0|3] "" Vector__XXX
 SG_ GD_ID_WBZ_AUXIO1_04_FI01 m12955 : 40|16@1+ (1,0) [0|3] "" Vector__XXX
 SG_ GD_ID_WBZ_AUXIO1_05_FI01 m12956 : 40|16@1+ (1,0) [0|3] "" Vector__XXX
 SG_ GD_ID_WBZ_AUXIO1_06_FI01 m12957 : 40|16@1+ (1,0) [0|3] "" Vector__XXX
 SG_ GD_ID_WBZ_AUXIO1_07_FI01 m12958 : 40|16@1+ (1,0) [0|3] "" Vector__XXX
 SG_ GD_ID_WBZ_AUXIO1_08_FI01 m12959 : 40|16@1+ (1,0) [0|3] "" Vector__XXX
 SG_ GD_ID_WBZ_AUXIO1_09_FI01 m12960 : 40|16@1+ (1,0) [0|3] "" Vector__XXX
 SG_ GD_ID_WBZ_AUXIO1_10_FI01 m12961 : 40|16@1+ (1,0) [0|3] "" Vector__XXX
 SG_ GD_ID_WBZ_AUXIO1_11_FI01 m12962 : 40|16@1+ (1,0) [0|3] "" Vector__XXX
 SG_ GD_ID_WBZ_AUXIO1_12_FI01 m12963 : 40|16@1+ (1,0) [0|3] "" Vector__XXX
 SG_ GD_ID_WBZ_AUXIO1_13_FI01 m12964 : 40|16@1+ (1,0) [0|3] "" Vector__XXX
 SG_ GD_ID_WBZ_AUXIO1_14_FI01 m12965 : 40|16@1+ (1,0) [0|3] "" Vector__XXX
 SG_ GD_ID_WBZ_AUXIO1_15_FI01 m12966 : 40|16@1+ (1,0) [0|3] "" Vector__XXX
 SG_ GD_ID_WBZ_AUXIO1_16_FI01 m12967 : 40|16@1+ (1,0) [0|3] "" Vector__XXX
 SG_ GD_ID_WBZ_AUXIO2_17_FI01 m12969 : 40|16@1+ (1,0) [0|3] "" Vector__XXX
 SG_ GD_ID_WBZ_AUXIO2_18_FI01 m12970 : 40|16@1+ (1,0) [0|3] "" Vector__XXX
 SG_ GD_ID_WBZ_AUXIO2_21_FI01 m12973 : 40|16@1+ (1,0) [0|3] "" Vector__XXX
 SG_ GD_ID_WBZ_AUXIO2_22_FI01 m12974 : 40|16@1+ (1,0) [0|3] "" Vector__XXX
 SG_ GD_ID_WBZ_AUXIO2_26_FI01 m12978 : 40|16@1+ (1,0) [0|3] "" Vector__XXX
 SG_ GD_ID_WBZ_AUXIO2_27_FI01 m12979 : 40|16@1+ (1,0) [0|3] "" Vector__XXX
 SG_ GD_ID_WBZ_AUXIO2_28_FI01 m12980 : 40|16@1+ (1,0) [0|3] "" Vector__XXX
 SG_ GD_ID_WBZ_AUXIO2_29_FI01 m12981 : 40|16@1+ (1,0) [0|3] "" Vector__XXX
 SG_ GD_ID_WBZ_AUXIO2_30_FI01 m12982 : 40|16@1+ (1,0) [0|3] "" Vector__XXX
 SG_ GD_ID_WBZ_AUXIO2_31_FI01 m12983 : 40|16@1+ (1,0) [0|3] "" Vector__XXX
 SG_ GD_ID_WBZ_AUXIO2_32_FI01 m12984 : 40|16@1+ (1,0) [0|3] "" Vector__XXX
 SG_ GD_ID_WBZ_AUXIO2_21_FI02 m12985 : 40|16@1+ (1,0) [0|3] "" Vector__XXX
 SG_ GD_ID_WBZ_AUXIO2_22_FI02 m12986 : 40|16@1+ (1,0) [0|3] "" Vector__XXX
 SG_ GD_ID_WBZ_TI_ACCESS m13000 : 40|16@1+ (1,0) [0|65535] "" Vector__XXX
 SG_ GD_ID_Unknown_Engine_Error_Part1 m13052 : 40|16@1+ (1,0) [0|65535] "" Vector__XXX
 SG_ GD_ID_Unknown_Engine_Error_Part2 m13053 : 40|16@1+ (1,0) [0|65535] "" Vector__XXX
 SG_ GD_ID_WBZ_DPF_WARNING_LAMP_Status m13120 : 39|1@1+ (1,0) [0|0] "1/0" Vector__XXX
 SG_ GD_ID_WBZ_DPF_WARNING_LAMP m13120 : 40|16@1+ (1,0) [0|1] "" Vector__XXX
 SG_ GD_ID_WBZ_DPF_HEST_LAMP_Status m13121 : 39|1@1+ (1,0) [0|0] "1/0" Vector__XXX
 SG_ GD_ID_WBZ_DPF_HEST_LAMP m13121 : 40|16@1+ (1,0) [0|1] "" Vector__XXX
 SG_ GD_ID_WBZ_DPF_SOOT_ASH m13123 : 40|16@1+ (1,0) [0|65535] "%" Vector__XXX
 SG_ GD_ID_WBZ_DPF_HOURS_SINCE_REGEN m13124 : 40|16@1+ (1,0) [0|65535] "h" Vector__XXX
 SG_ GD_ID_WBZ_DPF_MINUTES_SINCE_REGEN m13125 : 40|16@1+ (1,0) [0|65535] "min" Vector__XXX
 SG_ GD_ID_WBZ_DPF_STATI m13126 : 40|16@1+ (1,0) [0|65535] "" Vector__XXX
 SG_ GD_ID_WBZ_DPF_INHIBITED_STATI m13128 : 40|16@1+ (1,0) [0|32768] "" Vector__XXX
 SG_ GD_ID_WBZ_DPF_CONTROL_REGEN m13129 : 40|16@1+ (1,0) [0|2] "" Vector__XXX
 SG_ GD_ID_WBZ_DPF_ENABLE_REGEN_Status m13130 : 39|1@1+ (1,0) [0|0] "1/0" Vector__XXX
 SG_ GD_ID_WBZ_DPF_ENABLE_REGEN m13130 : 40|16@1+ (1,0) [0|0] "" Vector__XXX
 SG_ GD_ID_WBZ_ErrorManagement_Status m13294 : 39|1@1+ (1,0) [0|0] "1/0" Vector__XXX
 SG_ GD_ID_WBZ_ErrorManagement m13294 : 40|16@1+ (1,0) [0|255] "" Vector__XXX
 SG_ GD_ID_WBZ_LifeMessage m13311 : 40|16@1+ (1,0) [0|65535] "ms" Vector__XXX

 SG_ GD_ID_Current_Track_Width m13824 : 40|16@1+ (1,0) [0|32767] "mm" Vector__XXX
 SG_ GD_ID_TA_Min_Track_Width m13825 : 40|16@1+ (1,0) [1800|3900] "mm" Vector__XXX
 SG_ GD_ID_Max_Track_Width m13826 : 40|16@1+ (1,0) [0|32767] "mm" Vector__XXX
 SG_ GD_ID_Calib_State_Track_Width_Status m13827 : 39|1@1+ (1,0) [0|0] "1/0" Vector__XXX
 SG_ GD_ID_Calib_State_Track_Width m13827 : 40|16@1+ (1,0) [0|0] "TRUE/FALSE" Vector__XXX
 SG_ GD_ID_TA_Front_Axle_Width m13828 : 40|16@1+ (1,0) [0|32767] "mm" Vector__XXX
 SG_ GD_ID_TA_Front_Track_Width m13829 : 40|16@1+ (1,0) [1800|3900] "mm" Vector__XXX
 SG_ GD_ID_TA_Rear_Axle_Width m13830 : 40|16@1+ (1,0) [0|32767] "mm" Vector__XXX
 SG_ GD_ID_TA_Rear_Track_Width m13831 : 40|16@1+ (1,0) [1800|3900] "mm" Vector__XXX
 SG_ GD_ID_Track_Adjust_Errors_Status m13832 : 39|1@1+ (1,0) [0|0] "1/0" Vector__XXX
 SG_ GD_ID_Track_Adjust_Errors m13832 : 40|16@1+ (1,0) [0|65535] "1 bit/error" Vector__XXX
 SG_ GD_ID_TA_Calibration_Command m13833 : 40|16@1+ (1,0) [0|65535] "" Vector__XXX
 SG_ GD_ID_TA_Calibration_State m13834 : 40|16@1+ (1,0) [0|65535] "" Vector__XXX
 SG_ GD_ID_TA_MANUAL_IN_Status m13835 : 39|1@1+ (1,0) [0|0] "1/0" Vector__XXX
 SG_ GD_ID_TA_MANUAL_IN m13835 : 40|16@1+ (1,0) [0|0] "" Vector__XXX
 SG_ GD_ID_TA_MANUAL_OUT_Status m13836 : 39|1@1+ (1,0) [0|0] "1/0" Vector__XXX
 SG_ GD_ID_TA_MANUAL_OUT m13836 : 40|16@1+ (1,0) [0|0] "" Vector__XXX
 SG_ GD_ID_TA_Actual_Front_In_R_Status m13839 : 39|1@1+ (1,0) [0|0] "1/0" Vector__XXX
 SG_ GD_ID_TA_Actual_Front_In_R m13839 : 40|16@1+ (1,0) [0|0] "ON/OFF" Vector__XXX
 SG_ GD_ID_TA_Actual_Front_Out_R_Status m13840 : 39|1@1+ (1,0) [0|0] "1/0" Vector__XXX
 SG_ GD_ID_TA_Actual_Front_Out_R m13840 : 40|16@1+ (1,0) [0|0] "ON/OFF" Vector__XXX
 SG_ GD_ID_TA_Actual_Rear_In_R_Status m13841 : 39|1@1+ (1,0) [0|0] "1/0" Vector__XXX
 SG_ GD_ID_TA_Actual_Rear_In_R m13841 : 40|16@1+ (1,0) [0|0] "ON/OFF" Vector__XXX
 SG_ GD_ID_TA_Actual_Rear_Out_R_Status m13842 : 39|1@1+ (1,0) [0|0] "1/0" Vector__XXX
 SG_ GD_ID_TA_Actual_Rear_Out_R m13842 : 40|16@1+ (1,0) [0|0] "ON/OFF" Vector__XXX
 SG_ GD_ID_TA_Actual_Front_In_Status m13843 : 39|1@1+ (1,0) [0|0] "1/0" Vector__XXX
 SG_ GD_ID_TA_Actual_Front_In m13843 : 40|16@1+ (1,0) [0|0] "ON/OFF" Vector__XXX
 SG_ GD_ID_TA_Actual_Front_Out_Status m13844 : 39|1@1+ (1,0) [0|0] "1/0" Vector__XXX
 SG_ GD_ID_TA_Actual_Front_Out m13844 : 40|16@1+ (1,0) [0|0] "ON/OFF" Vector__XXX
 SG_ GD_ID_TA_Actual_Rear_In_Status m13845 : 39|1@1+ (1,0) [0|0] "1/0" Vector__XXX
 SG_ GD_ID_TA_Actual_Rear_In m13845 : 40|16@1+ (1,0) [0|0] "ON/OFF" Vector__XXX
 SG_ GD_ID_TA_Actual_Rear_Out_Status m13846 : 39|1@1+ (1,0) [0|0] "1/0" Vector__XXX
 SG_ GD_ID_TA_Actual_Rear_Out m13846 : 40|16@1+ (1,0) [0|0] "ON/OFF" Vector__XXX
 SG_ GD_ID_Track_Adjust_Equipped_Status m13847 : 39|1@1+ (1,0) [0|0] "1/0" Vector__XXX
 SG_ GD_ID_Track_Adjust_Equipped m13847 : 40|16@1+ (1,0) [0|0] "YES/NO" Vector__XXX
 SG_ GD_ID_TA_Min_Tire_Track_Width m13848 : 40|16@1+ (1,0) [0|3900] "mm" Vector__XXX
 SG_ GD_ID_Current_Axle_Width m13849 : 40|16@1+ (1,0) [0|3900] "mm" Vector__XXX
 SG_ GD_ID_TA_Operation_State_Status m13850 : 39|1@1+ (1,0) [0|0] "1/0" Vector__XXX
 SG_ GD_ID_TA_Operation_State m13850 : 40|16@1+ (1,0) [0|3] "enum" Vector__XXX
 SG_ GD_ID_TA_In_Tolerance_Status m13851 : 39|1@1+ (1,0) [0|0] "1/0" Vector__XXX
 SG_ GD_ID_TA_In_Tolerance m13851 : 40|16@1+ (1,0) [0|0] "bool" Vector__XXX
 SG_ GD_ID_TA_Auto_Enable_A_Status m13852 : 39|1@1+ (1,0) [0|0] "1/0" Vector__XXX
 SG_ GD_ID_TA_Auto_Enable_A m13852 : 40|16@1+ (1,0) [0|0] "bool" Vector__XXX
 SG_ GD_ID_TA_Auto_Enable_B_Status m13853 : 39|1@1+ (1,0) [0|0] "1/0" Vector__XXX
 SG_ GD_ID_TA_Auto_Enable_B m13853 : 40|16@1+ (1,0) [0|0] "bool" Vector__XXX
 SG_ GD_ID_TA_Auto_Enable_Dual_Status m13854 : 39|1@1+ (1,0) [0|0] "1/0" Vector__XXX
 SG_ GD_ID_TA_Auto_Enable_Dual m13854 : 40|16@1+ (1,0) [0|0] "bool" Vector__XXX
 SG_ GD_ID_TA_Setpoint_A m13855 : 40|16@1+ (1,0) [1800|3900] "mm" Vector__XXX
 SG_ GD_ID_TA_Setpoint_B m13856 : 40|16@1+ (1,0) [1800|3900] "mm" Vector__XXX
 SG_ GD_ID_TA_Setpoint_Dual_Front m13857 : 40|16@1+ (1,0) [1800|3900] "mm" Vector__XXX
 SG_ GD_ID_TA_Setpoint_Dual_Rear m13858 : 40|16@1+ (1,0) [1800|3900] "mm" Vector__XXX
 SG_ GD_ID_TA_Equipped_Status m13864 : 39|1@1+ (1,0) [0|0] "1/0" Vector__XXX
 SG_ GD_ID_TA_Equipped m13864 : 40|16@1+ (1,0) [0|0] "YES/NO" Vector__XXX
 SG_ GD_ID_TA_FL_POSITION m13874 : 40|16@1+ (1,0) [0|2250] "mm" Vector__XXX
 SG_ GD_ID_TA_FR_POSITION m13875 : 40|16@1+ (1,0) [0|2250] "mm" Vector__XXX
 SG_ GD_ID_TA_RL_POSITION m13876 : 40|16@1+ (1,0) [0|2250] "mm" Vector__XXX
 SG_ GD_ID_TA_RR_POSITION m13877 : 40|16@1+ (1,0) [0|2250] "mm" Vector__XXX
 SG_ GD_ID_TA_Setpoint_A_Rear_Status m13878 : 39|1@1+ (1,0) [0|0] "1/0" Vector__XXX
 SG_ GD_ID_TA_Setpoint_A_Rear m13878 : 40|16@1+ (1,0) [1800|3900] "mm" Vector__XXX
 SG_ GD_ID_TA_Setpoint_B_Rear_Status m13879 : 39|1@1+ (1,0) [0|0] "1/0" Vector__XXX
 SG_ GD_ID_TA_Setpoint_B_Rear m13879 : 40|16@1+ (1,0) [1800|3900] "mm" Vector__XXX
 SG_ GD_ID_TA_TARGET_TRACKWIDTH_FL m13880 : 40|16@1+ (1,0) [0|3900] "mm" Vector__XXX
 SG_ GD_ID_TA_TARGET_TRACKWIDTH_FR m13881 : 40|16@1+ (1,0) [0|3900] "mm" Vector__XXX
 SG_ GD_ID_TA_TARGET_TRACKWIDTH_RL m13882 : 40|16@1+ (1,0) [0|3900] "mm" Vector__XXX
 SG_ GD_ID_TA_TARGET_TRACKWIDTH_RR m13883 : 40|16@1+ (1,0) [0|3900] "mm" Vector__XXX
 SG_ GD_ID_TA_ADDITIONAL_WIDTH_FL m13884 : 40|16@1+ (0.1,0) [0|80] "mm" Vector__XXX
 SG_ GD_ID_TA_ADDITIONAL_WIDTH_FR m13885 : 40|16@1+ (0.1,0) [0|80] "mm" Vector__XXX
 SG_ GD_ID_TA_ADDITIONAL_WIDTH_RL m13886 : 40|16@1+ (0.1,0) [0|80] "mm" Vector__XXX
 SG_ GD_ID_TA_ADDITIONAL_WIDTH_RR m13887 : 40|16@1+ (0.1,0) [0|80] "mm" Vector__XXX
 SG_ GD_ID_TA_ErrorManagement_Status m14318 : 39|1@1+ (1,0) [0|0] "1/0" Vector__XXX
 SG_ GD_ID_TA_ErrorManagement m14318 : 40|16@1+ (1,0) [0|255] "" Vector__XXX
 SG_ GD_ID_TA_LifeMessage m14335 : 40|16@1+ (1,0) [0|65535] "ms" Vector__XXX

 SG_ GD_ID_EMM_SIGNAL_LN00_ERROR_W_Status m15872 : 39|1@1+ (1,0) [0|0] "1/0" Vector__XXX
 SG_ GD_ID_EMM_SIGNAL_LN00_ERROR_W m15872 : 40|16@1+ (1,0) [0|255] "" Vector__XXX
 SG_ GD_ID_EMM_SIGNAL_LN01_ERROR_W_Status m15873 : 39|1@1+ (1,0) [0|0] "1/0" Vector__XXX
 SG_ GD_ID_EMM_SIGNAL_LN01_ERROR_W m15873 : 40|16@1+ (1,0) [0|255] "" Vector__XXX
 SG_ GD_ID_EMM_SIGNAL_LN02_ERROR_W_Status m15874 : 39|1@1+ (1,0) [0|0] "1/0" Vector__XXX
 SG_ GD_ID_EMM_SIGNAL_LN02_ERROR_W m15874 : 40|16@1+ (1,0) [0|255] "" Vector__XXX
 SG_ GD_ID_EMM_SIGNAL_LN03_ERROR_W_Status m15875 : 39|1@1+ (1,0) [0|0] "1/0" Vector__XXX
 SG_ GD_ID_EMM_SIGNAL_LN03_ERROR_W m15875 : 40|16@1+ (1,0) [0|255] "" Vector__XXX
 SG_ GD_ID_EMM_SIGNAL_LN04_ERROR_W_Status m15876 : 39|1@1+ (1,0) [0|0] "1/0" Vector__XXX
 SG_ GD_ID_EMM_SIGNAL_LN04_ERROR_W m15876 : 40|16@1+ (1,0) [0|255] "" Vector__XXX
 SG_ GD_ID_EMM_SIGNAL_LN05_ERROR_W_Status m15877 : 39|1@1+ (1,0) [0|0] "1/0" Vector__XXX
 SG_ GD_ID_EMM_SIGNAL_LN05_ERROR_W m15877 : 40|16@1+ (1,0) [0|255] "" Vector__XXX
 SG_ GD_ID_EMM_SIGNAL_LN06_ERROR_W_Status m15878 : 39|1@1+ (1,0) [0|0] "1/0" Vector__XXX
 SG_ GD_ID_EMM_SIGNAL_LN06_ERROR_W m15878 : 40|16@1+ (1,0) [0|255] "" Vector__XXX
 SG_ GD_ID_EMM_SIGNAL_LN07_ERROR_W_Status m15879 : 39|1@1+ (1,0) [0|0] "1/0" Vector__XXX
 SG_ GD_ID_EMM_SIGNAL_LN07_ERROR_W m15879 : 40|16@1+ (1,0) [0|255] "" Vector__XXX
 SG_ GD_ID_EMM_SIGNAL_LN08_ERROR_W_Status m15880 : 39|1@1+ (1,0) [0|0] "1/0" Vector__XXX
 SG_ GD_ID_EMM_SIGNAL_LN08_ERROR_W m15880 : 40|16@1+ (1,0) [0|255] "" Vector__XXX
 SG_ GD_ID_EMM_SIGNAL_LN09_ERROR_W_Status m15881 : 39|1@1+ (1,0) [0|0] "1/0" Vector__XXX
 SG_ GD_ID_EMM_SIGNAL_LN09_ERROR_W m15881 : 40|16@1+ (1,0) [0|255] "" Vector__XXX
 SG_ GD_ID_EMM_SIGNAL_LN10_ERROR_W_Status m15882 : 39|1@1+ (1,0) [0|0] "1/0" Vector__XXX
 SG_ GD_ID_EMM_SIGNAL_LN10_ERROR_W m15882 : 40|16@1+ (1,0) [0|255] "" Vector__XXX
 SG_ GD_ID_EMM_SIGNAL_LN11_ERROR_W_Status m15883 : 39|1@1+ (1,0) [0|0] "1/0" Vector__XXX
 SG_ GD_ID_EMM_SIGNAL_LN11_ERROR_W m15883 : 40|16@1+ (1,0) [0|255] "" Vector__XXX
 SG_ GD_ID_EMM_SIGNAL_LN12_ERROR_W_Status m15884 : 39|1@1+ (1,0) [0|0] "1/0" Vector__XXX
 SG_ GD_ID_EMM_SIGNAL_LN12_ERROR_W m15884 : 40|16@1+ (1,0) [0|255] "" Vector__XXX
 SG_ GD_ID_EMM_SIGNAL_LN13_ERROR_W_Status m15885 : 39|1@1+ (1,0) [0|0] "1/0" Vector__XXX
 SG_ GD_ID_EMM_SIGNAL_LN13_ERROR_W m15885 : 40|16@1+ (1,0) [0|255] "" Vector__XXX
 SG_ GD_ID_EMM_SIGNAL_LN14_ERROR_W_Status m15886 : 39|1@1+ (1,0) [0|0] "1/0" Vector__XXX
 SG_ GD_ID_EMM_SIGNAL_LN14_ERROR_W m15886 : 40|16@1+ (1,0) [0|255] "" Vector__XXX
 SG_ GD_ID_EMM_SIGNAL_LN15_ERROR_W_Status m15887 : 39|1@1+ (1,0) [0|0] "1/0" Vector__XXX
 SG_ GD_ID_EMM_SIGNAL_LN15_ERROR_W m15887 : 40|16@1+ (1,0) [0|255] "" Vector__XXX
 SG_ GD_ID_EMM_SIGNAL_LN16_ERROR_W_Status m15888 : 39|1@1+ (1,0) [0|0] "1/0" Vector__XXX
 SG_ GD_ID_EMM_SIGNAL_LN16_ERROR_W m15888 : 40|16@1+ (1,0) [0|255] "" Vector__XXX
 SG_ GD_ID_EMM_SIGNAL_LN17_ERROR_W_Status m15889 : 39|1@1+ (1,0) [0|0] "1/0" Vector__XXX
 SG_ GD_ID_EMM_SIGNAL_LN17_ERROR_W m15889 : 40|16@1+ (1,0) [0|255] "" Vector__XXX
 SG_ GD_ID_EMM_SIGNAL_LN18_ERROR_W_Status m15890 : 39|1@1+ (1,0) [0|0] "1/0" Vector__XXX
 SG_ GD_ID_EMM_SIGNAL_LN18_ERROR_W m15890 : 40|16@1+ (1,0) [0|255] "" Vector__XXX
 SG_ GD_ID_EMM_SIGNAL_LN19_ERROR_W_Status m15891 : 39|1@1+ (1,0) [0|0] "1/0" Vector__XXX
 SG_ GD_ID_EMM_SIGNAL_LN19_ERROR_W m15891 : 40|16@1+ (1,0) [0|255] "" Vector__XXX
 SG_ GD_ID_EMM_SIGNAL_LN20_ERROR_W_Status m15892 : 39|1@1+ (1,0) [0|0] "1/0" Vector__XXX
 SG_ GD_ID_EMM_SIGNAL_LN20_ERROR_W m15892 : 40|16@1+ (1,0) [0|255] "" Vector__XXX
 SG_ GD_ID_EMM_SIGNAL_LN21_ERROR_W_Status m15893 : 39|1@1+ (1,0) [0|0] "1/0" Vector__XXX
 SG_ GD_ID_EMM_SIGNAL_LN21_ERROR_W m15893 : 40|16@1+ (1,0) [0|255] "" Vector__XXX
 SG_ GD_ID_EMM_SIGNAL_LN22_ERROR_W_Status m15894 : 39|1@1+ (1,0) [0|0] "1/0" Vector__XXX
 SG_ GD_ID_EMM_SIGNAL_LN22_ERROR_W m15894 : 40|16@1+ (1,0) [0|255] "" Vector__XXX
 SG_ GD_ID_EMM_SIGNAL_LN23_ERROR_W_Status m15895 : 39|1@1+ (1,0) [0|0] "1/0" Vector__XXX
 SG_ GD_ID_EMM_SIGNAL_LN23_ERROR_W m15895 : 40|16@1+ (1,0) [0|255] "" Vector__XXX
 SG_ GD_ID_EMM_SIGNAL_LN24_ERROR_W_Status m15896 : 39|1@1+ (1,0) [0|0] "1/0" Vector__XXX
 SG_ GD_ID_EMM_SIGNAL_LN24_ERROR_W m15896 : 40|16@1+ (1,0) [0|255] "" Vector__XXX
 SG_ GD_ID_EMM_SIGNAL_LN25_ERROR_W_Status m15897 : 39|1@1+ (1,0) [0|0] "1/0" Vector__XXX
 SG_ GD_ID_EMM_SIGNAL_LN25_ERROR_W m15897 : 40|16@1+ (1,0) [0|255] "" Vector__XXX
 SG_ GD_ID_EMM_SIGNAL_LN26_ERROR_W_Status m15898 : 39|1@1+ (1,0) [0|0] "1/0" Vector__XXX
 SG_ GD_ID_EMM_SIGNAL_LN26_ERROR_W m15898 : 40|16@1+ (1,0) [0|255] "" Vector__XXX
 SG_ GD_ID_EMM_SIGNAL_LN27_ERROR_W_Status m15899 : 39|1@1+ (1,0) [0|0] "1/0" Vector__XXX
 SG_ GD_ID_EMM_SIGNAL_LN27_ERROR_W m15899 : 40|16@1+ (1,0) [0|255] "" Vector__XXX
 SG_ GD_ID_EMM_SIGNAL_LN28_ERROR_W_Status m15900 : 39|1@1+ (1,0) [0|0] "1/0" Vector__XXX
 SG_ GD_ID_EMM_SIGNAL_LN28_ERROR_W m15900 : 40|16@1+ (1,0) [0|255] "" Vector__XXX
 SG_ GD_ID_EMM_SIGNAL_LN29_ERROR_W_Status m15901 : 39|1@1+ (1,0) [0|0] "1/0" Vector__XXX
 SG_ GD_ID_EMM_SIGNAL_LN29_ERROR_W m15901 : 40|16@1+ (1,0) [0|255] "" Vector__XXX
 SG_ GD_ID_EMM_SIGNAL_LN30_ERROR_W_Status m15902 : 39|1@1+ (1,0) [0|0] "1/0" Vector__XXX
 SG_ GD_ID_EMM_SIGNAL_LN30_ERROR_W m15902 : 40|16@1+ (1,0) [0|255] "" Vector__XXX
 SG_ GD_ID_EMM_SIGNAL_LN31_ERROR_W_Status m15903 : 39|1@1+ (1,0) [0|0] "1/0" Vector__XXX
 SG_ GD_ID_EMM_SIGNAL_LN31_ERROR_W m15903 : 40|16@1+ (1,0) [0|255] "" Vector__XXX
 SG_ GD_ID_EMM_SIGNAL_LN32_ERROR_W_Status m15904 : 39|1@1+ (1,0) [0|0] "1/0" Vector__XXX
 SG_ GD_ID_EMM_SIGNAL_LN32_ERROR_W m15904 : 40|16@1+ (1,0) [0|255] "" Vector__XXX
 SG_ GD_ID_EMM_SIGNAL_LN33_ERROR_W_Status m15905 : 39|1@1+ (1,0) [0|0] "1/0" Vector__XXX
 SG_ GD_ID_EMM_SIGNAL_LN33_ERROR_W m15905 : 40|16@1+ (1,0) [0|255] "" Vector__XXX
 SG_ GD_ID_EMM_SIGNAL_LN34_ERROR_W_Status m15906 : 39|1@1+ (1,0) [0|0] "1/0" Vector__XXX
 SG_ GD_ID_EMM_SIGNAL_LN34_ERROR_W m15906 : 40|16@1+ (1,0) [0|255] "" Vector__XXX
 SG_ GD_ID_EMM_SIGNAL_LN35_ERROR_W_Status m15907 : 39|1@1+ (1,0) [0|0] "1/0" Vector__XXX
 SG_ GD_ID_EMM_SIGNAL_LN35_ERROR_W m15907 : 40|16@1+ (1,0) [0|255] "" Vector__XXX
 SG_ GD_ID_EMM_SIGNAL_LN36_ERROR_W_Status m15908 : 39|1@1+ (1,0) [0|0] "1/0" Vector__XXX
 SG_ GD_ID_EMM_SIGNAL_LN36_ERROR_W m15908 : 40|16@1+ (1,0) [0|255] "" Vector__XXX
 SG_ GD_ID_EMM_SIGNAL_LN37_ERROR_W_Status m15909 : 39|1@1+ (1,0) [0|0] "1/0" Vector__XXX
 SG_ GD_ID_EMM_SIGNAL_LN37_ERROR_W m15909 : 40|16@1+ (1,0) [0|255] "" Vector__XXX
 SG_ GD_ID_EMM_SIGNAL_LN38_ERROR_W_Status m15910 : 39|1@1+ (1,0) [0|0] "1/0" Vector__XXX
 SG_ GD_ID_EMM_SIGNAL_LN38_ERROR_W m15910 : 40|16@1+ (1,0) [0|255] "" Vector__XXX
 SG_ GD_ID_EMM_SIGNAL_LN39_ERROR_W_Status m15911 : 39|1@1+ (1,0) [0|0] "1/0" Vector__XXX
 SG_ GD_ID_EMM_SIGNAL_LN39_ERROR_W m15911 : 40|16@1+ (1,0) [0|255] "" Vector__XXX
 SG_ GD_ID_EMM_SIGNAL_LN40_ERROR_W_Status m15912 : 39|1@1+ (1,0) [0|0] "1/0" Vector__XXX
 SG_ GD_ID_EMM_SIGNAL_LN40_ERROR_W m15912 : 40|16@1+ (1,0) [0|255] "" Vector__XXX
 SG_ GD_ID_EMM_SIGNAL_LN41_ERROR_W_Status m15913 : 39|1@1+ (1,0) [0|0] "1/0" Vector__XXX
 SG_ GD_ID_EMM_SIGNAL_LN41_ERROR_W m15913 : 40|16@1+ (1,0) [0|255] "" Vector__XXX
 SG_ GD_ID_EMM_SIGNAL_LN42_ERROR_W_Status m15914 : 39|1@1+ (1,0) [0|0] "1/0" Vector__XXX
 SG_ GD_ID_EMM_SIGNAL_LN42_ERROR_W m15914 : 40|16@1+ (1,0) [0|255] "" Vector__XXX
 SG_ GD_ID_EMM_SIGNAL_LN43_ERROR_W_Status m15915 : 39|1@1+ (1,0) [0|0] "1/0" Vector__XXX
 SG_ GD_ID_EMM_SIGNAL_LN43_ERROR_W m15915 : 40|16@1+ (1,0) [0|255] "" Vector__XXX
 SG_ GD_ID_EMM_SIGNAL_LN44_ERROR_W_Status m15916 : 39|1@1+ (1,0) [0|0] "1/0" Vector__XXX
 SG_ GD_ID_EMM_SIGNAL_LN44_ERROR_W m15916 : 40|16@1+ (1,0) [0|255] "" Vector__XXX
 SG_ GD_ID_EMM_SIGNAL_LN45_ERROR_W_Status m15917 : 39|1@1+ (1,0) [0|0] "1/0" Vector__XXX
 SG_ GD_ID_EMM_SIGNAL_LN45_ERROR_W m15917 : 40|16@1+ (1,0) [0|255] "" Vector__XXX
 SG_ GD_ID_EMM_SIGNAL_LN46_ERROR_W_Status m15918 : 39|1@1+ (1,0) [0|0] "1/0" Vector__XXX
 SG_ GD_ID_EMM_SIGNAL_LN46_ERROR_W m15918 : 40|16@1+ (1,0) [0|255] "" Vector__XXX
 SG_ GD_ID_EMM_SIGNAL_LN47_ERROR_W_Status m15919 : 39|1@1+ (1,0) [0|0] "1/0" Vector__XXX
 SG_ GD_ID_EMM_SIGNAL_LN47_ERROR_W m15919 : 40|16@1+ (1,0) [0|255] "" Vector__XXX
 SG_ GD_ID_EMM_SIGNAL_LN48_ERROR_W_Status m15920 : 39|1@1+ (1,0) [0|0] "1/0" Vector__XXX

BA_DEF_ BO_  "VFrameFormat" ENUM  "StandardCAN","ExtendedCAN","reserved","J1939PG";
BA_DEF_DEF_  "VFrameFormat" "J1939PG";
VAL_ 1557 GD_ID_DRIVE_SV_STATE 0 "OFF" 1 "SV 1 selected" 2 "SV 1 active" 3 "SV 2 selected" 4 "SV 2 active"  ;
VAL_ 1557 GD_ID_DRIVE_ROGATOR_MACHINE_CONFIGURATION 0 "RG900" 1 "RG1100" 2 "RG1300" 3 "RG1300 Rear Torque"  ;
VAL_ 1557 GD_ID_DRIVE_FIELD_STREET_STATE 0 "Field" 1 "Street" 2 "Street Tank Limit"  ;
VAL_ 1557 GD_ID_DRIVE_STATE 0 "Neutral" 1 "Forward" 2 "Reverse"  ;
VAL_ 1557 GD_ID_DRIVE_OPERATION_MODE 1 "Normal Operation" 2 "Limited Mode 1" 4 "Limited Mode 2" 8 "Limited Mode 3" 16 "Limited Mode 4" 32 "Stop Mode 1" 64 "Stop Mode 2"  ;
VAL_ 1557 GD_ID_DRIVE_CURRENT_GEAR 251 "Park" 125 "Neutral" 126 "Forward" 124 "Reverse"  ;
VAL_ 1557 GD_ID_DRIVE_SELECTED_GEAR 251 "Park" 125 "Neutral" 126 "Forward" 124 "Reverse"  ;
VAL_ 1557 GD_ID_DRIVE_BRAKE_PEDAL_CAL_COMMAND 52224 "Start" 52225 "Proceed From Step1" 52226 "Proceed From Step2" 52227 "Accept" 56576 "Abort " 60928 "Decline"  ;
VAL_ 1557 GD_ID_DRIVE_BRAKE_PEDAL_CAL_STATE 1 "Step1 - Push Pedal" 2 "Step2 - Release Pedal" 3 "Confirm" 0 "Calibration Finished" 65281 "Error - Pedal Down" 65282 "Error - Pedal Up" 65280 "Calibration Error"  ;
VAL_ 1557 GD_ID_DRIVE_WHEEL_SPEED_CALIBRATION_COMMAND 52224 "Start" 52225 "Proceed From Step1" 52226 "Proceed From Step2" 52227 "Proceed From Step3" 52228 "Accept-Proceed From Step4" 60928 "Decline-Proceed From Step4" 56576 "Abort"  ;
VAL_ 1557 GD_ID_DRIVE_WHEEL_SPEED_CALIBRATION_STATE 1 "Step1 - Begin Calib" 2 "Step2 - Start Position" 3 "Step3 - End Position" 4 "Step4 - User AcceptOrDeny" 0 "Calibration Finished" 65280 "Calibration Error"  ;
VAL_ 1557 GD_ID_DRIVE_RADAR_CALIBRATION_COMMAND 52224 "Start" 52225 "Proceed from Step 1" 52226 "Accept-Proceed From Step2" 60928 "Decline-Proceed From Step2" 56576 "Abort"  ;
VAL_ 1557 GD_ID_DRIVE_RADAR_CALIBRATION_STATE 1 "Step1 - End Position" 2 "Step2 - User AcceptOrDeny" 0 "Calibration Finished" 65280 "Calibration Error"  ;
VAL_ 1557 GD_ID_DRIVE_COMBO_CALIBRATION_COMMAND 52224 "Start" 52225 "Proceed From Step1" 52226 "Proceed From Step2" 52227 "Proceed From Step3" 52228 "Accept-Proceed From Step4" 60928 "Decline-Proceed From Step4" 56576 "Abort"  ;
VAL_ 1557 GD_ID_DRIVE_COMBO_CALIBRATION_STATE 1 "Step1 - Begin Calib" 2 "Step2 - Start Position" 3 "Step3 - End Position" 4 "Step4 - User AcceptOrDeny" 0 "Calibration Finished" 65280 "Calibration Error"  ;
VAL_ 1557 GD_ID_DRIVE_DANFOSS_IN_SV_STATE_COMMANDED_Status 0 "OFF" 1 "ON"  ;
VAL_ 1557 GD_ID_DRIVE_DANFOSS_OUT_SV_STATE_ACTUAL_Status 0 "OFF" 1 "ON"  ;
VAL_ 1557 GD_ID_DRIVE_DANFOSS_OUT_DRIVE_MODE_ACTUAL_Status 0 "Lever" 1 "Pedal"  ;
VAL_ 1557 GD_ID_DRIVE_DANFOSS_IN_DRIVE_MODE_COMMANDED_Status 0 "Lever" 1 "Pedal"  ;
VAL_ 1557 GD_ID_DRIVE_DANFOSS_OUT_PARKBRK_REQUEST_Status 0 "Release" 1 "Apply"  ;
VAL_ 1557 GD_ID_DRIVE_DANFOSS_OUT_CCO_VALVE_REQUEST_Status 0 "Release" 1 "Apply"  ;
VAL_ 1557 GD_ID_DRIVE_CCO_VALVE_COMMAND_Status 0 "Low" 1 "High"  ;
VAL_ 1557 GD_ID_DRIVE_CARGO_OVER_WEIGHT_Status 0 "Low" 1 "High"  ;
VAL_ 1557 GD_ID_DRIVE_BRAKE_LIGHT_COMMAND_Status 0 "OFF" 1 "ON"  ;
VAL_ 1557 GD_ID_DRIVE_PARKBRAKE_COMMAND_Status 0 "Low" 1 "High"  ;
VAL_ 1557 GD_ID_DRIVE_DASH_DISPLAYED_PARK_BRAKE_LED_Status 0 "OFF" 1 "ON"  ;
VAL_ 1557 GD_ID_DRIVE_RESET_DEFAULT_PROFILES_Status 0 "" 1 "Reset Profiles"  ;
VAL_ 1557 PlausibilityCheck 1 "ERROR - Plausibility" 0 "No Plausibility Error" ;
VAL_ 1557 ErrorId 6 "ERROR - Unspecified" 5 "Short to VBatt/Line Interrupt" 4 "Short to Ground/Line Interrupt" 3 "Line Interruption" 2 "Short Circuit to VBatt" 1 "Short Circuit to Ground" 0 "No Directly Diagnosable Error" ;
VAL_ 1557 CanError 1 "ERROR - GD CAN Communication" 0 "No GD CAN Communication Error" ;
VAL_ 1557 CalErrorState 1 "ERROR - Calibration" 0 "No Calibration Error" ;
VAL_ 1557 LowerHysteresis 255 "VALUE NOT PERMITTED" 254 "VALUE NOT PERMITTED" 253 "VALUE NOT PERMITTED" 252 "VALUE NOT PERMITTED" 251 "VALUE NOT PERMITTED" 250 "VALUE NOT PERMITTED" 249 "VALUE NOT PERMITTED" 248 "VALUE NOT PERMITTED" 247 "VALUE NOT PERMITTED" 246 "VALUE NOT PERMITTED" 245 "VALUE NOT PERMITTED" 244 "VALUE NOT PERMITTED" 243 "VALUE NOT PERMITTED" 242 "VALUE NOT PERMITTED" 241 "VALUE NOT PERMITTED" 240 "VALUE NOT PERMITTED" 239 "VALUE NOT PERMITTED" 238 "VALUE NOT PERMITTED" 237 "VALUE NOT PERMITTED" 236 "VALUE NOT PERMITTED" 235 "VALUE NOT PERMITTED" 234 "VALUE NOT PERMITTED" 233 "VALUE NOT PERMITTED" 232 "VALUE NOT PERMITTED" 231 "VALUE NOT PERMITTED" 230 "VALUE NOT PERMITTED" 229 "VALUE NOT PERMITTED" 228 "VALUE NOT PERMITTED" 227 "VALUE NOT PERMITTED" 226 "VALUE NOT PERMITTED" 225 "VALUE NOT PERMITTED" 224 "VALUE NOT PERMITTED" 223 "VALUE NOT PERMITTED" 222 "VALUE NOT PERMITTED" 221 "VALUE NOT PERMITTED" 220 "VALUE NOT PERMITTED" 219 "VALUE NOT PERMITTED" 218 "VALUE NOT PERMITTED" 217 "VALUE NOT PERMITTED" 216 "VALUE NOT PERMITTED" 215 "VALUE NOT PERMITTED" 214 "VALUE NOT PERMITTED" 213 "VALUE NOT PERMITTED" 212 "VALUE NOT PERMITTED" 211 "VALUE NOT PERMITTED" 210 "VALUE NOT PERMITTED" 209 "VALUE NOT PERMITTED" 208 "VALUE NOT PERMITTED" 207 "VALUE NOT PERMITTED" 206 "VALUE NOT PERMITTED" 205 "VALUE NOT PERMITTED" 204 "VALUE NOT PERMITTED" 203 "VALUE NOT PERMITTED" 202 "VALUE NOT PERMITTED" 201 "VALUE NOT PERMITTED" 200 "100 %" 199 "99 %" 198 "98 %" 197 "97 %" 196 "96 %" 195 "95 %" 194 "94 %" 193 "93 %" 192 "92 %" 191 "91 %" 190 "90 %" 189 "89 %" 188 "88 %" 187 "87 %" 186 "86 %" 185 "85 %" 184 "84 %" 183 "83 %" 182 "82 %" 181 "81 %" 180 "80 %" 179 "79 %" 178 "78 %" 177 "77 %" 176 "76 %" 175 "75 %" 174 "74 %" 173 "73 %" 172 "72 %" 171 "71 %" 170 "70 %" 169 "69 %" 168 "68 %" 167 "67 %" 166 "66 %" 165 "65 %" 164 "64 %" 163 "63 %" 162 "62 %" 161 "61 %" 160 "60 %" 159 "59 %" 158 "58 %" 157 "57 %" 156 "56 %" 155 "55 %" 154 "54 %" 153 "53 %" 152 "52 %" 151 "51 %" 150 "50 %" 149 "49 %" 148 "48 %" 147 "47 %" 146 "46 %" 145 "45 %" 144 "44 %" 143 "43 %" 142 "42 %" 141 "41 %" 140 "40 %" 139 "39 %" 138 "38 %" 137 "37 %" 136 "36 %" 135 "35 %" 134 "34 %" 133 "33 %" 132 "32 %" 131 "31 %" 130 "30 %" 129 "29 %" 128 "28 %" 127 "27 %" 126 "26 %" 125 "25 %" 124 "24 %" 123 "23 %" 122 "22 %" 121 "21 %" 120 "20 %" 119 "19 %" 118 "18 %" 117 "17 %" 116 "16 %" 115 "15 %" 114 "14 %" 113 "13 %" 112 "12 %" 111 "11 %" 110 "10 %" 109 "VALUE NOT PERMITTED" 108 "VALUE NOT PERMITTED" 107 "VALUE NOT PERMITTED" 106 "VALUE NOT PERMITTED" 105 "VALUE NOT PERMITTED" 104 "VALUE NOT PERMITTED" 103 "VALUE NOT PERMITTED" 102 "VALUE NOT PERMITTED" 101 "VALUE NOT PERMITTED" 100 "VALUE NOT PERMITTED" 99 "9.9 %" 98 "9.8 %" 97 "9.7 %" 96 "9.6 %" 95 "9.5 %" 94 "9.4 %" 93 "9.3 %" 92 "9.2 %" 91 "9.1 %" 90 "  9 %" 89 "8.9 %" 88 "8.8 %" 87 "8.7 %" 86 "8.6 %" 85 "8.5 %" 84 "8.4 %" 83 "8.3 %" 82 "8.2 %" 81 "8.1 %" 80 "  8 %" 79 "7.9 %" 78 "7.8 %" 77 "7.7 %" 76 "7.6 %" 75 "7.5 %" 74 "7.4 %" 73 "7.3 %" 72 "7.2 %" 71 "7.1 %" 70 "  7 %" 69 "6.9 %" 68 "6.8%" 67 "6.7 %" 66 "6.6 %" 65 "6.5 %" 64 "6.4 %" 63 "6.3 %" 62 "6.2 %" 61 "6.1 %" 60 "  6 %" 59 "5.9 %" 58 "5.8 %" 57 "5.7 %" 56 "5.6 %" 55 "5.5 %" 54 "5.4 %" 53 "5.3 %" 52 "5.2 %" 51 "5.1 %" 50 "  5 %" 49 "4.9 %" 48 "4.8 %" 47 "4.7 %" 46 "4.6 %" 45 "4.5 %" 44 "4.4 %" 43 "4.3 %" 42 "4.2 %" 41 "4.1 %" 40 "  4 %" 39 "3.9 %" 38 "3.8 %" 37 "3.7 %" 36 "3.6 %" 35 "3.5 %" 34 "3.4 %" 33 "3.3 %" 32 "3.2 %" 31 "3.1 %" 30 "  3 %" 29 "2.9 %" 28 "2.8 %" 27 "2.7 %" 26 "2.6 %" 25 "2.5 %" 24 "2.4 %" 23 "2.3 %" 22 "2.2 %" 21 "2.1 %" 20 "  2 %" 19 "1.9 %" 18 "1.8 %" 17 "1.7 %" 16 "1.6 %" 15 "1.5 %" 14 "1.4 %" 13 "1.3 %" 12 "1.2 %" 11 "1.1 %" 10 "  1 %" 9 "0.9 %" 8 "0.8 %" 7 "0.7 %" 6 "0.6 %" 5 "0.5 %" 4 "0.4 %" 3 "0.3 %" 2 "0.2 %" 1 "0.1 %" 0 "  0 %" ;
VAL_ 1557 SendInfoTcrr 255 "Every  32s" 254 "Every  32s" 253 "Every  32s" 252 "Every  32s" 251 "Every  32s" 250 "Every  32s" 249 "Every  32s" 248 "Every  32s" 247 "Every  32s" 246 "Every  32s" 245 "Every  32s" 244 "Every  32s" 243 "Every  32s" 242 "Every  32s" 241 "Every  32s" 240 "Every  32s" 239 "Every  32s" 238 "Every  32s" 237 "Every  32s" 236 "Every  32s" 235 "Every  32s" 234 "Every  32s" 233 "Every  32s" 232 "Every  32s" 231 "Every  32s" 230 "Every  32s" 229 "Every  32s" 228 "Every  32s" 227 "Every  32s" 226 "Every  32s" 225 "Every  32s" 224 "Every  32s" 223 "Every  32s" 222 "Every  32s" 221 "Every  32s" 220 "Every  32s" 219 "Every  32s" 218 "Every  32s" 217 "Every  32s" 216 "Every  32s" 215 "Every  32s" 214 "Every  32s" 213 "Every  32s" 212 "Every  32s" 211 "Every  32s" 210 "Every  32s" 209 "Every  32s" 208 "Every  32s" 207 "Every  32s" 206 "Every  32s" 205 "Every  32s" 204 "Every  32s" 203 "Every  32s" 202 "Every  32s" 201 "Every  32s" 200 "Every  32s" 199 "Every  32s" 198 "Every  32s" 197 "Every  32s" 196 "Every  32s" 195 "Every  32s" 194 "Every  32s" 193 "Every  32s" 192 "Every  32s" 191 "Every  32s" 190 "Every  32s" 189 "Every  32s" 188 "Every  32s" 187 "Every  32s" 186 "Every  32s" 185 "Every  32s" 184 "Every  32s" 183 "Every  32s" 182 "Every  32s" 181 "Every  32s" 180 "Every  32s" 179 "Every  32s" 178 "Every  32s" 177 "Every  32s" 176 "Every  32s" 175 "Every  32s" 174 "Every  32s" 173 "Every  32s" 172 "Every  32s" 171 "Every  32s" 170 "Every  32s" 169 "Every  32s" 168 "Every  32s" 167 "Every  32s" 166 "Every  32s" 165 "Every  32s" 164 "Every  32s" 163 "Every  32s" 162 "Every  32s" 161 "Every  32s" 160 "Every  32s" 159 "Every  32s" 158 "Every  32s" 157 "Every  32s" 156 "Every  32s" 155 "Every  32s" 154 "Every  32s" 153 "Every  32s" 152 "Every  32s" 151 "Every  32s" 150 "Every  32s" 149 "Every  32s" 148 "Every  32s" 147 "Every  32s" 146 "Every  32s" 145 "Every  32s" 144 "Every  32s" 143 "Every  32s" 142 "Every  32s" 141 "Every  32s" 140 "Every  32s" 139 "Every  32s" 138 "Every  32s" 137 "Every  32s" 136 "Every  32s" 135 "Every  32s" 134 "Every  32s" 133 "Every  32s" 132 "Every  32s" 131 "Every  31s" 130 "Every  30s" 129 "Every  29s" 128 "Every  28s" 127 "Every  27s" 126 "Every  26s" 125 "Every  25s" 124 "Every  24s" 123 "Every  23s" 122 "Every  22s" 121 "Every  21s" 120 "Every  20s" 119 "Every  19s" 118 "Every  18s" 117 "Every  17s" 116 "Every  16s" 115 "Every  15s" 114 "Every  14s" 113 "Every  13s" 112 "Every  12s" 111 "Every  11s" 110 "Every  10s" 109 "Every   9s" 108 "Every   8s" 107 "Every   7s" 106 "Every   6s" 105 "Every   5s" 104 "Every   4s" 103 "Every   3s" 102 "Every   2s" 101 "Every   1s" 100 "Every1000ms" 99 "Every 990ms" 98 "Every 980ms" 97 "Every 970ms" 96 "Every 960ms" 95 "Every 950ms" 94 "Every 940ms" 93 "Every 930ms" 92 "Every 920ms" 91 "Every 910ms" 90 "Every 900ms" 89 "Every 890ms" 88 "Every 880ms" 87 "Every 870ms" 86 "Every 860ms" 85 "Every 850ms" 84 "Every 840ms" 83 "Every 830ms" 82 "Every 820ms" 81 "Every 810ms" 80 "Every 800ms" 79 "Every 790ms" 78 "Every 780ms" 77 "Every 770ms" 76 "Every 760ms" 75 "Every 750ms" 74 "Every 740ms" 73 "Every 730ms" 72 "Every 720ms" 71 "Every 710ms" 70 "Every 700ms" 69 "Every 690ms" 68 "Every 680ms" 67 "Every 670ms" 66 "Every 660ms" 65 "Every 650ms" 64 "Every 640ms" 63 "Every 630ms" 62 "Every 620ms" 61 "Every 610ms" 60 "Every 600ms" 59 "Every 590ms" 58 "Every 580ms" 57 "Every 570ms" 56 "Every 560ms" 55 "Every 550ms" 54 "Every 540ms" 53 "Every 530ms" 52 "Every 520ms" 51 "Every 510ms" 50 "Every 500ms" 49 "Every 490ms" 48 "Every 480ms" 47 "Every 470ms" 46 "Every 460ms" 45 "Every 450ms" 44 "Every 440ms" 43 "Every 430ms" 42 "Every 420ms" 41 "Every 410ms" 40 "Every 400ms" 39 "Every 390ms" 38 "Every 380ms" 37 "Every 370ms" 36 "Every 360ms" 35 "Every 350ms" 34 "Every 340ms" 33 "Every 330ms" 32 "Every 320ms" 31 "Every 310ms" 30 "Every 300ms" 29 "Every 290ms" 28 "Every 280ms" 27 "Every 270ms" 26 "Every 260ms" 25 "Every 250ms" 24 "Every 240ms" 23 "Every 230ms" 22 "Every 220ms" 21 "Every 210ms" 20 "Every 200ms" 19 "Every 190ms" 18 "Every 180ms" 17 "Every 170ms" 16 "Every 160ms" 15 "Every 1 50ms" 14 "Every 140ms" 13 "Every 130ms" 12 "Every 120ms" 11 "Every 110ms" 10 "Every 100ms" 9 "Every  90ms" 8 "Every  80ms" 7 "Every  70ms" 6 "Every  60ms" 5 "Every  50ms" 4 "Every  40ms" 3 "Every  30ms" 2 "Every  20ms" 1 "Every  10ms" 0 "Every   5ms";VAL_ 1557 SendInfoEcrr 255 "Wait Time = 25.5s" 254 "Wait Time = 25.4s" 253 "Wait Time = 25.3s" 252 "Wait Time = 25.2s" 251 "Wait Time = 25.1s" 250 "Wait Time =   25s" 249 "Wait Time = 24.9s" 248 "Wait Time = 24.8s" 247 "Wait Time = 24.7s" 246 "Wait Time = 24.6s" 245 "Wait Time = 24.5s" 244 "Wait Time = 24.4s" 243 "Wait Time = 24.3s" 242 "Wait Time = 24.2s" 241 "Wait Time = 24.1s" 240 "Wait Time =   24s" 239 "Wait Time = 23.9s" 238 "Wait Time = 23.8s" 237 "Wait Time = 23.7s" 236 "Wait Time = 23.6s" 235 "Wait Time = 23.5s" 234 "Wait Time = 23.4s" 233 "Wait Time = 23.3s" 232 "Wait Time = 23.2s" 231 "Wait Time = 23.1s" 230 "Wait Time =   23s" 229 "Wait Time = 22.9s" 228 "Wait Time = 22.8s" 227 "Wait Time = 22.7s" 226 "Wait Time = 22.6s" 225 "Wait Time = 22.5s" 224 "Wait Time = 22.4s" 223 "Wait Time = 22.3s" 222 "Wait Time = 22.2s" 221 "Wait Time = 22.1s" 220 "Wait Time =   22s" 219 "Wait Time = 21.9s" 218 "Wait Time = 21.8s" 217 "Wait Time = 21.7s" 216 "Wait Time = 21.6s" 215 "Wait Time = 21.5s" 214 "Wait Time = 21.4s" 213 "Wait Time = 21.3s" 212 "Wait Time = 21.2s" 211 "Wait Time = 21.1s" 210 "Wait Time =   21s" 209 "Wait Time = 20.9s" 208 "Wait Time = 20.8s" 207 "Wait Time = 20.7s" 206 "Wait Time = 20.6s" 205 "Wait Time = 20.5s" 204 "Wait Time = 20.4s" 203 "Wait Time = 20.3s" 202 "Wait Time = 20.2s" 201 "Wait Time = 20.1s" 200 "Wait Time =   20s" 199 "Wait Time = 19.9s" 198 "Wait Time = 19.8s" 197 "Wait Time = 19.7s" 196 "Wait Time = 19.6s" 195 "Wait Time = 19.5s" 194 "Wait Time = 19.4s" 193 "Wait Time = 19.3s" 192 "Wait Time = 19.2s" 191 "Wait Time = 19.1s" 190 "Wait Time =   19s" 189 "Wait Time = 18.9s" 188 "Wait Time = 18.8s" 187 "Wait Time = 18.7s" 186 "Wait Time = 18.6s" 185 "Wait Time = 18.5s" 184 "Wait Time = 18.4s" 183 "Wait Time = 18.3s" 182 "Wait Time = 18.2s" 181 "Wait Time = 18.1s" 180 "Wait Time =   18s" 179 "Wait Time = 17.9s" 178 "Wait Time = 17.8s" 177 "Wait Time = 17.7s" 176 "Wait Time = 17.6s" 175 "Wait Time = 17.5s" 174 "Wait Time = 17.4s" 173 "Wait Time = 17.3s" 172 "Wait Time = 17.2s" 171 "Wait Time = 17.1s" 170 "Wait Time =   17s" 169 "Wait Time = 16.9s" 168 "Wait Time = 16.8s" 167 "Wait Time = 16.7s" 166 "Wait Time = 16.6s" 165 "Wait Time = 16.5s" 164 "Wait Time = 16.4s" 163 "Wait Time = 16.3s" 162 "Wait Time = 16.2s" 161 "Wait Time = 16.1s" 160 "Wait Time =   16s" 159 "Wait Time = 15.9s" 158 "Wait Time = 15.8s" 157 "Wait Time = 15.7s" 156 "Wait Time = 15.6s" 155 "Wait Time = 15.5s" 154 "Wait Time = 15.4s" 153 "Wait Time = 15.3s" 152 "Wait Time = 15.2s" 151 "Wait Time = 15.1s" 150 "Wait Time =   15s" 149 "Wait Time = 14.9s" 148 "Wait Time = 14.8s" 147 "Wait Time = 14.7s" 146 "Wait Time = 14.6s" 145 "Wait Time = 14.5s" 144 "Wait Time = 14.4s" 143 "Wait Time = 14.3s" 142 "Wait Time = 14.2s" 141 "Wait Time = 14.1s" 140 "Wait Time =   14s" 139 "Wait Time = 13.9s" 138 "Wait Time = 13.8s" 137 "Wait Time = 13.7s" 136 "Wait Time = 13.6s" 135 "Wait Time = 13.5s" 134 "Wait Time = 13.4s" 133 "Wait Time = 13.3s" 132 "Wait Time = 13.2s" 131 "Wait Time = 13.1s" 130 "Wait Time =   13s" 129 "Wait Time = 12.9s" 128 "Wait Time = 12.8s" 127 "Wait Time = 12.7s" 126 "Wait Time = 12.6s" 125 "Wait Time = 12.5s" 124 "Wait Time = 12.4s" 123 "Wait Time = 12.3s" 122 "Wait Time = 12.2s"121 "Wait Time = 12.1s" 120 "Wait Time =   12s" 119 "Wait Time = 11.9s" 118 "Wait Time = 11.8s" 117 "Wait Time = 11.7s" 116 "Wait Time = 11.6s" 115 "Wait Time = 11.5s" 114 "Wait Time = 11.4s" 113 "Wait Time = 11.3s" 112 "Wait Time = 11.2s" 111 "Wait Time = 11.1s" 110 "Wait Time =  11s" 109 "Wait Time = 10.9s" 108 "Wait Time = 10.8s" 107 "Wait Time = 10.7s" 106 "Wait Time = 10.6s" 105 "Wait Time = 10.5s" 104 "Wait Time = 10.4s" 103 "Wait Time = 10.3s" 102 "Wait Time = 10.2s" 101 "Wait Time = 10.1s" 100 "Wait Time =  10s" 99 "Wait Time = 9.9s" 98 "Wait Time = 9.8s" 97 "Wait Time = 9.7s" 96 "Wait Time = 9.6s" 95 "Wait Time = 9.5s" 94 "Wait Time = 9.4s" 93 "Wait Time = 9.3s" 92 "Wait Time = 9.2s" 91 "Wait Time = 9.1s" 90 "Wait Time =   9s" 89 "Wait Time = 8.9s" 88 "Wait Time = 8.8s" 87 "Wait Time = 8.7s" 86 "Wait Time = 8.6s" 85 "Wait Time = 8.5s" 84 "Wait Time = 8.4s" 83 "Wait Time = 8.3s" 82 "Wait Time = 8.2s" 81 "Wait Time = 8.1s" 80 "Wait Time =   8s" 79 "Wait Time = 7.9s" 78 "Wait Time = 7.8s" 77 "Wait Time = 7.7s" 76 "Wait Time = 7.6s" 75 "Wait Time = 7.5s" 74 "Wait Time = 7.4s" 73 "Wait Time = 7.3s" 72 "Wait Time = 7.2s" 71 "Wait Time = 7.1s" 70 "Wait Time =   7s" 69 "Wait Time = 6.9s" 68 "Wait Time = 6.8s" 67 "Wait Time = 6.7s" 66 "Wait Time = 6.6s" 65 "Wait Time = 6.5s" 64 "Wait Time = 6.4s" 63 "Wait Time = 6.3s" 62 "Wait Time = 6.2s" 61 "Wait Time = 6.1s" 60 "Wait Time =   6s" 59 "Wait Time = 5.9s" 58 "Wait Time = 5.8s" 57 "Wait Time = 5.7s" 56 "Wait Time = 5.6s" 55 "Wait Time = 5.5s" 54 "Wait Time = 5.4s" 53 "Wait Time = 5.3s" 52 "Wait Time = 5.2s" 51 "Wait Time = 5.1s" 50 "Wait Time =   5s" 49 "Wait Time = 4.9s" 48 "Wait Time = 4.8s" 47 "Wait Time = 4.7s" 46 "Wait Time = 4.6s" 45 "Wait Time = 4.5s" 44 "Wait Time = 4.4s" 43 "Wait Time = 4.3s" 42 "Wait Time = 4.2s" 41 "Wait Time = 4.1s" 40 "Wait Time =   4s" 39 "Wait Time = 3.9s" 38 "Wait Time = 3.8s" 37 "Wait Time = 3.7s" 36 "Wait Time = 3.6s" 35 "Wait Time = 3.5s" 34 "Wait Time = 3.4s" 33 "Wait Time = 3.3s" 32 "Wait Time = 3.2s" 31 "Wait Time = 3.1s" 30 "Wait Time =   3s" 29 "Wait Time = 2.9s" 28 "Wait Time = 2.8s" 27 "Wait Time = 2.7s" 26 "Wait Time = 2.6s" 25 "Wait Time = 2.5s" 24 "Wait Time = 2.4s" 23 "Wait Time = 2.3s" 22 "Wait Time = 2.2s" 21 "Wait Time = 2.1s" 20 "Wait Time =   2s" 19 "Wait Time = 1.9s" 18 "Wait Time = 1.8s" 17 "Wait Time = 1.7s" 16 "Wait Time = 1.6s" 15 "Wait Time = 1.5s" 14 "Wait Time = 1.4s" 13 "Wait Time = 1.3s" 12 "Wait Time = 1.2s" 11 "Wait Time = 1.1s" 10 "Wait Time =   1s" 9 "Wait Time = 900ms" 8 "Wait Time = 800ms" 7 "Wait Time = 700ms" 6 "Wait Time = 600ms" 5 "Wait Time = 500ms" 4 "Wait Time = 400ms" 3 "Wait Time = 300ms" 2 "Wait Time = 200ms" 1 "Wait Time = 100ms" 0 "On Change" ;VAL_ 1557 ServiceType 501 "System Alive" 481 "System Logon" 427 "Imm. Write once" 423 "Imm. Write once w handshake" 422 "Imm. Write Handshake" 415 "Request TCRR" 414 "Response TCRR" 407 "Request ECRR w handshake" 406 "Response ECRR w handshake" 405 "Request ECRR wo hs" 404 "Response ECRR wo hs" 395 "Request SRR wo hs" 394 "Response SRR wo hs" 391 "Request srr w hs" 390 "Response srr w hs" 385 "Abort " 359 "Handshake srr w hs" 375 "Handshake ECRR w handshake" 511 "System Logoff" 509 "Broadcast Message" 399 "Block Transfer Request" 430 "Block Transfer Read Data" 431 "Block Transfer Write Data" 398 "Block Transfer Control/Acknowledge";VAL_ 1557 RequestType 0 "Read" 1 "Write"  ;VAL_ 1557 ControlType 44 "Read Control Message" 172 "Write Control Message" 45 "Read Acknowledge Message" ;VAL_ 1557 ControlOrErrorCode 0 "TRANSER_COMPLETED" 1 "TRANSFER_PARTIAL_COMPLETED" 2 "TRANSFER_ABORTED" 3 "TRANSFER_TIMEOUT" 4 "TRANFER_REPEAT_DATA" 6 "TRANSFER_WRONG_LENGTH" ;VAL_ 1557 RecieverNodeNumber 0 "Dash" 1 "AGCO Connectivity Module" 2 "NT01" 3 "MFA" 4 "" 5 "Chassis" 6 "NOT ASSIGNED" 7 "Light Control Panel" 8 "NOT ASSIGNED" 9 "NOT ASSIGNED" 10 "NOT ASSIGNED" 11 "NOT ASSIGNED" 12 "Diagnostics" 13 "VarioDoc" 14 "NOT ASSIGNED" 15 "Central Electric" ;
VAL_ 1557 RecieverBusNumber 0 "NOT ASSIGNED" 1 "Main GD Bus" 2 "NOT ASSIGNED" 3 "NOT ASSIGNED" 4 "NOT ASSIGNED" 5 "NOT ASSIGNED" 6 "NOT ASSIGNED" 7 "NOT ASSIGNED" 8 "NOT ASSIGNED" 9 "NOT ASSIGNED" 10 "NOT ASSIGNED" 11 "NOT ASSIGNED" 12 "NOT ASSIGNED" 13 "NOT ASSIGNED" 14 "NOT ASSIGNED" 15 "Global" ;
VAL_ 1557 GD_ID_SCT_STATUSDISPLAY_TERMINAL 0 "SCT_OFF" 1 "SCT_PREACTIVE" 2 "SCT_ACTIVE"  ;
VAL_ 1557 GD_ID_SCT_TURNING_OFF_REASON 0 "SCT_CHANGE_STATE_REASON_NONE" 1 "SCT_CHANGE_STATE_REASON_USER_OVERRIDE" 2 "SCT_CHANGE_STATE_REASON_BUTTON_ASSISTED_STEERING_PRESSED" 3 "SCT_CHANGE_STATE_REASON_BUTTON_AUTO_STEERING_PRESSED" 4 "SCT_CHANGE_STATE_REASON_OPERATOR_PRESENCE" 5 "SCT_CHANGE_STATE_REASON_EXTERNAL_ACCESS" 6 "SCT_CHANGE_STATE_REASON_ERROR_REGARDING_EXTERNAL_ACCESS" 7 "SCT_CHANGE_STATE_REASON_SAFE_STATE_REGARDING_EXTERNAL_ACCESS" 8 "SCT_CHANGE_STATE_REASON_BSAC_DEACTIVATION" 9 "SCT_CHANGE_STATE_REASON_BSAC_NOT_AVAILABLE" 10 "SCT_CHANGE_STATE_REASON_BSAC_TIMEOUT" 11 "SCT_CHANGE_STATE_REASON_SPEED_LIMIT" 12 "SCT_CHANGE_STATE_REASON_SPEED_ERROR" 13 "SCT_CHANGE_STATE_REASON_IGNITION_OFF" 14 "SCT_CHANGE_STATE_REASON_ENGINE_NOT_RUNNING" 15 "SCT_CHANGE_STATE_REASON_SWS_STEERING_VALVE_CALIBRATION_ERROR" 16 "SCT_CHANGE_STATE_REASON_EMERGENCY_OPERATION" 17 "SCT_CHANGE_STATE_REASON_ERROR_MFA" 18 "SCT_CHANGE_STATE_REASON_ERROR_OPERATOR_PRESENCE" 19 "SCT_CHANGE_STATE_REASON_STEERING_WHEEL_CUT_OFF_VALVE" 20 "SCT_CHANGE_STATE_REASON_ERROR_PILOT_PRESSURE_VALVE" 21 "SCT_CHANGE_STATE_REASON_ERROR_WAS" 22 "SCT_CHANGE_STATE_REASON_ERROR_SWS" 23 "SCT_CHANGE_STATE_REASON_ERROR_PVED" 24 "SCT_CHANGE_STATE_REASON_ERROR_PVED_NEUTRAL" 25 "SCT_CHANGE_STATE_REASON_PLAUSI_ASSISTANCE_STEERING" 26 "SCT_CHANGE_STATE_REASON_PLAUSI_AUTOMATIC_STEERING" 27 "SCT_CHANGE_STATE_REASON_SYSTEM_ERROR" 28 "SCT_CHANGE_STATE_REASON_MULTI_ERRORS" 29 "SCT_CHANGE_STATE_REASON_WAS_CALIBRATION" 30 "SCT_CHANGE_STATE_REASON_SWITCH_TO_OFF_REQUEST" 31 "SCT_CHANGE_STATE_REASON_SWITCH_TO_ON_REQUEST"  ;
VAL_ 1557 GD_ID_SCT_VOTED_ACTIVE_CLASS_1 0 "feature deactivated" 1 "Superimposed steering"  ;
VAL_ 1557 GD_ID_SCT_VOTED_ACTIVE_CLASS_2 0 "feature deactivated" 1 "GNSS Guidance" 2 "Feeler Guidance" 3 "TIM"  ;
VAL_ 1557 GD_ID_SCT_WAS_CALIB_COMMAND 0 "Start command" 1 "Start calibration wheel angle sensor" 2 "Turn max left and confirm" 3 "Turn max right and confirm" 4 "Turn straight and confirm" 254 "Calibration successful"  ;
VAL_ 1557 GD_ID_SCT_WAS_CALIB_STATUS 0 "Startkommando" 1 "Start calibration wheel angle sensor" 2 "Turn max left and confirm" 3 "Turn max right and confirm" 4 "Turn straight and confirm" 254 "Calibration successful"  ;
VAL_ 1557 GD_ID_SCT_VALVE_CALIB_COMMAND 0 "Start command" 1 "Start calibration steering valve" 2 "Automatic turn left" 3 "Automatic turn right" 254 "Calibration successful"  ;
VAL_ 1557 GD_ID_SCT_VALVE_CALIB_STATUS 0 "Start command" 1 "Start calibration steering valve" 2 "Automatic turn left" 3 "Automatic turn right" 254 "Calibration successful"  ;
VAL_ 1557 GD_ID_SCT_STEERING_MODE 0 "Front-Wheel (all except Three-Wheeler)" 1 "Front-Wheel (Three-Wheeler)" 2 "Rear-Wheel" 3 "Differential" 4 "Articulated" 5 "Four-Wheel" 6 "Auto-Coordinated 4-Wheel Steering" 7 "Dog-Walk" 8 "Crab Steering"  ;
VAL_ 1557 GD_ID_SCT_ADDITIONAL_WORKING_HEIGHT 0 "Inactive" 1 "Active"  ;
VAL_ 1557 GD_ID_SCT_ISO_STATE 0 "NMEA2000 Messages on ISOBus Prohibited" 1 "NMEA2000 Messages on ISOBUS Allowed"  ;
VAL_ 1557 GD_ID_SCT_CONTROL_MSG_TERMINAL 0 "No Message" 1 "New Data Available" 2 "Factory Reset"  ;
VAL_ 1557 GD_ID_SCT_CONTROL_MSG_GUIDEANCE 0 "No Message" 1 "New Data Available"  ;
VAL_ 1557 GD_ID_SCT_TI_SUB_STATE 0 "DISABLE" 1 "TI_INIT" 2 "RECORD_STANDBY" 3 "RECORD_ACTIVE" 4 "PLAY_STANDBY" 5 "PLAY_ACTIVE" 6 "CONFIG" 7 "EDIT" 8 "DATAXCHANGE" 240 "SAFESTATE" 255 "NO_SUBSTATEWXL"  ;
VAL_ 1557 GD_ID_SCT_SETPOINT_Status 0 "Not Active" 1 "Active"  ;
VAL_ 1557 GD_ID_SCT_SETPOINT_FEELER_GUIDANCE_Status 0 "Not Active" 1 "Active"  ;
VAL_ 1557 GD_ID_SCT_SETPOINT_CURVATURE_Status 0 "Not Active" 1 "Active"  ;
VAL_ 1557 GD_ID_SCT_SETPOINT_CURVATURE_TIM_Status 0 "Not Active" 1 "Active"  ;
VAL_ 1557 GD_ID_SCT_SETPOINT_CURVATURE_FEELER_GUIDANCE_Status 0 "Not Active" 1 "Active"  ;
VAL_ 1557 GD_ID_SCT_SWS_RAW_VALUE_Status 0 "Reverse Station Mode OFF" 1 "Reverse Station Mode ON"  ;
VAL_ 1557 GD_ID_SCT_SWS_LIMITED_ANGLE_Status 0 "NO Steering Intervention" 1 "Steering Intervention"  ;
VAL_ 1557 GD_ID_SCT_SWS_CONTINUED_ANGLE_Status 0 "NO Steering Intervention" 1 "Steering Intervention"  ;
VAL_ 1557 GD_ID_SCT_PILOTVALVE_STATUS_Status 0 "Valve State - Not Active" 1 "Valve State - Active"  ;
VAL_ 1557 GD_ID_SCT_GUIDANCE_CONFIGURATION_DATA_Status 0 "CEAGuideVersion" 1 "CEAGuideVersion"  ;
VAL_ 1557 GD_ID_SCT_STEERING_MODE_Status 0 "Steering Mode NOT Variable" 1 "Steering Mode Variable"  ;
VAL_ 1557 GD_ID_SCT_SECONDARY_WAS_RAW_VALUE_Status 0 "Secondary WAS Is NOT Present" 1 "Secondary WAS Is Present"  ;
VAL_ 1557 GD_ID_SCT_SECONDARY_WAS_SENSOR_ANGLE_Status 0 "Secondary WAS Is NOT Present" 1 "Secondary WAS Is Present"  ;
VAL_ 1557 GD_ID_SCT_SECONDARY_WAS_MEDIAN_ANGLE_Status 0 "Secondary WAS Is NOT Present" 1 "Secondary WAS Is Present"  ;
VAL_ 1557 GD_ID_SCT_SECONDARY_WAS_MEDIAN_ANGLE_MAX_Status 0 "Secondary WAS Is NOT Present" 1 "Secondary WAS Is Present"  ;
VAL_ 1557 GD_ID_SCT_ALS_X_OFFSET_Status 0 "Inactive" 1 "Active"  ;
VAL_ 1557 GD_ID_SCT_ALS_Y_OFFSET_Status 0 "Inactive" 1 "Active"  ;
VAL_ 1557 GD_ID_SCT_VEHICLE_CURRENT_PAYLOAD_Status 0 "Can NOT Carry Payload" 1 "Can Carry Payload"  ;
VAL_ 1557 GD_ID_SCT_VEHICLE_SPEED_Status 0 "Reverse" 1 "Forward"  ;
VAL_ 1557 GD_ID_SCT_VEHICLE_MOVEMENT_Status 0 "Moved" 1 "NOT Moved"  ;
VAL_ 1557 GD_ID_SCT_PARKING_BRAKE_Status 0 "Inactive" 0 "Active"  ;
VAL_ 1557 GD_ID_SCT_ERROR_ACKNOWLEDGE_Status 0 "Not Acknowledged" 1 "Acknowledged"  ;
VAL_ 1557 GD_ID_SCT_SAFETY_VERSION_Status 0 "First safety concept for MOD X900 for homologation of the EHL/EHPF in 2006" 1 " - Inclusion of superimposed steering  - Operation concept modification (omission of state StandBy; as a result of superimposed steering)  - Omission of the cut-off valve (as a result of the usage of the OSPE steering valve this functionality is now realised by the pilot pressure valve) - Plausibility check of steering wheel sensor (SWS) and wheel angle sensor (WAS)"  ;
VAL_ 1557 GD_ID_Alt_Low_Idle 0 "OFF" 1 "ON (Alternative selection 1)"  ;
VAL_ 1557 GD_ID_Engine_Operating_State 0 "Engine Stopped" 1 "Pre-Start" 2 "Starting" 3 "Warm-Up" 4 "Running" 5 "Cool-down" 6 "Engine Stopping" 7 "Post-Run" 15 "Not available"  ;
VAL_ 1557 GD_ID_WBZ_MACHINE_SELECTED_SOURCE 0 "Wheel" 1 "Radar" 2 "GPS" 7 "Not Avaliable"  ;
VAL_ 1557 GD_ID_WBZ_TERMINAL_PAGE_SIZE 0 "DoNothing" 1 "QuarterScreen" 2 "HalfScreen" 3 "FullScreen"  ;
VAL_ 1557 GD_ID_WBZ_ENG_DEF_LVL_LAMP 0 "Flash" 1 "Solid"  ;
VAL_ 1557 GD_ID_WBZ_ENG_DEF_MIL_LAMP 0 "Flash" 1 "Solid"  ;
VAL_ 1557 GD_ID_WBZ_AUXIO1_01_FI02 0 "Btn released" 1 "Btn pressed" 2 "Error" 3 "Not Available"  ;
VAL_ 1557 GD_ID_WBZ_AUXIO1_02_FI02 0 "Btn released" 1 "Btn pressed" 2 "Error" 3 "Not Available"  ;
VAL_ 1557 GD_ID_WBZ_AUXIO1_03_FI02 0 "Btn released" 1 "Btn pressed" 2 "Error" 3 "Not Available"  ;
VAL_ 1557 GD_ID_WBZ_AUXIO1_04_FI02 0 "Btn released" 1 "Btn pressed" 2 "Error" 3 "Not Available"  ;
VAL_ 1557 GD_ID_WBZ_AUXIO1_05_FI02 0 "Btn released" 1 "Btn pressed" 2 "Error" 3 "Not Available"  ;
VAL_ 1557 GD_ID_WBZ_AUXIO1_06_FI02 0 "Btn released" 1 "Btn pressed" 2 "Error" 3 "Not Available"  ;
VAL_ 1557 GD_ID_WBZ_AUXIO1_07_FI02 0 "Btn released" 1 "Btn pressed" 2 "Error" 3 "Not Available"  ;
VAL_ 1557 GD_ID_WBZ_AUXIO1_08_FI02 0 "Btn released" 1 "Btn pressed" 2 "Error" 3 "Not Available"  ;
VAL_ 1557 GD_ID_WBZ_AUXIO1_09_FI02 0 "Btn released" 1 "Btn pressed" 2 "Error" 3 "Not Available"  ;
VAL_ 1557 GD_ID_WBZ_AUXIO1_10_FI02 0 "Btn released" 1 "Btn pressed" 2 "Error" 3 "Not Available"  ;
VAL_ 1557 GD_ID_WBZ_AUXIO1_11_FI02 0 "Btn released" 1 "Btn pressed" 2 "Error" 3 "Not Available"  ;
VAL_ 1557 GD_ID_WBZ_AUXIO1_12_FI02 0 "Btn released" 1 "Btn pressed" 2 "Error" 3 "Not Available"  ;
VAL_ 1557 GD_ID_WBZ_AUXIO2_17_FI02 0 "LED off" 1 "LED on" 2 "Error" 3 "Not Available"  ;
VAL_ 1557 GD_ID_WBZ_AUXIO2_18_FI02 0 "LED off" 1 "LED on" 2 "Error" 3 "Not Available"  ;
VAL_ 1557 GD_ID_WBZ_AUXIO1_01_FI00 0 "Btn released" 1 "Btn pressed" 2 "Error" 3 "Not Available"  ;
VAL_ 1557 GD_ID_WBZ_AUXIO1_02_FI00 0 "Btn released" 1 "Btn pressed" 2 "Error" 3 "Not Available"  ;
VAL_ 1557 GD_ID_WBZ_AUXIO1_03_FI00 0 "Btn released" 1 "Btn pressed" 2 "Error" 3 "Not Available"  ;
VAL_ 1557 GD_ID_WBZ_AUXIO1_04_FI00 0 "Btn released" 1 "Btn pressed" 2 "Error" 3 "Not Available"  ;
VAL_ 1557 GD_ID_WBZ_AUXIO1_05_FI00 0 "Btn released" 1 "Btn pressed" 2 "Error" 3 "Not Available"  ;
VAL_ 1557 GD_ID_WBZ_AUXIO1_06_FI00 0 "Btn released" 1 "Btn pressed" 2 "Error" 3 "Not Available"  ;
VAL_ 1557 GD_ID_WBZ_AUXIO1_07_FI00 0 "Btn released" 1 "Btn pressed" 2 "Error" 3 "Not Available"  ;
VAL_ 1557 GD_ID_WBZ_AUXIO1_08_FI00 0 "Btn released" 1 "Btn pressed" 2 "Error" 3 "Not Available"  ;
VAL_ 1557 GD_ID_WBZ_AUXIO1_09_FI00 0 "Btn released" 1 "Btn pressed" 2 "Error" 3 "Not Available"  ;
VAL_ 1557 GD_ID_WBZ_AUXIO1_10_FI00 0 "Btn released" 1 "Btn pressed" 2 "Error" 3 "Not Available"  ;
VAL_ 1557 GD_ID_WBZ_AUXIO1_11_FI00 0 "Btn released" 1 "Btn pressed" 2 "Error" 3 "Not Available"  ;
VAL_ 1557 GD_ID_WBZ_AUXIO1_12_FI00 0 "Btn released" 1 "Btn pressed" 2 "Error" 3 "Not Available"  ;
VAL_ 1557 GD_ID_WBZ_AUXIO1_13_FI00 0 "Btn released" 1 "Btn pressed" 2 "Error" 3 "Not Available"  ;
VAL_ 1557 GD_ID_WBZ_AUXIO1_14_FI00 0 "Btn released" 1 "Btn pressed" 2 "Error" 3 "Not Available"  ;
VAL_ 1557 GD_ID_WBZ_AUXIO1_15_FI00 0 "Btn released" 1 "Btn pressed" 2 "Error" 3 "Not Available"  ;
VAL_ 1557 GD_ID_WBZ_AUXIO1_16_FI00 0 "Btn released" 1 "Btn pressed" 2 "Error" 3 "Not Available"  ;
VAL_ 1557 GD_ID_WBZ_AUXIO2_17_FI00 0 "OFF" 1 "ON" 2 "Error" 3 "Not Available"  ;
VAL_ 1557 GD_ID_WBZ_AUXIO2_18_FI00 0 "OFF" 1 "ON" 2 "Error" 3 "Not Available"  ;
VAL_ 1557 GD_ID_WBZ_AUXIO2_21_FI00 0 "OFF" 1 "ON" 2 "Error" 3 "Not Available"  ;
VAL_ 1557 GD_ID_WBZ_AUXIO2_22_FI00 0 "OFF" 1 "ON" 2 "Error" 3 "Not Available"  ;
VAL_ 1557 GD_ID_WBZ_AUXIO2_26_FI00 0 "OFF" 1 "ON" 2 "Error" 3 "Not Available"  ;
VAL_ 1557 GD_ID_WBZ_AUXIO2_27_FI00 0 "OFF" 1 "ON" 2 "Error" 3 "Not Available"  ;
VAL_ 1557 GD_ID_WBZ_AUXIO2_28_FI00 0 "OFF" 1 "ON" 2 "Error" 3 "Not Available"  ;
VAL_ 1557 GD_ID_WBZ_AUXIO2_29_FI00 0 "OFF" 1 "ON" 2 "Error" 3 "Not Available"  ;
VAL_ 1557 GD_ID_WBZ_AUXIO2_30_FI00 0 "OFF" 1 "ON" 2 "Error" 3 "Not Available"  ;
VAL_ 1557 GD_ID_WBZ_AUXIO2_31_FI00 0 "OFF" 1 "ON" 2 "Error" 3 "Not Available"  ;
VAL_ 1557 GD_ID_WBZ_AUXIO2_32_FI00 0 "OFF" 1 "ON" 2 "Error" 3 "Not Available"  ;
VAL_ 1557 GD_ID_WBZ_AUXIO1_01_FI01 0 "Btn released" 1 "Btn pressed" 2 "Error" 3 "Not Available"  ;
VAL_ 1557 GD_ID_WBZ_AUXIO1_02_FI01 0 "Btn released" 1 "Btn pressed" 2 "Error" 3 "Not Available"  ;
VAL_ 1557 GD_ID_WBZ_AUXIO1_03_FI01 0 "Btn released" 1 "Btn pressed" 2 "Error" 3 "Not Available"  ;
VAL_ 1557 GD_ID_WBZ_AUXIO1_04_FI01 0 "Btn released" 1 "Btn pressed" 2 "Error" 3 "Not Available"  ;
VAL_ 1557 GD_ID_WBZ_AUXIO1_05_FI01 0 "Btn released" 1 "Btn pressed" 2 "Error" 3 "Not Available"  ;
VAL_ 1557 GD_ID_WBZ_AUXIO1_06_FI01 0 "Btn released" 1 "Btn pressed" 2 "Error" 3 "Not Available"  ;
VAL_ 1557 GD_ID_WBZ_AUXIO1_07_FI01 0 "Btn released" 1 "Btn pressed" 2 "Error" 3 "Not Available"  ;
VAL_ 1557 GD_ID_WBZ_AUXIO1_08_FI01 0 "Btn released" 1 "Btn pressed" 2 "Error" 3 "Not Available"  ;
VAL_ 1557 GD_ID_WBZ_AUXIO1_09_FI01 0 "Btn released" 1 "Btn pressed" 2 "Error" 3 "Not Available"  ;
VAL_ 1557 GD_ID_WBZ_AUXIO1_10_FI01 0 "Btn released" 1 "Btn pressed" 2 "Error" 3 "Not Available"  ;
VAL_ 1557 GD_ID_WBZ_AUXIO1_11_FI01 0 "Btn released" 1 "Btn pressed" 2 "Error" 3 "Not Available"  ;
VAL_ 1557 GD_ID_WBZ_AUXIO1_12_FI01 0 "Btn released" 1 "Btn pressed" 2 "Error" 3 "Not Available"  ;
VAL_ 1557 GD_ID_WBZ_AUXIO1_13_FI01 0 "Btn released" 1 "Btn pressed" 2 "Error" 3 "Not Available"  ;
VAL_ 1557 GD_ID_WBZ_AUXIO1_14_FI01 0 "Btn released" 1 "Btn pressed" 2 "Error" 3 "Not Available"  ;
VAL_ 1557 GD_ID_WBZ_AUXIO1_15_FI01 0 "Btn released" 1 "Btn pressed" 2 "Error" 3 "Not Available"  ;
VAL_ 1557 GD_ID_WBZ_AUXIO1_16_FI01 0 "Btn released" 1 "Btn pressed" 2 "Error" 3 "Not Available"  ;
VAL_ 1557 GD_ID_WBZ_AUXIO2_17_FI01 0 "OFF" 1 "ON" 2 "Error" 3 "Not Available"  ;
VAL_ 1557 GD_ID_WBZ_AUXIO2_18_FI01 0 "OFF" 1 "ON" 2 "Error" 3 "Not Available"  ;
VAL_ 1557 GD_ID_WBZ_AUXIO2_21_FI01 0 "OFF" 1 "ON" 2 "Error" 3 "Not Available"  ;
VAL_ 1557 GD_ID_WBZ_AUXIO2_22_FI01 0 "OFF" 1 "ON" 2 "Error" 3 "Not Available"  ;
VAL_ 1557 GD_ID_WBZ_AUXIO2_26_FI01 0 "OFF" 1 "ON" 2 "Error" 3 "Not Available"  ;
VAL_ 1557 GD_ID_WBZ_AUXIO2_27_FI01 0 "OFF" 1 "ON" 2 "Error" 3 "Not Available"  ;
VAL_ 1557 GD_ID_WBZ_AUXIO2_28_FI01 0 "OFF" 1 "ON" 2 "Error" 3 "Not Available"  ;
VAL_ 1557 GD_ID_WBZ_AUXIO2_29_FI01 0 "OFF" 1 "ON" 2 "Error" 3 "Not Available"  ;
VAL_ 1557 GD_ID_WBZ_AUXIO2_30_FI01 0 "OFF" 1 "ON" 2 "Error" 3 "Not Available"  ;
VAL_ 1557 GD_ID_WBZ_AUXIO2_31_FI01 0 "OFF" 1 "ON" 2 "Error" 3 "Not Available"  ;
VAL_ 1557 GD_ID_WBZ_AUXIO2_32_FI01 0 "OFF" 1 "ON" 2 "Error" 3 "Not Available"  ;
VAL_ 1557 GD_ID_WBZ_AUXIO2_21_FI02 0 "OFF" 1 "ON" 2 "Error" 3 "Not Available"  ;
VAL_ 1557 GD_ID_WBZ_AUXIO2_22_FI02 0 "OFF" 1 "ON" 2 "Error" 3 "Not Available"  ;
VAL_ 1557 GD_ID_WBZ_DPF_WARNING_LAMP 0 "solid" 1 "flash"  ;
VAL_ 1557 GD_ID_WBZ_DPF_STATI 0 "No heat mode" 1 "Heat mode 1" 2 "Heat mode 2" 3 "Active regeneration needed" 4 "Power derating 1" 5 "Power derating 2" 8 "Regeneration Succesful" 16 "Precondition active"  ;
VAL_ 1557 GD_ID_WBZ_DPF_INHIBITED_STATI 0 "Not Inhibited" 1 "Engine operation state not reached" 2 "Coolant temperature not reached" 8 "Parking brake not applied" 64 "Not in standstill" 32768 "Regeneration activatable"  ;
VAL_ 1557 GD_ID_WBZ_DPF_CONTROL_REGEN 1 "Start" 2 "Cancel"  ;
VAL_ 1557 GD_ID_Engine_Standing_Still_Status 0 "Running" 1 "Still"  ;
VAL_ 1557 GD_ID_Engine_Oil_Pressure_Low_Status 0 "pressure is okay" 1 "pressure is too low"  ;
VAL_ 1557 GD_ID_Engine_Oil_Service_Interval_Status 0 "interval is okay" 1 "interval is exceeded"  ;
VAL_ 1557 GD_ID_Water_In_Fuel_Status 0 "No" 1 "Yes"  ;
VAL_ 1557 GD_ID_WBZ_ENG_DEF_LVL_LAMP_Status 0 "Off" 1 "On"  ;
VAL_ 1557 GD_ID_WBZ_ENG_DEF_MIL_LAMP_Status 0 "Off" 1 "On"  ;
VAL_ 1557 GD_ID_WBZ_THIRD_PARTY_MANUS_Status 0 "NA" 1 "Active"  ;
VAL_ 1557 GD_ID_WBZ_NEW_LEADER_ACL_Status 0 "Missing" 1 "Present"  ;
VAL_ 1557 GD_ID_WBZ_DPF_WARNING_LAMP_Status 0 "OFF" 1 "ON"  ;
VAL_ 1557 GD_ID_WBZ_DPF_HEST_LAMP_Status 0 "OFF" 1 "ON"  ;
VAL_ 1557 GD_ID_TA_Calibration_Command 52224 "Start" 52225 "Proceed From Step1" 52226 "Proceed From Step2" 52227 "Proceed From Step3" 52228 "Accept-Proceed From Step4" 60928 "Decline-Proceed From Step4" 56576 "Abort"  ;
VAL_ 1557 GD_ID_TA_Calibration_State 1 "Step1 - Begin Calib" 2 "Step2 - Min Track" 3 "Step3 - Max Track" 4 "Step4 - User AcceptOrDeny" 0 "Calibration Finished" 65280 "Calibration Error"  ;
VAL_ 1557 GD_ID_TA_Operation_State 0 "Manual" 1 "AutoA" 2 "AutoB" 3 "AutoDual" 4 "Transition"  ;
VAL_ 1557 GD_ID_TA_Operation_State_Status 0 "active" 1 "idle"  ;
VAL_ 1557 DataIndex 1024 "GD_ID_NT01_Date_Year" 1025 "GD_ID_NT01_Date_Month" 1026 "GD_ID_NT01_Date_Day" 1027 "GD_ID_NT01_Date_WeekDay" 1028 "GD_ID_NT01_Time_Hours" 1029 "GD_ID_NT01_Time_Minutes" 1030 "GD_ID_NT01_Time_Seconds" 1045 "GD_ID_NT01_MainBoardTemp" 1056 "GD_ID_NT01_LightSensor_Status" 1056 "GD_ID_NT01_LightSensor" 1281 "GD_ID_NT01_Software_Version" 1282 "GD_ID_NT01_Software_Revision" 1283 "GD_ID_NT01_Build_Date_Day_Month" 1284 "GD_ID_NT01_Build_Date_Year" 1285 "GD_ID_NT01_Build_Time_Hrs_Min" 1286 "GD_ID_NT01_Build_Time_Seconds" 1036 "GD_ID_Time_Seconds" 1037 "GD_ID_Time_Hours_Minutes" 1038 "GD_ID_Date_Month_Day" 1039 "GD_ID_Date_Year" 1518 "GD_ID_NT01_ErrorManagement_Status" 1518 "GD_ID_NT01_ErrorManagement" 1535 "GD_ID_NT01_LifeMessage" 1536 "GD_ID_MFA_A19_Status" 1536 "GD_ID_MFA_A19" 1544 "GD_ID_MFA_A11_Status" 1544 "GD_ID_MFA_A11" 1545 "GD_ID_MFA_A11_LED" 1546 "GD_ID_MFA_A12_Status" 1546 "GD_ID_MFA_A12" 1547 "GD_ID_MFA_A12_LED" 1548 "GD_ID_MFA_A13_Status" 1548 "GD_ID_MFA_A13" 1549 "GD_ID_MFA_A13_LED" 1550 "GD_ID_MFA_A14_Status" 1550 "GD_ID_MFA_A14" 1551 "GD_ID_MFA_A14_LED" 1562 "GD_ID_MFA_A1_Status" 1562 "GD_ID_MFA_A1" 1563 "GD_ID_MFA_A2_Status" 1563 "GD_ID_MFA_A2" 1568 "GD_ID_MFA_A10_Status" 1568 "GD_ID_MFA_A10" 1569 "GD_ID_MFA_A8_Status" 1569 "GD_ID_MFA_A8" 1570 "GD_ID_MFA_A7_Status" 1570 "GD_ID_MFA_A7" 1571 "GD_ID_MFA_A24_Status" 1571 "GD_ID_MFA_A24" 1572 "GD_ID_MFA_A9_Status" 1572 "GD_ID_MFA_A9" 1573 "GD_ID_MFA_A26_Status" 1573 "GD_ID_MFA_A26" 1574 "GD_ID_MFA_A17_Status" 1574 "GD_ID_MFA_A17" 1575 "GD_ID_MFA_A18_Status" 1575 "GD_ID_MFA_A18" 1576 "GD_ID_MFA_A15_Status" 1576 "GD_ID_MFA_A15" 1577 "GD_ID_MFA_A16_Status" 1577 "GD_ID_MFA_A16" 1578 "GD_ID_MFA_A3_Status" 1578 "GD_ID_MFA_A3" 1579 "GD_ID_MFA_A20_Status" 1579 "GD_ID_MFA_A20" 1580 "GD_ID_MFA_A5_Status" 1580 "GD_ID_MFA_A5" 1581 "GD_ID_MFA_A22_Status" 1581 "GD_ID_MFA_A22" 1582 "GD_ID_MFA_A4_Status" 1582 "GD_ID_MFA_A4" 1583 "GD_ID_MFA_A6_Status" 1583 "GD_ID_MFA_A6" 1584 "GD_ID_MFA_E1_Status" 1584 "GD_ID_MFA_E1" 1585 "GD_ID_MFA_E2_Status" 1585 "GD_ID_MFA_E2" 1586 "GD_ID_MFA_E3_Status" 1586 "GD_ID_MFA_E3" 1587 "GD_ID_MFA_E4_Status" 1587 "GD_ID_MFA_E4" 1590 "GD_ID_MFA_ZONE_D_ROCKER_1" 1591 "GD_ID_MFA_ZONE_D_LED_ROCKER_1" 1592 "GD_ID_MFA_ZONE_D_ROCKER_2" 1593 "GD_ID_MFA_ZONE_D_LED_ROCKER_2" 1594 "GD_ID_MFA_ZONE_D_ROCKER_3" 1595 "GD_ID_MFA_ZONE_D_LED_ROCKER_3" 1596 "GD_ID_MFA_ZONE_D_ROCKER_4" 1597 "GD_ID_MFA_ZONE_D_LED_ROCKER_4" 1598 "GD_ID_MFA_ZONE_D_ROCKER_5" 1599 "GD_ID_MFA_ZONE_D_LED_ROCKER_5" 1600 "GD_ID_MFA_B1_Status" 1600 "GD_ID_MFA_B1" 1601 "GD_ID_MFA_F1_Status" 1601 "GD_ID_MFA_F1" 1632 "GD_ID_MFA_C17_Status" 1632 "GD_ID_MFA_C17" 1633 "GD_ID_MFA_C17_LED" 1634 "GD_ID_MFA_C18_Status" 1634 "GD_ID_MFA_C18" 1635 "GD_ID_MFA_C18_LED" 1636 "GD_ID_MFA_C9_Status" 1636 "GD_ID_MFA_C9" 1637 "GD_ID_MFA_C9_LED" 1638 "GD_ID_MFA_C10_Status" 1638 "GD_ID_MFA_C10" 1639 "GD_ID_MFA_C10_LED" 1640 "GD_ID_MFA_C1_Status" 1640 "GD_ID_MFA_C1" 1641 "GD_ID_MFA_C1_LED" 1642 "GD_ID_MFA_C2_Status" 1642 "GD_ID_MFA_C2" 1643 "GD_ID_MFA_C2_LED" 1644 "GD_ID_MFA_ZONE_D_BUTTON_LEFT_INSIDE_Status" 1644 "GD_ID_MFA_ZONE_D_BUTTON_LEFT_INSIDE" 1645 "GD_ID_MFA_ZONE_D_LED_LEFT_INSIDE" 1646 "GD_ID_MFA_ZONE_D_BUTTON_LEFT_OUTSIDE_Status" 1646 "GD_ID_MFA_ZONE_D_BUTTON_LEFT_OUTSIDE" 1647 "GD_ID_MFA_ZONE_D_LED_LEFT_OUTSIDE" 1648 "GD_ID_MFA_C19_Status" 1648 "GD_ID_MFA_C19" 1649 "GD_ID_MFA_C19_LED" 1650 "GD_ID_MFA_C20_Status" 1650 "GD_ID_MFA_C20" 1651 "GD_ID_MFA_C20_LED" 1652 "GD_ID_MFA_C11_Status" 1652 "GD_ID_MFA_C11" 1653 "GD_ID_MFA_C11_LED" 1654 "GD_ID_MFA_C12_Status" 1654 "GD_ID_MFA_C12" 1655 "GD_ID_MFA_C12_LED" 1656 "GD_ID_MFA_C3_Status" 1656 "GD_ID_MFA_C3" 1657 "GD_ID_MFA_C3_LED" 1658 "GD_ID_MFA_C4_Status" 1658 "GD_ID_MFA_C4" 1659 "GD_ID_MFA_C4_LED" 1660 "GD_ID_MFA_ZONE_D_BUTTON_RIGHT_INSIDE_Status" 1660 "GD_ID_MFA_ZONE_D_BUTTON_RIGHT_INSIDE" 1661 "GD_ID_MFA_ZONE_D_LED_RIGHT_INSIDE" 1662 "GD_ID_MFA_ZONE_D_BUTTON_RIGHT_OUTSIDE_Status" 1662 "GD_ID_MFA_ZONE_D_BUTTON_RIGHT_OUTSIDE" 1663 "GD_ID_MFA_ZONE_D_LED_RIGHT_OUTSIDE" 1664 "GD_ID_MFA_C21_Status" 1664 "GD_ID_MFA_C21" 1665 "GD_ID_MFA_C21_LED" 1666 "GD_ID_MFA_C22_Status" 1666 "GD_ID_MFA_C22" 1667 "GD_ID_MFA_C22_LED" 1668 "GD_ID_MFA_C13_Status" 1668 "GD_ID_MFA_C13" 1669 "GD_ID_MFA_C13_LED" 1670 "GD_ID_MFA_C14_Status" 1670 "GD_ID_MFA_C14" 1671 "GD_ID_MFA_C14_LED" 1672 "GD_ID_MFA_C5_Status" 1672 "GD_ID_MFA_C5" 1673 "GD_ID_MFA_C5_LED" 1674 "GD_ID_MFA_C6_Status" 1674 "GD_ID_MFA_C6" 1675 "GD_ID_MFA_C6_LED" 1680 "GD_ID_MFA_C23_Status" 1680 "GD_ID_MFA_C23" 1681 "GD_ID_MFA_C23_LED" 1682 "GD_ID_MFA_C24_Status" 1682 "GD_ID_MFA_C24" 1683 "GD_ID_MFA_C24_LED" 1684 "GD_ID_MFA_C15_Status" 1684 "GD_ID_MFA_C15" 1685 "GD_ID_MFA_C15_LED" 1686 "GD_ID_MFA_C16_Status" 1686 "GD_ID_MFA_C16" 1687 "GD_ID_MFA_C16_LED" 1688 "GD_ID_MFA_C7_Status" 1688 "GD_ID_MFA_C7" 1689 "GD_ID_MFA_C7_LED" 1690 "GD_ID_MFA_C8_Status" 1690 "GD_ID_MFA_C8" 1691 "GD_ID_MFA_C8_LED" 1696 "GD_ID_MFA_FunctionLighting" 1697 "GD_ID_MFA_NightDesign" 1736 "GD_ID_MFA_Throttle_CalibCmd" 1737 "GD_ID_MFA_Throttle_CalibState" 1738 "GD_ID_MFA_UNKNOWN_Calibration_Cmd" 1739 "GD_ID_MFA_UNKNOWN_Calibration_Status" 1740 "GD_ID_LM1_CalibrationCommand" 1741 "GD_ID_LM1_CalibrationStatus" 1742 "GD_ID_MFA_Lever_CalibCmd" 1743 "GD_ID_MFA_Lever_CalibState" 1744 "GD_ID_LM3_CalibrationCommand" 1745 "GD_ID_LM3_CalibrationStatus" 1746 "GD_ID_LM4_CalibrationCommand" 1747 "GD_ID_LM4_CalibrationStatus" 2030 "GD_ID_MFA_ErrorManagement_Status" 2030 "GD_ID_MFA_ErrorManagement" 2032 "GD_ID_HwConfigMFA" 2033 "GD_ID_IdentificationModule" 2036 "GD_ID_MFA_SoftwareVersion" 2037 "GD_ID_SwVersionAJS" 2040 "GD_ID_SerialNumber1st" 2041 "GD_ID_SerialNumber2nd" 2047 "GD_ID_MFA_LifeMessage" 2049 "GD_ID_DRIVE_AIR_PRESSURE" 2050 "GD_ID_DRIVE_HYDRAULICS_ENABLE_Status" 2050 "GD_ID_DRIVE_HYDRAULICS_ENABLE" 2051 "GD_ID_DRIVE_REQUEST_HYD_ENABLE_OFF_Status" 2051 "GD_ID_DRIVE_REQUEST_HYD_ENABLE_OFF" 2052 "GD_ID_DRIVE_BRAKE_PEDAL_POSITION_A" 2053 "GD_ID_DRIVE_BRAKE_PEDAL_POSITION_B" 2054 "GD_ID_DRIVE_BRAKE_PEDAL_POSITION" 2055 "GD_ID_DRIVE_HYD_MOT_RPM_FR" 2056 "GD_ID_DRIVE_HYD_MOT_RPM_RR" 2057 "GD_ID_DRIVE_HYD_MOT_RPM_RL" 2058 "GD_ID_DRIVE_HYD_MOT_RPM_FL" 2061 "GD_ID_DRIVE_FORWARD_SS_DEFAULT_SPEED" 2062 "GD_ID_DRIVE_REVERSE_SS_DEFAULT_SPEED" 2063 "GD_ID_DRIVE_WHEEL_BASED_MACHINE_SPEED" 2064 "GD_ID_DRIVE_DANFOSS_IN_SV_STATE_COMMANDED_Status" 2064 "GD_ID_DRIVE_DANFOSS_IN_SV_STATE_COMMANDED" 2065 "GD_ID_DRIVE_DANFOSS_OUT_SV_STATE_ACTUAL_Status" 2065 "GD_ID_DRIVE_DANFOSS_OUT_SV_STATE_ACTUAL" 2066 "GD_ID_DRIVE_DANFOSS_IN_SV_SPEED" 2067 "GD_ID_DRIVE_DANFOSS_OUT_DRIVE_MODE_ACTUAL_Status" 2067 "GD_ID_DRIVE_DANFOSS_OUT_DRIVE_MODE_ACTUAL" 2068 "GD_ID_DRIVE_DANFOSS_IN_DRIVE_MODE_COMMANDED_Status" 2068 "GD_ID_DRIVE_DANFOSS_IN_DRIVE_MODE_COMMANDED" 2069 "GD_ID_DRIVE_SV_1_Status" 2069 "GD_ID_DRIVE_SV_1" 2070 "GD_ID_DRIVE_SV_2_Status" 2070 "GD_ID_DRIVE_SV_2" 2071 "GD_ID_DRIVE_SV_STATE" 2072 "GD_ID_DRIVE_MAX_ENGINE_DROP" 2076 "GD_ID_DRIVE_CALIB_STATE_BRAKE_PEDAL_Status" 2076 "GD_ID_DRIVE_CALIB_STATE_BRAKE_PEDAL" 2077 "GD_ID_DRIVE_MAX_SV_SPEED" 2078 "GD_ID_DRIVE_PRESSURE_A" 2079 "GD_ID_DRIVE_PRESSURE_B" 2080 "GD_ID_DRIVE_CHARGE_PRESSURE" 2084 "GD_ID_DRIVE_DASH_DISPLAYED_ENGINE_SPEED" 2085 "GD_ID_DRIVE_FRONT_STEER_ANGLE" 2086 "GD_ID_DRIVE_DANFOSS_OUT_PARKBRK_REQUEST_Status" 2086 "GD_ID_DRIVE_DANFOSS_OUT_PARKBRK_REQUEST" 2087 "GD_ID_DRIVE_DANFOSS_OUT_CCO_VALVE_REQUEST_Status" 2087 "GD_ID_DRIVE_DANFOSS_OUT_CCO_VALVE_REQUEST" 2088 "GD_ID_DRIVE_CCO_VALVE_COMMAND_Status" 2088 "GD_ID_DRIVE_CCO_VALVE_COMMAND" 2092 "GD_ID_DRIVE_TIRE_RCI" 2094 "GD_ID_DRIVE_DASH_DISPLAYED_MACHINE_SPEED2" 2095 "GD_ID_DRIVE_CARGO_OVER_WEIGHT_Status" 2095 "GD_ID_DRIVE_CARGO_OVER_WEIGHT" 2096 "GD_ID_DRIVE_ROGATOR_MACHINE_CONFIGURATION" 2097 "GD_ID_DRIVE_TIRE_ROLLING_CIRCUMFERENCE" 2098 "GD_ID_DRIVE_BRAKE_LIGHT_COMMAND_Status" 2098 "GD_ID_DRIVE_BRAKE_LIGHT_COMMAND" 2099 "GD_ID_DRIVE_TARGET_MACHINE_SPEED" 2100 "GD_ID_DRIVE_MAX_MACHINE_SPEED" 2101 "GD_ID_DRIVE_EXPECTED_MACHINE_SPEED" 2111 "GD_ID_DRIVE_CALIB_BRAKE_PEDAL_START_Status" 2111 "GD_ID_DRIVE_CALIB_BRAKE_PEDAL_START" 2112 "GD_ID_DRIVE_CALIB_BRAKE_PEDAL_ACTIVE_Status" 2112 "GD_ID_DRIVE_CALIB_BRAKE_PEDAL_ACTIVE" 2113 "GD_ID_DRIVE_CALIB_BRAKE_PEDAL_DOWN_Status" 2113 "GD_ID_DRIVE_CALIB_BRAKE_PEDAL_DOWN" 2114 "GD_ID_DRIVE_CALIB_BRAKE_PEDAL_DOWN_RET_Status" 2114 "GD_ID_DRIVE_CALIB_BRAKE_PEDAL_DOWN_RET" 2115 "GD_ID_DRIVE_CALIB_BRAKE_PEDAL_UP_Status" 2115 "GD_ID_DRIVE_CALIB_BRAKE_PEDAL_UP" 2116 "GD_ID_DRIVE_CALIB_BRAKE_PEDAL_UP_RET_Status" 2116 "GD_ID_DRIVE_CALIB_BRAKE_PEDAL_UP_RET" 2117 "GD_ID_DRIVE_CALIB_BRAKE_PEDAL_ACCEPT_Status" 2117 "GD_ID_DRIVE_CALIB_BRAKE_PEDAL_ACCEPT" 2118 "GD_ID_DRIVE_CALIB_BRAKE_PEDAL_DECLINE_Status" 2118 "GD_ID_DRIVE_CALIB_BRAKE_PEDAL_DECLINE" 2119 "GD_ID_DRIVE_CALIB_BRAKE_PEDAL_PROCESSED_Status" 2119 "GD_ID_DRIVE_CALIB_BRAKE_PEDAL_PROCESSED" 2120 "GD_ID_DRIVE_CALIB_BRAKE_PEDAL_ERROR_Status" 2120 "GD_ID_DRIVE_CALIB_BRAKE_PEDAL_ERROR" 2121 "GD_ID_DRIVE_FIELD_STREET_STATE" 2122 "GD_ID_DRIVE_DTM_ENALBED_IN_MANUAL_Status" 2122 "GD_ID_DRIVE_DTM_ENALBED_IN_MANUAL" 2123 "GD_ID_DRIVE_STATE" 2124 "GD_ID_DRIVE_DTM_MIN_RPM" 2125 "GD_ID_DRIVE_DTM_MAX_RPM" 2126 "GD_ID_DRIVE_DRIVEPUMP_A_COMCURRENT" 2127 "GD_ID_DRIVE_DRIVEPUMP_B_COMCURRENT" 2128 "GD_ID_DRIVE_HYD_MOT_FR_COMCURRENT" 2129 "GD_ID_DRIVE_HYD_MOT_RR_COMCURRENT" 2130 "GD_ID_DRIVE_HYD_MOT_RL_COMCURRENT" 2131 "GD_ID_DRIVE_HYD_MOT_FL_COMCURRENT" 2133 "GD_ID_DRIVE_HYDRAULIC_OIl_TEMP" 2135 "GD_ID_DRIVE_FUEL_LEVEL" 2137 "GD_ID_DRIVE_PARKBRAKE_COMMAND_Status" 2137 "GD_ID_DRIVE_PARKBRAKE_COMMAND" 2138 "GD_ID_DRIVE_OPERATION_MODE" 2139 "GD_ID_DRIVE_DRIVEPUMP_A_FEEDBACK_CURRENT" 2140 "GD_ID_DRIVE_DRIVEPUMP_B_FEEDBACK_CURRENT" 2141 "GD_ID_DRIVE_HYD_MOT_FR_FEEDBACK_CURRENT" 2142 "GD_ID_DRIVE_HYD_MOT_RR_FEEDBACK_CURRENT" 2143 "GD_ID_DRIVE_HYD_MOT_RL_FEEDBACK_CURRENT" 2144 "GD_ID_DRIVE_HYD_MOT_FL_FEEDBACK_CURRENT" 2150 "GD_ID_DRIVE_RADAR_SPEED" 2175 "GD_ID_DRIVE_DASH_DISPLAYED_PARK_BRAKE_LED_Status" 2175 "GD_ID_DRIVE_DASH_DISPLAYED_PARK_BRAKE_LED" 2192 "GD_ID_DRIVE_CURRENT_GEAR" 2193 "GD_ID_DRIVE_SELECTED_GEAR" 2194 "GD_ID_DRIVE_DRIVE_PEDAL_POSITION" 2207 "GD_ID_DRIVE_DASH_DISPLAYED_MACHINE_SPEED1" 2258 "GD_ID_DRIVE_DTM_COMMANDED_RPM" 2300 "GD_ID_DRIVE_DISPLAY_UNITS_Status" 2300 "GD_ID_DRIVE_DISPLAY_UNITS" 2348 "GD_ID_DRIVE_RESET_DEFAULT_PROFILES_Status" 2348 "GD_ID_DRIVE_RESET_DEFAULT_PROFILES" 2349 "GD_ID_DRIVE_LEVER_ACCEL_PROFILE" 2350 "GD_ID_DRIVE_LEVER_DECEL_PROFILE" 2351 "GD_ID_DRIVE_PEDAL_ACCEL_PROFILE" 2352 "GD_ID_DRIVE_PEDAL_DECEL_PROFILE" 2353 "GD_ID_DRIVE_SV_ACCELDECEL_PROFILE" 2355 "GD_ID_DRIVE_SHUTTLE_ACCELDECEL_PROFILE" 2373 "GD_ID_DRIVE_DANFOSS_IN_OUTFAULTS" 2374 "GD_ID_ASC_RAMP_RL_DECTM" 2375 "GD_ID_ASC_PID_FL_KIUP_ASC" 2376 "GD_ID_ASC_PID_FL_KIDOWN_ASC" 2377 "GD_ID_ASC_PID_FL_KPUP_ASC" 2378 "GD_ID_ASC_PID_FL_KPDOWN_ASC" 2379 "GD_ID_ASC_PID_FL_KDUP_ASC" 2380 "GD_ID_ASC_PID_FL_IRED" 2381 "GD_ID_ASC_INCHING_INCHMODE" 2382 "GD_ID_ASC_INCHING_TVOLINCH" 2383 "GD_ID_ASC_REFSPDDISABLE_ABS_MINREFSPD_MMSEC" 2384 "GD_ID_ASC_REFSPDDISABLE_ASC_MINREFSPD_MMSEC" 2385 "GD_ID_ASC_REFSPDDISABLE_ABS_DECRAMP60K" 2386 "GD_ID_ASC_FFPROFILES_REVBRAKINGFRONT_Y4_PTC2" 2387 "GD_ID_ASC_FFPROFILES_REVBRAKINGFRONT_Y5_PTC2" 2388 "GD_ID_ASC_FFPROFILES_REVBRAKINGFRONT_Y6_PTC2" 2389 "GD_ID_ASC_FFPROFILES_FWDBRAKINGREAR_Y5_PTC2_LD" 2390 "GD_ID_ASC_FFPROFILES_FWDBRAKINGREAR_Y5_PTC2" 2391 "GD_ID_ASC_FFPROFILES_FWDBRAKINGREAR_Y6_PTC2_LD" 2392 "GD_ID_ASC_FFPROFILES_FWDBRAKINGREAR_Y6_PTC2" 2393 "GD_ID_ASC_CORE_ASC_MINTOLERANCE_PCT2" 2394 "GD_ID_ASC_PID_RL_KDUP_ASC" 2395 "GD_ID_ASC_PID_RL_KPUP_ASC" 2396 "GD_ID_ASC_PID_RL_KPDN_ASC" 2397 "GD_ID_ASC_PID_RL_KIUP_ASC" 2398 "GD_ID_ASC_PID_RL_KIDN_ASC" 2399 "GD_ID_ASC_PID_RL_IRED" 2400 "GD_ID_BRK_Y5" 2401 "GD_ID_ENGADJLD_FILTERTM_MS" 2402 "GD_ID_ENGADJLD_Y4" 2403 "GD_ID_MV_I_INT_I_GAIN" 2404 "GD_ID_MISC_PR_PERACT_Y3" 2405 "GD_ID_MISC_PR_PERACT_Y4" 2406 "GD_ID_MISC_PR_PERACT_Y5" 2407 "GD_ID_ASC_Core_ABS_Ang_Y1_ptc2" 2408 "GD_ID_ASC_Core_ABS_Ang_Y2_ptc2" 2409 "GD_ID_ASC_Core_ABS_Ang_Y3_ptc2" 2410 "GD_ID_ASC_Core_ABS_Ang_Y4_ptc2" 2411 "GD_ID_ASC_Core_ABS_Ang_Y5_ptc2" 2412 "GD_ID_ASC_Core_ABS_MinTolerance_pct2" 2413 "GD_ID_ASC_Core_ASC_Ang_Y1_ptc2" 2414 "GD_ID_ASC_Core_ASC_Ang_Y2_ptc2" 2415 "GD_ID_ASC_Core_ASC_Ang_Y3_ptc2" 2416 "GD_ID_ASC_Core_ASC_Ang_Y4_ptc2" 2417 "GD_ID_ASC_Core_ASC_Ang_Y5_ptc2" 2458 "GD_ID_DRIVE_PEDAL_CAL_COMMAND_Status" 2458 "GD_ID_DRIVE_PEDAL_CAL_COMMAND" 2459 "GD_ID_DRIVE_PEDAL_CAL_STATE_Status" 2459 "GD_ID_DRIVE_PEDAL_CAL_STATE" 2460 "GD_ID_DRIVE_BRAKE_PEDAL_CAL_COMMAND_Status" 2460 "GD_ID_DRIVE_BRAKE_PEDAL_CAL_COMMAND" 2461 "GD_ID_DRIVE_BRAKE_PEDAL_CAL_STATE_Status" 2461 "GD_ID_DRIVE_BRAKE_PEDAL_CAL_STATE" 2462 "GD_ID_DRIVE_WAS_CAL_COMMAND_Status" 2462 "GD_ID_DRIVE_WAS_CAL_COMMAND" 2463 "GD_ID_DRIVE_WAS_CAL_STATE_Status" 2463 "GD_ID_DRIVE_WAS_CAL_STATE" 2464 "GD_ID_DRIVE_HYDRO_CAL_COMMAND_Status" 2464 "GD_ID_DRIVE_HYDRO_CAL_COMMAND" 2465 "GD_ID_DRIVE_HYDRO_CAL_STATE_Status" 2465 "GD_ID_DRIVE_HYDRO_CAL_STATE" 2468 "GD_ID_DRIVE_WHEEL_SPEED_CALIBRATION_COMMAND_Status" 2468 "GD_ID_DRIVE_WHEEL_SPEED_CALIBRATION_COMMAND" 2469 "GD_ID_DRIVE_WHEEL_SPEED_CALIBRATION_STATE_Status" 2469 "GD_ID_DRIVE_WHEEL_SPEED_CALIBRATION_STATE" 2470 "GD_ID_DRIVE_WHEEL_SPEED_CALIBRATION_USER_DISTANCE_Status" 2470 "GD_ID_DRIVE_WHEEL_SPEED_CALIBRATION_USER_DISTANCE" 2471 "GD_ID_DRIVE_RADAR_CALIBRATION_COMMAND_Status" 2471 "GD_ID_DRIVE_RADAR_CALIBRATION_COMMAND" 2472 "GD_ID_DRIVE_RADAR_CALIBRATION_STATE_Status" 2472 "GD_ID_DRIVE_RADAR_CALIBRATION_STATE" 2473 "GD_ID_DRIVE_RADAR_CALIBRATION_USER_DISTANCE_Status" 2473 "GD_ID_DRIVE_RADAR_CALIBRATION_USER_DISTANCE" 2474 "GD_ID_DRIVE_COMBO_CALIBRATION_COMMAND_Status" 2474 "GD_ID_DRIVE_COMBO_CALIBRATION_COMMAND" 2475 "GD_ID_DRIVE_COMBO_CALIBRATION_STATE_Status" 2475 "GD_ID_DRIVE_COMBO_CALIBRATION_STATE" 2476 "GD_ID_DRIVE_COMBO_CALIBRATION_USER_DISTANCE_Status" 2476 "GD_ID_DRIVE_COMBO_CALIBRATION_USER_DISTANCE" 2498 "GD_ID_DRIVE_DRIVEPUMP_A_START_CAL_CURRENT_STORED" 2499 "GD_ID_DRIVE_DRIVEPUMP_A_END_CAL_CURRENT_STORED" 2500 "GD_ID_DRIVE_DRIVEPUMP_B_START_CAL_CURRENT_STORED" 2501 "GD_ID_DRIVE_DRIVEPUMP_B_END_CAL_CURRENT_STORED" 2502 "GD_ID_DRIVE_MOTOR_FL_START_CAL_CURRENT_STORED" 2503 "GD_ID_DRIVE_MOTOR_FL_END_CAL_CURRENT_STORED" 2504 "GD_ID_DRIVE_MOTOR_FR_START_CAL_CURRENT_STORED" 2505 "GD_ID_DRIVE_MOTOR_FR_END_CAL_CURRENT_STORED" 2506 "GD_ID_DRIVE_MOTOR_RL_START_CAL_CURRENT_STORED" 2507 "GD_ID_DRIVE_MOTOR_RL_END_CAL_CURRENT_STORED" 2508 "GD_ID_DRIVE_MOTOR_RR_START_CAL_CURRENT_STORED" 2509 "GD_ID_DRIVE_MOTOR_RR_END_CAL_CURRENT_STORED" 2510 "GD_ID_DRIVE_DRIVEPUMP_A_START_CAL_CURRENT_NEW" 2511 "GD_ID_DRIVE_DRIVEPUMP_A_END_CAL_CURRENT_NEW" 2512 "GD_ID_DRIVE_DRIVEPUMP_B_START_CAL_CURRENT_NEW" 2513 "GD_ID_DRIVE_DRIVEPUMP_B_END_CAL_CURRENT_NEW" 2514 "GD_ID_DRIVE_MOTOR_FL_START_CAL_CURRENT_NEW" 2515 "GD_ID_DRIVE_MOTOR_FL_END_CAL_CURRENT_NEW" 2516 "GD_ID_DRIVE_MOTOR_FR_START_CAL_CURRENT_NEW" 2517 "GD_ID_DRIVE_MOTOR_FR_END_CAL_CURRENT_NEW" 2518 "GD_ID_DRIVE_MOTOR_RL_START_CAL_CURRENT_NEW" 2519 "GD_ID_DRIVE_MOTOR_RL_END_CAL_CURRENT_NEW" 2520 "GD_ID_DRIVE_MOTOR_RR_START_CAL_CURRENT_NEW" 2521 "GD_ID_DRIVE_MOTOR_RR_END_CAL_CURRENT_NEW" 2523 "GD_ID_DRIVE_DANFOSS_CAL_REQUEST" 2525 "GD_ID_DRIVE_WHEEL_BASED_MACHINE_SPEED_KPH" 2526 "GD_ID_DRIVE_NORMALIZED_WHEEL_SPEED_FL" 2527 "GD_ID_DRIVE_NORMALIZED_WHEEL_SPEED_FR" 2528 "GD_ID_DRIVE_NORMALIZED_WHEEL_SPEED_RL" 2529 "GD_ID_DRIVE_NORMALIZED_WHEEL_SPEED_RR" 2530 "GD_ID_DRIVE_AIRBAG_DEFLATE_Status" 2530 "GD_ID_DRIVE_AIRBAG_DEFLATE" 2542 "GD_ID_DRIVE_ERRORMANAGEMENT_Status" 2542 "GD_ID_DRIVE_ERRORMANAGEMENT" 2559 "GD_ID_DRIVE_LIFEMESSAGE" 12288 "GD_ID_SCT_ENABLE" 12289 "GD_ID_SCT_MODUL_OUT_STATUS" 12290 "GD_ID_SCT_MODUL_IN_STATUS" 12298 "GD_ID_SCT_STATUSDISPLAY_TERMINAL" 12303 "GD_ID_SCT_TURNING_OFF_REASON" 12304 "GD_ID_SCT_STATE" 12305 "GD_ID_SCT_VOTED_ACTIVE_CLASS_1" 12306 "GD_ID_SCT_VOTED_ACTIVE_CLASS_2" 12312 "GD_ID_SCT_SETPOINT_Status" 12312 "GD_ID_SCT_SETPOINT" 12313 "GD_ID_SCT_SETPOINT_FEELER_GUIDANCE_Status" 12313 "GD_ID_SCT_SETPOINT_FEELER_GUIDANCE" 12314 "GD_ID_SCT_SETPOINT_CURVATURE_Status" 12314 "GD_ID_SCT_SETPOINT_CURVATURE" 12315 "GD_ID_SCT_SETPOINT_CURVATURE_TIM_Status" 12315 "GD_ID_SCT_SETPOINT_CURVATURE_TIM" 12316 "GD_ID_SCT_SETPOINT_CURVATURE_FEELER_GUIDANCE_Status" 12316 "GD_ID_SCT_SETPOINT_CURVATURE_FEELER_GUIDANCE" 12320 "GD_ID_SCT_WAS_RAW_VALUE" 12321 "GD_ID_SCT_WAS_SCALED_VALUE" 12322 "GD_ID_SCT_WAS_SENSOR_ANGLE" 12323 "GD_ID_SCT_WAS_MEDIAN_ANGLE" 12324 "GD_ID_SCT_WAS_MEDIAN_ANGLE_MAX" 12325 "GD_ID_SCT_WAS_VIRTUAL_ANGLE" 12328 "GD_ID_SCT_WAS_MEDIAN_CURVATURE" 12329 "GD_ID_SCT_WAS_MEDIAN_CURVATURE_MAX" 12334 "GD_ID_SCT_WAS_CALIB_COMMAND" 12335 "GD_ID_SCT_WAS_CALIB_STATUS" 12336 "GD_ID_SCT_SWS_RAW_VALUE_Status" 12336 "GD_ID_SCT_SWS_RAW_VALUE" 12338 "GD_ID_SCT_SWS_LIMITED_ANGLE_Status" 12338 "GD_ID_SCT_SWS_LIMITED_ANGLE" 12339 "GD_ID_SCT_SWS_CONTINUED_ANGLE_Status" 12339 "GD_ID_SCT_SWS_CONTINUED_ANGLE" 12340 "GD_ID_SCT_SWS_ROTATIONAL_SPEED" 12352 "GD_ID_SCT_VALVE_SETPOINT" 12353 "GD_ID_SCT_VALVE_POSITION" 12366 "GD_ID_SCT_VALVE_CALIB_COMMAND" 12367 "GD_ID_SCT_VALVE_CALIB_STATUS" 12368 "GD_ID_SCT_PILOTVALVE_STATUS_Status" 12368 "GD_ID_SCT_PILOTVALVE_STATUS" 12388 "GD_ID_SCT_OLAY_STEER_FACTOR" 12416 "GD_ID_SCT_HEADLAND_CMD_Status" 12416 "GD_ID_SCT_HEADLAND_CMD" 12417 "GD_ID_SCT_3RDPARTY_READY_STATUS_Status" 12417 "GD_ID_SCT_3RDPARTY_READY_STATUS" 12418 "GD_ID_SCT_3RDPARTY_POSITION_STATUS_Status" 12418 "GD_ID_SCT_3RDPARTY_POSITION_STATUS" 12419 "GD_ID_SCT_3RDPARTY_CANCEL_REQUEST_Status" 12419 "GD_ID_SCT_3RDPARTY_CANCEL_REQUEST" 12420 "GD_ID_SCT_3RDPARTY_COMMAND_GUIDANCE_Status" 12420 "GD_ID_SCT_3RDPARTY_COMMAND_GUIDANCE" 12544 "GD_ID_SCT_TSD_MIN_SPEED_FORWARD" 12545 "GD_ID_SCT_TSD_MAX_SPEED_FORWARD" 12546 "GD_ID_SCT_TSD_MIN_MACHINE_RADIUS" 12547 "GD_ID_SCT_TSD_MAX_ACQUISITION_ANGLE" 12560 "GD_ID_SCT_GUIDANCE_CONFIGURATION_DATA_Status" 12560 "GD_ID_SCT_GUIDANCE_CONFIGURATION_DATA" 12568 "GD_ID_SCT_STEERING_MODE_Status" 12568 "GD_ID_SCT_STEERING_MODE" 12569 "GD_ID_SCT_SECONDARY_WAS_RAW_VALUE_Status" 12569 "GD_ID_SCT_SECONDARY_WAS_RAW_VALUE" 12570 "GD_ID_SCT_SECONDARY_WAS_SENSOR_ANGLE_Status" 12570 "GD_ID_SCT_SECONDARY_WAS_SENSOR_ANGLE" 12571 "GD_ID_SCT_SECONDARY_WAS_MEDIAN_ANGLE_Status" 12571 "GD_ID_SCT_SECONDARY_WAS_MEDIAN_ANGLE" 12572 "GD_ID_SCT_SECONDARY_WAS_MEDIAN_ANGLE_MAX_Status" 12572 "GD_ID_SCT_SECONDARY_WAS_MEDIAN_ANGLE_MAX" 12573 "GD_ID_SCT_ALS_X_OFFSET_Status" 12573 "GD_ID_SCT_ALS_X_OFFSET" 12574 "GD_ID_SCT_ALS_Y_OFFSET_Status" 12574 "GD_ID_SCT_ALS_Y_OFFSET" 12575 "GD_ID_SCT_ADDITIONAL_WORKING_HEIGHT" 12576 "GD_ID_SCT_VEHICLE_CURRENT_PAYLOAD_Status" 12576 "GD_ID_SCT_VEHICLE_CURRENT_PAYLOAD" 12598 "GD_ID_SCT_ISO_STATE" 12599 "GD_ID_SCT_VEHICLE_SPEED_Status" 12599 "GD_ID_SCT_VEHICLE_SPEED" 12600 "GD_ID_SCT_VEHICLE_MOVEMENT_Status" 12600 "GD_ID_SCT_VEHICLE_MOVEMENT" 12601 "GD_ID_SCT_PARKING_BRAKE_Status" 12601 "GD_ID_SCT_PARKING_BRAKE" 12608 "GD_ID_SCT_CONTROL_MSG_TERMINAL" 12609 "GD_ID_SCT_CONTROL_MSG_GUIDEANCE" 12610 "GD_ID_SCT_MODIFIED_REFERENCE_POINT_HEIGHT" 12611 "GD_ID_SCT_MODIFIED_GNSS_ANTENNA_X_OFFSET" 12612 "GD_ID_SCT_MODIFIED_GNSS_ANTENNA_Y_OFFSET" 12613 "GD_ID_SCT_MODIFIED_GNSS_ANTENNA_Z_OFFSET" 12614 "GD_ID_SCT_MODIFIED_TRACK_WIDTH" 12615 "GD_ID_SCT_MODIFIED_MOUNTING_ERROR_Y_OFFSET" 12736 "GD_ID_SCT_TRACTOR_SN_TYPE" 12737 "GD_ID_SCT_TRACTOR_SN_GROUP" 12738 "GD_ID_SCT_TRACTOR_SN_NUMBER" 12782 "GD_ID_SCT_ERROR_ACKNOWLEDGE_Status" 12782 "GD_ID_SCT_ERROR_ACKNOWLEDGE" 12784 "GD_ID_SCT_ACTIVATE_DIAGNOSTICS" 12788 "GD_ID_SCT_SAFETY_VERSION_Status" 12788 "GD_ID_SCT_SAFETY_VERSION" 12789 "GD_ID_SCT_LIB_SAFETY_VERSION" 12792 "GD_ID_SCT_RECIPE_ACCESS_SETPOINT" 12793 "GD_ID_SCT_TI_ACCESS_SETPOINT" 12794 "GD_ID_SCT_TI_ACCESS_STATE" 12795 "GD_ID_SCT_TI_ACCESS_STATE_KL15" 12797 "GD_ID_SCT_TI_SUB_STATE" 12782 "GD_ID_SCT_ErrorManagement_Status" 12782 "GD_ID_SCT_ErrorManagement" 12799 "GD_ID_SCT_LifeMessage" 12800 "GD_ID_Engine_Rpm" 12801 "GD_ID_Engine_Load" 12802 "GD_ID_Engine_Coolant_Temp_Status" 12802 "GD_ID_Engine_Coolant_Temp" 12803 "GD_ID_Engine_Air_Intake_Temp" 12804 "GD_ID_Engine_Battery_Power_Status" 12804 "GD_ID_Engine_Battery_Power" 12805 "GD_ID_Engine_Air_Intake_Pressure" 12806 "GD_ID_Engine_Oil_Pressure" 12807 "GD_ID_Engine_Rpm_Setpoint_Status" 12807 "GD_ID_Engine_Rpm_Setpoint" 12808 "GD_ID_Engine_Standing_Still_Status" 12808 "GD_ID_Engine_Standing_Still" 12809 "GD_ID_Engine_Oil_Pressure_Low_Status" 12809 "GD_ID_Engine_Oil_Pressure_Low" 12810 "GD_ID_Engine_Oil_Service_Interval_Status" 12810 "GD_ID_Engine_Oil_Service_Interval" 12811 "GD_ID_Engine_Hours" 12812 "GD_ID_Engine_Amber_Warning_Lamp_Status" 12812 "GD_ID_Engine_Amber_Warning_Lamp" 12813 "GD_ID_Engine_Red_Stop_Lamp_Status" 12813 "GD_ID_Engine_Red_Stop_Lamp" 12814 "GD_ID_Alt_Low_Idle" 12815 "GD_ID_Engine_Audible_Warning_Status" 12815 "GD_ID_Engine_Audible_Warning" 12816 "GD_ID_Ambient_Temp" 12817 "GD_ID_Ecu_Temp" 12820 "GD_ID_Fuel_Rate" 12821 "GD_ID_Trip_Fuel" 12822 "GD_ID_Trip_DEF" 12823 "GD_ID_DEF_Level" 12824 "GD_ID_Water_In_Fuel_Status" 12824 "GD_ID_Water_In_Fuel" 12825 "GD_ID_Engine_Malfunction_Lamp_Status" 12825 "GD_ID_Engine_Malfunction_Lamp" 12826 "GD_ID_DEF_Level_Warning_Status" 12826 "GD_ID_DEF_Level_Warning" 12827 "GD_ID_Engine_WaitToStart_Status" 12827 "GD_ID_Engine_WaitToStart" 12828 "GD_ID_Engine_Operating_State" 12829 "GD_ID_Engine_Start_Enable_Status" 12829 "GD_ID_Engine_Start_Enable" 12830 "GD_ID_Implement_Transport_State_Status" 12830 "GD_ID_Implement_Transport_State" 12831 "GD_ID_Implement_Work_State_Status" 12831 "GD_ID_Implement_Work_State" 12832 "GD_ID_Implement_Actual_Working_Width" 12833 "GD_ID_Implement_Actual_Flow" 12834 "GD_ID_Implement_ReadyForFieldWork_Status" 12834 "GD_ID_Implement_ReadyForFieldWork" 12840 "GD_ID_WheelBasedDistance_km" 12841 "GD_ID_WheelBasedDistance_m" 12842 "GD_ID_GroundBasedDistance_km" 12843 "GD_ID_GroundBasedDistance_m" 12844 "GD_ID_SelectedSpeedDistance_km" 12845 "GD_ID_SelectedSpeedDistance_m" 12846 "GD_ID_MachineSelectedSpeed" 12847 "GD_ID_WBZ_MACHINE_SELECTED_SOURCE" 12848 "GD_ID_WBZ_MAX_ENG_RPM" 12850 "GD_ID_Working_Time_SecMin_VD" 12851 "GD_ID_Working_Time_Hours_VD" 12852 "GD_ID_Worked_Area_Ha_VD" 12853 "GD_ID_Worked_Area_0001Ha_VD" 12854 "GD_ID_Used_Fuel_VD" 12855 "GD_ID_Remaining_Time_SecMin_VD" 12856 "GD_ID_Remaining_Time_Hours_VD" 12857 "GD_ID_Remaining_Area_Ha_VD" 12858 "GD_ID_Remaining_Area_0001Ha_VD" 12859 "GD_ID_Required_Fuel_VD" 12860 "GD_ID_Field_Size_Ha_VD" 12861 "GD_ID_Field_Size_0001Ha_VD" 12862 "GD_ID_Reset_VD_Status" 12862 "GD_ID_Reset_VD" 12870 "GD_Iso_IsoState_state_RW" 12871 "GD_ID_WBZ_TERMINAL_PAGE_SIZE" 12878 "GD_ID_WBZ_ENG_DEF_LVL_LAMP_Status" 12878 "GD_ID_WBZ_ENG_DEF_LVL_LAMP" 12879 "GD_ID_WBZ_ENG_DEF_MIL_LAMP_Status" 12879 "GD_ID_WBZ_ENG_DEF_MIL_LAMP" 12880 "GD_ID_IgnitionState_Status" 12880 "GD_ID_IgnitionState" 12881 "GD_ID_WBZ_ENG_FAN_RPM" 12882 "GD_ID_WBZ_ENG_FUEL_TEMP" 12883 "GD_ID_WBZ_ENG_AUXIO1_01" 12884 "GD_ID_WBZ_ENG_FAN_DUTY_CYCLE" 12885 "GD_ID_WBZ_DEF_TEMP" 12886 "GD_ID_WBZ_EXHAUST_TEMP" 12887 "GD_ID_WBZ_FUEL_PRESSURE" 12888 "GD_ID_WBZ_CURVATURE_SETPOINT" 12889 "GD_ID_WBZ_CURVATURE_ENABLE_Status" 12889 "GD_ID_WBZ_CURVATURE_ENABLE" 12890 "GD_ID_WBZ_ENG_START_CMD_Status" 12890 "GD_ID_WBZ_ENG_START_CMD" 12891 "GD_ID_WBZ_THIRD_PARTY_MANUS_Status" 12891 "GD_ID_WBZ_THIRD_PARTY_MANUS" 12892 "GD_ID_WBZ_NEW_LEADER_ACL_Status" 12892 "GD_ID_WBZ_NEW_LEADER_ACL" 12901 "GD_ID_WBZ_AUXIO1_01_FI02" 12902 "GD_ID_WBZ_AUXIO1_02_FI02" 12903 "GD_ID_WBZ_AUXIO1_03_FI02" 12904 "GD_ID_WBZ_AUXIO1_04_FI02" 12905 "GD_ID_WBZ_AUXIO1_05_FI02" 12906 "GD_ID_WBZ_AUXIO1_06_FI02" 12907 "GD_ID_WBZ_AUXIO1_07_FI02" 12908 "GD_ID_WBZ_AUXIO1_08_FI02" 12909 "GD_ID_WBZ_AUXIO1_09_FI02" 12910 "GD_ID_WBZ_AUXIO1_10_FI02" 12911 "GD_ID_WBZ_AUXIO1_11_FI02" 12912 "GD_ID_WBZ_AUXIO1_12_FI02" 12917 "GD_ID_WBZ_AUXIO2_17_FI02" 12918 "GD_ID_WBZ_AUXIO2_18_FI02" 12919 "GD_ID_WBZ_AUXIO1_01_FI00" 12920 "GD_ID_WBZ_AUXIO1_02_FI00" 12921 "GD_ID_WBZ_AUXIO1_03_FI00" 12922 "GD_ID_WBZ_AUXIO1_04_FI00" 12923 "GD_ID_WBZ_AUXIO1_05_FI00" 12924 "GD_ID_WBZ_AUXIO1_06_FI00" 12925 "GD_ID_WBZ_AUXIO1_07_FI00" 12926 "GD_ID_WBZ_AUXIO1_08_FI00" 12927 "GD_ID_WBZ_AUXIO1_09_FI00" 12928 "GD_ID_WBZ_AUXIO1_10_FI00" 12929 "GD_ID_WBZ_AUXIO1_11_FI00" 12930 "GD_ID_WBZ_AUXIO1_12_FI00" 12931 "GD_ID_WBZ_AUXIO1_13_FI00" 12932 "GD_ID_WBZ_AUXIO1_14_FI00" 12933 "GD_ID_WBZ_AUXIO1_15_FI00" 12934 "GD_ID_WBZ_AUXIO1_16_FI00" 12935 "GD_ID_WBZ_AUXIO1_CH2" 12936 "GD_ID_WBZ_AUXIO2_17_FI00" 12937 "GD_ID_WBZ_AUXIO2_18_FI00" 12940 "GD_ID_WBZ_AUXIO2_21_FI00" 12941 "GD_ID_WBZ_AUXIO2_22_FI00" 12945 "GD_ID_WBZ_AUXIO2_26_FI00" 12946 "GD_ID_WBZ_AUXIO2_27_FI00" 12947 "GD_ID_WBZ_AUXIO2_28_FI00" 12948 "GD_ID_WBZ_AUXIO2_29_FI00" 12949 "GD_ID_WBZ_AUXIO2_30_FI00" 12950 "GD_ID_WBZ_AUXIO2_31_FI00" 12951 "GD_ID_WBZ_AUXIO2_32_FI00" 12952 "GD_ID_WBZ_AUXIO1_01_FI01" 12953 "GD_ID_WBZ_AUXIO1_02_FI01" 12954 "GD_ID_WBZ_AUXIO1_03_FI01" 12955 "GD_ID_WBZ_AUXIO1_04_FI01" 12956 "GD_ID_WBZ_AUXIO1_05_FI01" 12957 "GD_ID_WBZ_AUXIO1_06_FI01" 12958 "GD_ID_WBZ_AUXIO1_07_FI01" 12959 "GD_ID_WBZ_AUXIO1_08_FI01" 12960 "GD_ID_WBZ_AUXIO1_09_FI01" 12961 "GD_ID_WBZ_AUXIO1_10_FI01" 12962 "GD_ID_WBZ_AUXIO1_11_FI01" 12963 "GD_ID_WBZ_AUXIO1_12_FI01" 12964 "GD_ID_WBZ_AUXIO1_13_FI01" 12965 "GD_ID_WBZ_AUXIO1_14_FI01" 12966 "GD_ID_WBZ_AUXIO1_15_FI01" 12967 "GD_ID_WBZ_AUXIO1_16_FI01" 12969 "GD_ID_WBZ_AUXIO2_17_FI01" 12970 "GD_ID_WBZ_AUXIO2_18_FI01" 12973 "GD_ID_WBZ_AUXIO2_21_FI01" 12974 "GD_ID_WBZ_AUXIO2_22_FI01" 12978 "GD_ID_WBZ_AUXIO2_26_FI01" 12979 "GD_ID_WBZ_AUXIO2_27_FI01" 12980 "GD_ID_WBZ_AUXIO2_28_FI01" 12981 "GD_ID_WBZ_AUXIO2_29_FI01" 12982 "GD_ID_WBZ_AUXIO2_30_FI01" 12983 "GD_ID_WBZ_AUXIO2_31_FI01" 12984 "GD_ID_WBZ_AUXIO2_32_FI01" 12985 "GD_ID_WBZ_AUXIO2_21_FI02" 12986 "GD_ID_WBZ_AUXIO2_22_FI02" 13000 "GD_ID_WBZ_TI_ACCESS" 13052 "GD_ID_Unknown_Engine_Error_Part1" 13053 "GD_ID_Unknown_Engine_Error_Part2" 13120 "GD_ID_WBZ_DPF_WARNING_LAMP_Status" 13120 "GD_ID_WBZ_DPF_WARNING_LAMP" 13121 "GD_ID_WBZ_DPF_HEST_LAMP_Status" 13121 "GD_ID_WBZ_DPF_HEST_LAMP" 13123 "GD_ID_WBZ_DPF_SOOT_ASH" 13124 "GD_ID_WBZ_DPF_HOURS_SINCE_REGEN" 13125 "GD_ID_WBZ_DPF_MINUTES_SINCE_REGEN" 13126 "GD_ID_WBZ_DPF_STATI" 13128 "GD_ID_WBZ_DPF_INHIBITED_STATI" 13129 "GD_ID_WBZ_DPF_CONTROL_REGEN" 13130 "GD_ID_WBZ_DPF_ENABLE_REGEN_Status" 13130 "GD_ID_WBZ_DPF_ENABLE_REGEN" 13294 "GD_ID_WBZ_ErrorManagement_Status" 13294 "GD_ID_WBZ_ErrorManagement" 13311 "GD_ID_WBZ_LifeMessage" 13824 "GD_ID_Current_Track_Width" 13825 "GD_ID_TA_Min_Track_Width" 13826 "GD_ID_Max_Track_Width" 13827 "GD_ID_Calib_State_Track_Width_Status" 13827 "GD_ID_Calib_State_Track_Width" 13828 "GD_ID_TA_Front_Axle_Width" 13829 "GD_ID_TA_Front_Track_Width" 13830 "GD_ID_TA_Rear_Axle_Width" 13831 "GD_ID_TA_Rear_Track_Width" 13832 "GD_ID_Track_Adjust_Errors_Status" 13832 "GD_ID_Track_Adjust_Errors" 13833 "GD_ID_TA_Calibration_Command" 13834 "GD_ID_TA_Calibration_State" 13835 "GD_ID_TA_MANUAL_IN_Status" 13835 "GD_ID_TA_MANUAL_IN" 13836 "GD_ID_TA_MANUAL_OUT_Status" 13836 "GD_ID_TA_MANUAL_OUT" 13839 "GD_ID_TA_Actual_Front_In_R_Status" 13839 "GD_ID_TA_Actual_Front_In_R" 13840 "GD_ID_TA_Actual_Front_Out_R_Status" 13840 "GD_ID_TA_Actual_Front_Out_R" 13841 "GD_ID_TA_Actual_Rear_In_R_Status" 13841 "GD_ID_TA_Actual_Rear_In_R" 13842 "GD_ID_TA_Actual_Rear_Out_R_Status" 13842 "GD_ID_TA_Actual_Rear_Out_R" 13843 "GD_ID_TA_Actual_Front_In_Status" 13843 "GD_ID_TA_Actual_Front_In" 13844 "GD_ID_TA_Actual_Front_Out_Status" 13844 "GD_ID_TA_Actual_Front_Out" 13845 "GD_ID_TA_Actual_Rear_In_Status" 13845 "GD_ID_TA_Actual_Rear_In" 13846 "GD_ID_TA_Actual_Rear_Out_Status" 13846 "GD_ID_TA_Actual_Rear_Out" 13847 "GD_ID_Track_Adjust_Equipped_Status" 13847 "GD_ID_Track_Adjust_Equipped" 13848 "GD_ID_TA_Min_Tire_Track_Width" 13849 "GD_ID_Current_Axle_Width" 13850 "GD_ID_TA_Operation_State_Status" 13850 "GD_ID_TA_Operation_State" 13851 "GD_ID_TA_In_Tolerance_Status" 13851 "GD_ID_TA_In_Tolerance" 13852 "GD_ID_TA_Auto_Enable_A_Status" 13852 "GD_ID_TA_Auto_Enable_A" 13853 "GD_ID_TA_Auto_Enable_B_Status" 13853 "GD_ID_TA_Auto_Enable_B" 13854 "GD_ID_TA_Auto_Enable_Dual_Status" 13854 "GD_ID_TA_Auto_Enable_Dual" 13855 "GD_ID_TA_Setpoint_A" 13856 "GD_ID_TA_Setpoint_B" 13857 "GD_ID_TA_Setpoint_Dual_Front" 13858 "GD_ID_TA_Setpoint_Dual_Rear" 13864 "GD_ID_TA_Equipped_Status" 13864 "GD_ID_TA_Equipped" 13874 "GD_ID_TA_FL_POSITION" 13875 "GD_ID_TA_FR_POSITION" 13876 "GD_ID_TA_RL_POSITION" 13877 "GD_ID_TA_RR_POSITION" 13878 "GD_ID_TA_Setpoint_A_Rear_Status" 13878 "GD_ID_TA_Setpoint_A_Rear" 13879 "GD_ID_TA_Setpoint_B_Rear_Status" 13879 "GD_ID_TA_Setpoint_B_Rear" 13880 "GD_ID_TA_TARGET_TRACKWIDTH_FL" 13881 "GD_ID_TA_TARGET_TRACKWIDTH_FR" 13882 "GD_ID_TA_TARGET_TRACKWIDTH_RL" 13883 "GD_ID_TA_TARGET_TRACKWIDTH_RR" 13884 "GD_ID_TA_ADDITIONAL_WIDTH_FL" 13885 "GD_ID_TA_ADDITIONAL_WIDTH_FR" 13886 "GD_ID_TA_ADDITIONAL_WIDTH_RL" 13887 "GD_ID_TA_ADDITIONAL_WIDTH_RR" 14318 "GD_ID_TA_ErrorManagement_Status" 14318 "GD_ID_TA_ErrorManagement" 14335 "GD_ID_TA_LifeMessage" 15872 "GD_ID_EMM_SIGNAL_LN00_ERROR_W_Status" 15872 "GD_ID_EMM_SIGNAL_LN00_ERROR_W" 15873 "GD_ID_EMM_SIGNAL_LN01_ERROR_W_Status" 15873 "GD_ID_EMM_SIGNAL_LN01_ERROR_W" 15874 "GD_ID_EMM_SIGNAL_LN02_ERROR_W_Status" 15874 "GD_ID_EMM_SIGNAL_LN02_ERROR_W" 15875 "GD_ID_EMM_SIGNAL_LN03_ERROR_W_Status" 15875 "GD_ID_EMM_SIGNAL_LN03_ERROR_W" 15876 "GD_ID_EMM_SIGNAL_LN04_ERROR_W_Status" 15876 "GD_ID_EMM_SIGNAL_LN04_ERROR_W" 15877 "GD_ID_EMM_SIGNAL_LN05_ERROR_W_Status" 15877 "GD_ID_EMM_SIGNAL_LN05_ERROR_W" 15878 "GD_ID_EMM_SIGNAL_LN06_ERROR_W_Status" 15878 "GD_ID_EMM_SIGNAL_LN06_ERROR_W" 15879 "GD_ID_EMM_SIGNAL_LN07_ERROR_W_Status" 15879 "GD_ID_EMM_SIGNAL_LN07_ERROR_W" 15880 "GD_ID_EMM_SIGNAL_LN08_ERROR_W_Status" 15880 "GD_ID_EMM_SIGNAL_LN08_ERROR_W" 15881 "GD_ID_EMM_SIGNAL_LN09_ERROR_W_Status" 15881 "GD_ID_EMM_SIGNAL_LN09_ERROR_W" 15882 "GD_ID_EMM_SIGNAL_LN10_ERROR_W_Status" 15882 "GD_ID_EMM_SIGNAL_LN10_ERROR_W" 15883 "GD_ID_EMM_SIGNAL_LN11_ERROR_W_Status" 15883 "GD_ID_EMM_SIGNAL_LN11_ERROR_W" 15884 "GD_ID_EMM_SIGNAL_LN12_ERROR_W_Status" 15884 "GD_ID_EMM_SIGNAL_LN12_ERROR_W" 15885 "GD_ID_EMM_SIGNAL_LN13_ERROR_W_Status" 15885 "GD_ID_EMM_SIGNAL_LN13_ERROR_W" 15886 "GD_ID_EMM_SIGNAL_LN14_ERROR_W_Status" 15886 "GD_ID_EMM_SIGNAL_LN14_ERROR_W" 15887 "GD_ID_EMM_SIGNAL_LN15_ERROR_W_Status" 15887 "GD_ID_EMM_SIGNAL_LN15_ERROR_W" 15888 "GD_ID_EMM_SIGNAL_LN16_ERROR_W_Status" 15888 "GD_ID_EMM_SIGNAL_LN16_ERROR_W" 15889 "GD_ID_EMM_SIGNAL_LN17_ERROR_W_Status" 15889 "GD_ID_EMM_SIGNAL_LN17_ERROR_W" 15890 "GD_ID_EMM_SIGNAL_LN18_ERROR_W_Status" 15890 "GD_ID_EMM_SIGNAL_LN18_ERROR_W" 15891 "GD_ID_EMM_SIGNAL_LN19_ERROR_W_Status" 15891 "GD_ID_EMM_SIGNAL_LN19_ERROR_W" 15892 "GD_ID_EMM_SIGNAL_LN20_ERROR_W_Status" 15892 "GD_ID_EMM_SIGNAL_LN20_ERROR_W" 15893 "GD_ID_EMM_SIGNAL_LN21_ERROR_W_Status" 15893 "GD_ID_EMM_SIGNAL_LN21_ERROR_W" 15894 "GD_ID_EMM_SIGNAL_LN22_ERROR_W_Status" 15894 "GD_ID_EMM_SIGNAL_LN22_ERROR_W" 15895 "GD_ID_EMM_SIGNAL_LN23_ERROR_W_Status" 15895 "GD_ID_EMM_SIGNAL_LN23_ERROR_W" 15896 "GD_ID_EMM_SIGNAL_LN24_ERROR_W_Status" 15896 "GD_ID_EMM_SIGNAL_LN24_ERROR_W" 15897 "GD_ID_EMM_SIGNAL_LN25_ERROR_W_Status" 15897 "GD_ID_EMM_SIGNAL_LN25_ERROR_W" 15898 "GD_ID_EMM_SIGNAL_LN26_ERROR_W_Status" 15898 "GD_ID_EMM_SIGNAL_LN26_ERROR_W" 15899 "GD_ID_EMM_SIGNAL_LN27_ERROR_W_Status" 15899 "GD_ID_EMM_SIGNAL_LN27_ERROR_W" 15900 "GD_ID_EMM_SIGNAL_LN28_ERROR_W_Status" 15900 "GD_ID_EMM_SIGNAL_LN28_ERROR_W" 15901 "GD_ID_EMM_SIGNAL_LN29_ERROR_W_Status" 15901 "GD_ID_EMM_SIGNAL_LN29_ERROR_W" 15902 "GD_ID_EMM_SIGNAL_LN30_ERROR_W_Status" 15902 "GD_ID_EMM_SIGNAL_LN30_ERROR_W" 15903 "GD_ID_EMM_SIGNAL_LN31_ERROR_W_Status" 15903 "GD_ID_EMM_SIGNAL_LN31_ERROR_W" 15904 "GD_ID_EMM_SIGNAL_LN32_ERROR_W_Status" 15904 "GD_ID_EMM_SIGNAL_LN32_ERROR_W" 15905 "GD_ID_EMM_SIGNAL_LN33_ERROR_W_Status" 15905 "GD_ID_EMM_SIGNAL_LN33_ERROR_W" 15906 "GD_ID_EMM_SIGNAL_LN34_ERROR_W_Status" 15906 "GD_ID_EMM_SIGNAL_LN34_ERROR_W" 15907 "GD_ID_EMM_SIGNAL_LN35_ERROR_W_Status" 15907 "GD_ID_EMM_SIGNAL_LN35_ERROR_W" 15908 "GD_ID_EMM_SIGNAL_LN36_ERROR_W_Status" 15908 "GD_ID_EMM_SIGNAL_LN36_ERROR_W" 15909 "GD_ID_EMM_SIGNAL_LN37_ERROR_W_Status" 15909 "GD_ID_EMM_SIGNAL_LN37_ERROR_W" 15910 "GD_ID_EMM_SIGNAL_LN38_ERROR_W_Status" 15910 "GD_ID_EMM_SIGNAL_LN38_ERROR_W" 15911 "GD_ID_EMM_SIGNAL_LN39_ERROR_W_Status" 15911 "GD_ID_EMM_SIGNAL_LN39_ERROR_W" 15912 "GD_ID_EMM_SIGNAL_LN40_ERROR_W_Status" 15912 "GD_ID_EMM_SIGNAL_LN40_ERROR_W" 15913 "GD_ID_EMM_SIGNAL_LN41_ERROR_W_Status" 15913 "GD_ID_EMM_SIGNAL_LN41_ERROR_W" 15914 "GD_ID_EMM_SIGNAL_LN42_ERROR_W_Status" 15914 "GD_ID_EMM_SIGNAL_LN42_ERROR_W" 15915 "GD_ID_EMM_SIGNAL_LN43_ERROR_W_Status" 15915 "GD_ID_EMM_SIGNAL_LN43_ERROR_W" 15916 "GD_ID_EMM_SIGNAL_LN44_ERROR_W_Status" 15916 "GD_ID_EMM_SIGNAL_LN44_ERROR_W" 15917 "GD_ID_EMM_SIGNAL_LN45_ERROR_W_Status" 15917 "GD_ID_EMM_SIGNAL_LN45_ERROR_W" 15918 "GD_ID_EMM_SIGNAL_LN46_ERROR_W_Status" 15918 "GD_ID_EMM_SIGNAL_LN46_ERROR_W" 15919 "GD_ID_EMM_SIGNAL_LN47_ERROR_W_Status" 15919 "GD_ID_EMM_SIGNAL_LN47_ERROR_W" 15920 "GD_ID_EMM_SIGNAL_LN48_ERROR_W_Status" 15920 "GD_ID_EMM_SIGNAL_LN48_ERROR_W" 15921 "GD_ID_EMM_SIGNAL_LN49_ERROR_W_Status" 15921 "GD_ID_EMM_SIGNAL_LN49_ERROR_W" 15922 "GD_ID_EMM_SIGNAL_LN50_ERROR_W_Status" 15922 "GD_ID_EMM_SIGNAL_LN50_ERROR_W" 15923 "GD_ID_EMM_SIGNAL_LN51_ERROR_W_Status" 15923 "GD_ID_EMM_SIGNAL_LN51_ERROR_W" 15924 "GD_ID_EMM_SIGNAL_LN52_ERROR_W_Status" 15924 "GD_ID_EMM_SIGNAL_LN52_ERROR_W" 15925 "GD_ID_EMM_SIGNAL_LN53_ERROR_W_Status" 15925 "GD_ID_EMM_SIGNAL_LN53_ERROR_W" 15926 "GD_ID_EMM_SIGNAL_LN54_ERROR_W_Status" 15926 "GD_ID_EMM_SIGNAL_LN54_ERROR_W" 15927 "GD_ID_EMM_SIGNAL_LN55_ERROR_W_Status" 15927 "GD_ID_EMM_SIGNAL_LN55_ERROR_W" 15928 "GD_ID_EMM_SIGNAL_LN56_ERROR_W_Status" 15928 "GD_ID_EMM_SIGNAL_LN56_ERROR_W" 15929 "GD_ID_EMM_SIGNAL_LN57_ERROR_W_Status" 15929 "GD_ID_EMM_SIGNAL_LN57_ERROR_W" 15930 "GD_ID_EMM_SIGNAL_LN58_ERROR_W_Status" 15930 "GD_ID_EMM_SIGNAL_LN58_ERROR_W" 15931 "GD_ID_EMM_SIGNAL_LN59_ERROR_W_Status" 15931 "GD_ID_EMM_SIGNAL_LN59_ERROR_W" 15932 "GD_ID_EMM_SIGNAL_LN60_ERROR_W_Status" 15932 "GD_ID_EMM_SIGNAL_LN60_ERROR_W" 15933 "GD_ID_EMM_SIGNAL_LN61_ERROR_W_Status" 15933 "GD_ID_EMM_SIGNAL_LN61_ERROR_W" 15934 "GD_ID_EMM_SIGNAL_LN62_ERROR_W_Status" 15934 "GD_ID_EMM_SIGNAL_LN62_ERROR_W" 15935 "GD_ID_EMM_SIGNAL_LN63_ERROR_W_Status" 15935 "GD_ID_EMM_SIGNAL_LN63_ERROR_W" 15938 "GD_ID_EMM_TERMINAL_TRANSFER_R_Status" 15938 "GD_ID_EMM_TERMINAL_TRANSFER_R" 15939 "GD_ID_EMM_ACM_TRANSFER_R_Status" 15939 "GD_ID_EMM_ACM_TRANSFER_R" 15970 "GD_ID_EMM_TERMINAL_ACKNOWLEDGE_W_Status" 15970 "GD_ID_EMM_TERMINAL_ACKNOWLEDGE_W" 16000 "GD_ID_EMM_REQUEST_ENVVAR_W" 16001 "GD_ID_EMM_ENV_VAR_VALUE1" 16002 "GD_ID_EMM_ENV_VAR_VALUE2" 16003 "GD_ID_EMM_ENV_VAR_VALUE3" 16004 "GD_ID_EMM_ENV_VAR_VALUE4" 16005 "GD_ID_EMM_ENV_VAR_VALUE5" 16006 "GD_ID_EMM_ENV_VAR_OPERATING_HOUR" 16007 "GD_ID_EMM_ENV_VAR_ERROR_COUNTER" 16008 "GD_ID_EMM_ENV_VAR_DATE1" 16009 "GD_ID_EMM_ENV_VAR_DATE2" 16010 "GD_ID_EMM_ENV_VAR_TIME1" 16011 "GD_ID_EMM_ENV_VAR_TIME2" 16012 "GD_ID_EMM_ENV_VAR_STATUS" 16127 "GD_ID_EMM_DEBUG_SET_RESET_ERROR" 16128 "GD_ID_EMM_STATUS_R" 16172 "GD_ID_EMM_ERR_LOG_DELETED_Status" 16172 "GD_ID_EMM_ERR_LOG_DELETED" 16222 "GD_ID_EMM_ERR_ACTIVE_Status" 16222 "GD_ID_EMM_ERR_ACTIVE" 16366 "GD_ID_EMM_ErrorManagement_Status" 16366 "GD_ID_EMM_ErrorManagement" 16383 "GD_ID_EMM_LifeMessage" 28161 "GD_ID_4WS_REQUESTED_MODE" 28162 "GD_ID_4WS_CURRENT_MODE" 28166 "GD_ID_4WS_JOG_LEFT_Status" 28166 "GD_ID_4WS_JOG_LEFT" 28167 "GD_ID_4WS_JOG_RIGHT_Status" 28167 "GD_ID_4WS_JOG_RIGHT" 28168 "GD_ID_4WS_JOG_CLEAR_Status" 28168 "GD_ID_4WS_JOG_CLEAR" 28169 "GD_ID_4WS_JOG_ANGLE_Status" 28169 "GD_ID_4WS_JOG_ANGLE" 28175 "GD_ID_4WS_UI_FRONT_ANGLE_Status" 28175 "GD_ID_4WS_UI_FRONT_ANGLE" 28176 "GD_ID_4WS_UI_REAR_ANGLE_Status" 28176 "GD_ID_4WS_UI_REAR_ANGLE" 28178 "GD_ID_4WS_MACHINE_REAR_ANGLE" 28179 "GD_ID_4WS_REAR_ANGLE_SETPOINT" 28180 "GD_ID_4WS_REAR_ANGLE_SENSOR_VALUE" 28183 "GD_ID_4WS_CURRENT_CONTROL_KP_Status" 28183 "GD_ID_4WS_CURRENT_CONTROL_KP" 28184 "GD_ID_4WS_CURRENT_CONTROL_KI_Status" 28184 "GD_ID_4WS_CURRENT_CONTROL_KI" 28185 "GD_ID_4WS_REAR_ANGLE_TARGET_Status" 28185 "GD_ID_4WS_REAR_ANGLE_TARGET" 28186 "GD_ID_4WS_LEFT_PWM_Status" 28186 "GD_ID_4WS_LEFT_PWM" 28187 "GD_ID_4WS_RIGHT_PWM_Status" 28187 "GD_ID_4WS_RIGHT_PWM" 28191 "GD_ID_4WS_RIGHT_VALVE_COIL_CURRENT" 28192 "GD_ID_4WS_LEFT_VALVE_COIL_CURRENT" 28193 "GD_ID_4WS_ANGLE_CONTROL_KP_Status" 28193 "GD_ID_4WS_ANGLE_CONTROL_KP" 28194 "GD_ID_4WS_ANGLE_CONTROL_KI_Status" 28194 "GD_ID_4WS_ANGLE_CONTROL_KI" 28195 "GD_ID_4WS_TARGET_CURRENT_Status" 28195 "GD_ID_4WS_TARGET_CURRENT" 28196 "GD_ID_4WS_CURRENT_CONTROL_KC_Status" 28196 "GD_ID_4WS_CURRENT_CONTROL_KC" 28201 "GD_ID_4WS_COMMAND_CURRENT_Status" 28201 "GD_ID_4WS_COMMAND_CURRENT" 28202 "GD_ID_4WS_ACTIVE_CURRENT_LOOP" 28203 "GD_ID_4WS_UNFILTERED_REAR_ANGLE_Status" 28203 "GD_ID_4WS_UNFILTERED_REAR_ANGLE" 28210 "GD_ID_4WS_START_CURRENT_CALIB_COMMAND" 28211 "GD_ID_4WS_START_CURRENT_CALIB_STATUS" 28260 "GD_ID_4WS_REAR_ANGLE_CALIB_COMMAND" 28261 "GD_ID_4WS_REAR_ANGLE_CALIB_STATUS" 28654 "GD_ID_4WS_ErrorManagement_Status" 28654 "GD_ID_4WS_ErrorManagement" 28671 "GD_ID_4WS_LifeMessage" 6638 "GD_ID_DIAGNOSE_ErrorManagement_Status" 6638 "GD_ID_DIAGNOSE_ErrorManagement" 6655 "GD_ID_DIAGNOSE_LifeMessage" 16384 "GD_ID_CEAG_FIELD_HEADLAND_WIDTH_RW" 16385 "GD_ID_CEAG_FIELD_HEADLAND_DISTANCE_RW" 16400 "GD_ID_CEAG_IMPLEMENT_PATHTOPATHDISTANCE_RW" 16402 "GD_ID_CEAG_IMPLEMENT_LINKAGETYPE_RW" 16403 "GD_ID_CEAG_IMPLEMENT_LINKAGEFRONT_RW" 16404 "GD_ID_CEAG_IMPLEMENT_LINKAGEREAR_RW" 16405 "GD_ID_CEAG_IMPLEMENT_MINIMUMRADIUS_RW" 16406 "GD_ID_CEAG_IMPLEMENT_OFFSET_SETOFFSET_RW" 16407 "GD_ID_CEAG_IMPLEMENT_OFFSET_SETWORKINGWIDTH_RW" 16408 "GD_ID_CEAG_IMPLEMENT_OFFSET_STATUS_RW" 16416 "GD_ID_CEAG_COMMUNICATION_COMMAND_W" 16417 "GD_ID_CEAG_COMMUNICATION_COMMAND_STATUS_R" 16432 "GD_ID_CEAG_PATH_DATA_BLKRW" 16435 "GD_ID_CEAG_PATH_AB_ANGLE_RW" 16436 "GD_ID_CEAG_PATH_AB_DISTANCE_R" 16439 "GD_ID_CEAG_PATH_PIVOT_CENTERPOINT_ACCURACY_R" 16441 "GD_ID_CEAG_PATH_SEGMENT_ACTUAL_R" 16442 "GD_ID_CEAG_PATH_NUMBER_ACTUAL_R" 16443 "GD_ID_CEAG_PATH_LP_SLOPE_RW_Status" 16443 "GD_ID_CEAG_PATH_LP_SLOPE_RW" 16444 "GD_ID_CEAG_PATH_DATA_ACKNOWLEDGE_R_Status" 16444 "GD_ID_CEAG_PATH_DATA_ACKNOWLEDGE_R" 16448 "GD_ID_CEAG_NUDGEOFFSET_MANUAL_RW" 16449 "GD_ID_CEAG_NUDGEOFFSET_TOTAL_R_Status" 16449 "GD_ID_CEAG_NUDGEOFFSET_TOTAL_R" 16450 "GD_ID_CEAG_OFFSET_NORTH" 16451 "GD_ID_CEAG_OFFSET_EAST" 16464 "GD_ID_CEAG_AUTOTURN_SETTINGS_RW" 16465 "GD_ID_CEAG_AUTOTURN_DIMENSIONS_R" 16466 "GD_ID_CEAG_AUTOTURN_STATUS_R" 16471 "GD_ID_CEAG_STATUSPAGE_POSITION_GNSS_R_Status" 16471 "GD_ID_CEAG_STATUSPAGE_POSITION_GNSS_R" 16472 "GD_ID_CEAG_STATUSPAGE_CORRECTION_R_Status" 16472 "GD_ID_CEAG_STATUSPAGE_CORRECTION_R" 16473 "GD_ID_CEAG_STATUSPAGE_INERTIAL_R_Status" 16473 "GD_ID_CEAG_STATUSPAGE_INERTIAL_R" 16474 "GD_ID_CEAG_STATUSPAGE_STEERING_SUBSYSTEM_R_Status" 16474 "GD_ID_CEAG_STATUSPAGE_STEERING_SUBSYSTEM_R" 16475 "GD_ID_CEAG_STATUSPAGE_XTRK_R_Status" 16475 "GD_ID_CEAG_STATUSPAGE_XTRK_R" 16476 "GD_ID_CEAG_STATUSPAGE_HEADINGTOWAYLINE_R_Status" 16476 "GD_ID_CEAG_STATUSPAGE_HEADINGTOWAYLINE_R" 16477 "GD_ID_CEAG_STATUSPAGE_VELOCITY_R_Status" 16477 "GD_ID_CEAG_STATUSPAGE_VELOCITY_R" 16478 "GD_ID_CEAG_STATUSPAGE_CALIBRATION_R_Status" 16478 "GD_ID_CEAG_STATUSPAGE_CALIBRATION_R" 16479 "GD_ID_CEAG_STATUSPAGE_SYSTEM_R_Status" 16479 "GD_ID_CEAG_STATUSPAGE_SYSTEM_R" 16480 "GD_ID_CEAG_STATUS_XTRK_R_Status" 16480 "GD_ID_CEAG_STATUS_XTRK_R" 16481 "GD_ID_CEAG_STATUS_HEADING_R" 16482 "GD_ID_CEAG_STATUS_STEERING_R" 16483 "GD_ID_CEAG_STEERING_SENSITIVITY_LINEACQUISITION_RW" 16484 "GD_ID_CEAG_STEERING_SENSITIVITY_ONLINE_RW" 16485 "GD_ID_CEAG_SYSTEM_STANDBYTIME_RW" 16486 "GD_ID_CEAG_SYSTEM_POWERSUPPLY_INPUT_R" 16487 "GD_ID_CEAG_SYSTEM_POWERSUPPLY_OUTPUT_R" 16488 "GD_ID_CEAG_SYSTEM_ALTITUDE_GEOIDAL_SEPARATION_R" 16489 "GD_ID_CEAG_STEERING_DISENGAGE_REASON_R" 16496 "GD_ID_CEAG_GNSS_GPS_SATVISIBLE_R" 16497 "GD_ID_CEAG_GNSS_GPS_SATUSED_R" 16498 "GD_ID_CEAG_GNSS_GLONASS_SATVISIBLE_R" 16499 "GD_ID_CEAG_GNSS_GLONASS_SATUSED_R" 16500 "GD_ID_CEAG_GNSS_GALILEO_SATVISIBLE_R" 16501 "GD_ID_CEAG_GNSS_GALILEO_SATUSED_R" 16503 "GD_ID_CEAG_GNSS_VALIDPOSITION_R_Status" 16503 "GD_ID_CEAG_GNSS_VALIDPOSITION_R" 16504 "GD_ID_CEAG_GNSS_POSITION_ACTUAL_BLKR" 16505 "GD_ID_CEAG_GNSS_DOP_R" 16506 "GD_ID_CEAG_GNSS_TIME_HOURMINUTE_R" 16507 "GD_ID_CEAG_GNSS_TIME_SECOND_R" 16508 "GD_ID_CEAG_GNSS_ANTENNA_INSTALLATION_RW_Status" 16508 "GD_ID_CEAG_GNSS_ANTENNA_INSTALLATION_RW" 16509 "GD_ID_CEAG_GNSS_VELOCITY_R" 16510 "GD_ID_CEAG_GNSS_DISTANCE_R" 16519 "GD_ID_CEAG_CORRECTIONSIGNAL_RTKNETWORK_ROAMING_RW_Status" 16519 "GD_ID_CEAG_CORRECTIONSIGNAL_RTKNETWORK_ROAMING_RW" 16520 "GD_ID_CEAG_CORRECTIONSIGNAL_RTK_DUHF2_CHANNELSPACING_RW" 16521 "GD_ID_CEAG_CORRECTIONSIGNAL_RTK_DUHF2_PROTOCOL_RW" 16522 "GD_ID_CEAG_CORRECTIONSIGNAL_RTK_DUHF2_ERRORCORRECTION_RW" 16523 "GD_ID_CEAG_CORRECTIONSIGNAL_RTK_FH915_CHANNEL_RW" 16524 "GD_ID_CEAG_CORRECTIONSIGNAL_RTK_FH915_LOCATION_RW" 16525 "GD_ID_CEAG_CORRECTIONSIGNAL_RTK_FH915_NETWORKID_RW" 16526 "GD_ID_CEAG_CORRECTIONSIGNAL_OMNISTAR_FREQUENCY_HIGH_RW" 16527 "GD_ID_CEAG_CORRECTIONSIGNAL_OMNISTAR_FREQUENCY_LOW_RW" 16528 "GD_ID_CEAG_CORRECTIONSIGNAL_TYPE_SELECTED_RW" 16529 "GD_ID_CEAG_CORRECTIONSIGNAL_OMNISTAR_BAUDRATE_RW" 16530 "GD_ID_CEAG_CORRECTIONSIGNAL_VBS_EXPIRYDATE_DAYMONTH_R" 16531 "GD_ID_CEAG_CORRECTIONSIGNAL_BARGRAPH_R" 16532 "GD_ID_CEAG_CORRECTIONSIGNAL_VBS_EXPIRYDATE_YEAR_R" 16533 "GD_ID_CEAG_CORRECTIONSIGNAL_HP_XP_EXPIRYDATE_DAYMONTH_R" 16535 "GD_ID_CEAG_CORRECTIONSIGNAL_HP_XP_EXPIRYDATE_YEAR_R" 16536 "GD_ID_CEAG_CORRECTIONSIGNAL_STATUS_R_Status" 16536 "GD_ID_CEAG_CORRECTIONSIGNAL_STATUS_R" 16537 "GD_ID_CEAG_CORRECTIONSIGNAL_OMNISTAR_SERIALNUMBER_HIGH_R" 16538 "GD_ID_CEAG_CORRECTIONSIGNAL_OMNISTAR_SERIALNUMBER_LOW_R" 16539 "GD_ID_CEAG_CORRECTIONSIGNAL_RTK_AGCO_CHANNEL_RW" 16540 "GD_ID_CEAG_CORRECTIONSIGNAL_RTK_AGCO_FREQUENCY_HIGH_R" 16541 "GD_ID_CEAG_CORRECTIONSIGNAL_RTK_AGCO_FREQUENCY_LOW_R" 16542 "GD_ID_CEAG_CORRECTIONSIGNAL_RTK_AGCO_RADIOTYPE_R" 16543 "GD_ID_CEAG_CORRECTIONSIGNAL_RTK_EXTERNAL_SERIALINTERFACE_RW" 16544 "GD_ID_CEAG_CORRECTIONSIGNAL_RTK_RADIOINSTALLATION_RW_Status" 16544 "GD_ID_CEAG_CORRECTIONSIGNAL_RTK_RADIOINSTALLATION_RW" 16545 "GD_ID_CEAG_CORRECTIONSIGNAL_RTK_AGCO_CORRECTIONFORMAT_RW" 16546 "GD_ID_CEAG_CORRECTIONSIGNAL_RTK_EXTERNAL_CORRECTIONFORMAT_RW" 16547 "GD_ID_CEAG_CORRECTIONSIGNAL_RTK_GPS_SATVISIBLE_R" 16548 "GD_ID_CEAG_CORRECTIONSIGNAL_RTK_GPS_SATUSED_R" 16549 "GD_ID_CEAG_CORRECTIONSIGNAL_RTK_GLONASS_SATVISIBLE_R" 16550 "GD_ID_CEAG_CORRECTIONSIGNAL_RTK_GLONASS_SATUSED_R" 16551 "GD_ID_CEAG_CORRECTIONSIGNAL_RTK_GALILEO_SATVISIBLE_R" 16552 "GD_ID_CEAG_CORRECTIONSIGNAL_RTK_GALILEO_SATUSED_R" 16553 "GD_ID_CEAG_CORRECTIONSIGNAL_RTK_RADIO_CONFIGURABLE_R" 16554 "GD_ID_CEAG_CORRECTIONSIGNAL_RTK_BASELINE_R" 16555 "GD_ID_CEAG_CORRECTIONSIGNAL_SIGNALLAG_R" 16556 "GD_ID_CEAG_CORRECTIONSIGNAL_FALLBACK_RW_Status" 16556 "GD_ID_CEAG_CORRECTIONSIGNAL_FALLBACK_RW" 16557 "GD_ID_CEAG_CORRECTIONSIGNAL_ACCURACY_GNSSANTENNA_R" 16558 "GD_ID_CEAG_CORRECTIONSIGNAL_ACCURACY_VEHICLEREFERENCEPOINT_R" 16559 "GD_ID_CEAG_CORRECTIONSIGNAL_AUTHORISATIONLEVEL_R" 16560 "GD_ID_CEAG_CORRECTIONSIGNAL_RTKNETWORK_GSM_NUMBER_BLKRW" 16561 "GD_ID_CEAG_CORRECTIONSIGNAL_RTKNETWORK_GSM_PIN_BLKRW" 16562 "GD_ID_CEAG_CORRECTIONSIGNAL_RTKNETWORK_CORRECTIONFORMAT_RW_Status" 16562 "GD_ID_CEAG_CORRECTIONSIGNAL_RTKNETWORK_CORRECTIONFORMAT_RW" 16563 "GD_ID_CEAG_CORRECTIONSIGNAL_RTKNETWORK_GPRS_ACCESSPOINT_BLKRW" 16564 "GD_ID_CEAG_CORRECTIONSIGNAL_RTKNETWORK_GPRS_IPADDRESS_BLKRW" 16565 "GD_ID_CEAG_CORRECTIONSIGNAL_RTKNETWORK_GPRS_PORT_BLKRW" 16566 "GD_ID_CEAG_CORRECTIONSIGNAL_RTKNETWORK_GPRS_MOUNTPOINT_BLKRW" 16567 "GD_ID_CEAG_CORRECTIONSIGNAL_RTKNETWORK_GPRS_USERNAME_CONNECTIONPOVIDER_BLKRW" 16568 "GD_ID_CEAG_CORRECTIONSIGNAL_RTKNETWORK_GPRS_PASSWORD_CONNECTIONPROVIDER_BLKRW" 16569 "GD_ID_CEAG_CORRECTIONSIGNAL_RTKNETWORK_NMEA_DATA_RW" 16570 "GD_ID_CEAG_CORRECTIONSIGNAL_TYPE_ACTUAL_R" 16571 "GD_ID_CEAG_CORRECTIONSIGNAL_RTKNETWORK_GPRS_USERNAME_SIGNALPROVIDER_BLKRW" 16572 "GD_ID_CEAG_CORRECTIONSIGNAL_RTKNETWORK_GPRS_PASSWORD_SIGNALPROVIDER_BLKRW" 16573 "GD_ID_CEAG_CORRECTIONSIGNAL_RTKNETWORK_GSM_GPRS_CONNECTION_RW_Status" 16573 "GD_ID_CEAG_CORRECTIONSIGNAL_RTKNETWORK_GSM_GPRS_CONNECTION_RW" 16574 "GD_ID_CEAG_CORRECTIONSIGNAL_RTKNETWORK_GPRS_PIN_BLKRW" 16575 "GD_ID_CEAG_CORRECTIONSIGNAL_RTKNETWORK_MODE_RW_Status" 16575 "GD_ID_CEAG_CORRECTIONSIGNAL_RTKNETWORK_MODE_RW" 16576 "GD_ID_CEAG_NMEA_SERIALINTERFACE_RW" 16579 "GD_ID_CEAG_NMEA_DATA_1_RW" 16580 "GD_ID_CEAG_NMEA_DATA_2_RW" 16581 "GD_ID_CEAG_NMEA_DATA_3_RW" 16582 "GD_ID_CEAG_NMEA_DATA_4_RW" 16583 "GD_ID_CEAG_NMEA_DATA_5_RW" 16584 "GD_ID_CEAG_NMEA_OUTPUT_RW" 16606 "GD_ID_CEAG_SENSOR_IMU_ROLL_R_Status" 16606 "GD_ID_CEAG_SENSOR_IMU_ROLL_R" 16607 "GD_ID_CEAG_SENSOR_IMU_PITCH_R_Status" 16607 "GD_ID_CEAG_SENSOR_IMU_PITCH_R" 16608 "GD_ID_CEAG_SENSOR_IMU_YAW_R_Status" 16608 "GD_ID_CEAG_SENSOR_IMU_YAW_R" 16609 "GD_ID_CEAG_SENSOR_IMU_MOUNTINGBIAS_R_Status" 16609 "GD_ID_CEAG_SENSOR_IMU_MOUNTINGBIAS_R" 16610 "GD_ID_CEAG_SENSOR_IMU_DHEADING_R" 16611 "GD_ID_CEAG_SENSOR_IMU_WARMING_TIME_R_Status" 16611 "GD_ID_CEAG_SENSOR_IMU_WARMING_TIME_R" 16612 "GD_ID_CEAG_SENSOR_IMU_CALIBRATION_TIME_R_Status" 16612 "GD_ID_CEAG_SENSOR_IMU_CALIBRATION_TIME_R" 16613 "GD_ID_CEAG_ID_FA_KALIB_IMU_SET_R" 16614 "GD_ID_CEAG_ID_FA_KALIB_IMU_GET_W" 16639 "GD_ID_CEAG_ID_GNSS_ANTENNA_TYPE_R" 16640 "GD_ID_CEAG_ID_GNSS_ANTENNA_MODEL_BLKR" 16641 "GD_ID_CEAG_ID_GNSS_ANTENNA_PSN_BLKR" 16642 "GD_ID_CEAG_ID_GNSS_ANTENNA_HWVERSION_BLKR" 16643 "GD_ID_CEAG_ID_GNSS_ANTENNA_SWVERSION_BLKR" 16644 "GD_ID_CEAG_ID_GNSS_ANTENNA_BOOTVERSION_BLKR" 16645 "GD_ID_CEAG_ID_GNSS_ANTENNA_COMPILE_DATE_BLKR" 16646 "GD_ID_CEAG_ID_GNSS_ANTENNA_AUTHCODE_BLKW" 16650 "GD_ID_CEAG_ID_CORRECTIONSIGNAL_NTRIP_DELAY_R" 16878 "GD_ID_CEAG_ErrorManagement_Status" 16878 "GD_ID_CEAG_ErrorManagement" 16895 "GD_ID_CEAG_LifeMessage" 27648 "GD_ID_HC_TARGET_STATE_Status" 27648 "GD_ID_HC_TARGET_STATE" 27649 "GD_ID_HC_MACHINE_STATE_Status" 27649 "GD_ID_HC_MACHINE_STATE" 27650 "GD_ID_HC_LEG_STATE_FRONTLEFT" 27651 "GD_ID_HC_LEG_STATE_FRONTRIGHT" 27652 "GD_ID_HC_LEG_STATE_REARLEFT" 27653 "GD_ID_HC_LEG_STATE_REARRIGHT" 27654 "GD_ID_HC_TARGET_CLEARANCE_FL" 27655 "GD_ID_HC_TARGET_CLEARANCE_FR" 27656 "GD_ID_HC_TARGET_CLEARANCE_RL" 27657 "GD_ID_HC_TARGET_CLEARANCE_RR" 27658 "GD_ID_HC_ACTUAL_CLEARANCE_FL_Status" 27658 "GD_ID_HC_ACTUAL_CLEARANCE_FL" 27659 "GD_ID_HC_ACTUAL_CLEARANCE_FR_Status" 27659 "GD_ID_HC_ACTUAL_CLEARANCE_FR" 27660 "GD_ID_HC_ACTUAL_CLEARANCE_RL_Status" 27660 "GD_ID_HC_ACTUAL_CLEARANCE_RL" 27661 "GD_ID_HC_ACTUAL_CLEARANCE_RR_Status" 27661 "GD_ID_HC_ACTUAL_CLEARANCE_RR" 27662 "GD_ID_HC_STROKE_LEGNTH_RAW_FL" 27663 "GD_ID_HC_STROKE_LEGNTH_RAW_FR" 27664 "GD_ID_HC_STROKE_LEGNTH_RAW_RL" 27665 "GD_ID_HC_STROKE_LEGNTH_RAW_RR" 27666 "GD_ID_HC_OKAY_TO_TRANSITION" 27667 "GD_ID_HC_CYLINDER_PWM_EXTEND_FL" 27668 "GD_ID_HC_CYLINDER_PWM_EXTEND_FR" 27669 "GD_ID_HC_CYLINDER_PWM_EXTEND_RL" 27670 "GD_ID_HC_CYLINDER_PWM_EXTEND_RR" 27671 "GD_ID_HC_CYLINDER_PWM_RETRCT_FL" 27672 "GD_ID_HC_CYLINDER_PWM_RETRCT_FR" 27673 "GD_ID_HC_CYLINDER_PWM_RETRCT_RL" 27674 "GD_ID_HC_CYLINDER_PWM_RETRCT_RR" 27675 "GD_ID_HC_LADDER_EXTEND_Status" 27675 "GD_ID_HC_LADDER_EXTEND" 27676 "GD_ID_HC_REQUEST_CCO_OFF_Status" 27676 "GD_ID_HC_REQUEST_CCO_OFF" 27677 "GD_ID_HC_USER_WARNINGS" 27682 "GD_ID_HC_MOVEMENT_ERROR_FL" 27679 "GD_ID_HC_MOVEMENT_ERROR_FR" 27680 "GD_ID_HC_MOVEMENT_ERROR_RL" 27681 "GD_ID_HC_MOVEMENT_ERROR_RR" 27678 "GD_ID_HC_MANUAL_OVERRIDE_Status" 27678 "GD_ID_HC_MANUAL_OVERRIDE" 27683 "GD_ID_HC_CAL_STATE_Status" 27683 "GD_ID_HC_CAL_STATE" 27684 "GD_ID_HC_CAL_CMD" 27685 "GD_ID_HC_SENSOR_RAW_FL" 27686 "GD_ID_HC_SENSOR_RAW_FR" 27687 "GD_ID_HC_SENSOR_RAW_RL" 27688 "GD_ID_HC_SENSOR_RAW_RR" 27689 "GD_ID_HC_COIL_RAW_EXTEND_FL" 27690 "GD_ID_HC_COIL_RAW_RETRCT_FL" 27691 "GD_ID_HC_COIL_RAW_EXTEND_FR" 27692 "GD_ID_HC_COIL_RAW_RETRCT_FR" 27693 "GD_ID_HC_COIL_RAW_EXTEND_RL" 27694 "GD_ID_HC_COIL_RAW_RETRCT_RL" 27695 "GD_ID_HC_COIL_RAW_EXTEND_RR" 27696 "GD_ID_HC_COIL_RAW_RETRCT_RR" 27697 "GD_ID_HC_STROKE_LEGNTH_FILTER_FL_Status" 27697 "GD_ID_HC_STROKE_LEGNTH_FILTER_FL" 27698 "GD_ID_HC_STROKE_LEGNTH_FILTER_FR_Status" 27698 "GD_ID_HC_STROKE_LEGNTH_FILTER_FR" 27699 "GD_ID_HC_STROKE_LEGNTH_FILTER_RL_Status" 27699 "GD_ID_HC_STROKE_LEGNTH_FILTER_RL" 27700 "GD_ID_HC_STROKE_LEGNTH_FILTER_RR_Status" 27700 "GD_ID_HC_STROKE_LEGNTH_FILTER_RR" 28142 "GD_ID_HC_ErrorManagement_Status" 28142 "GD_ID_HC_ErrorManagement" 28159 "GD_ID_HC_LifeMessage" 32480 "GD_ID_ACM_BT_SERVER_ADDR_ROUTER_Status" 32480 "GD_ID_ACM_BT_SERVER_ADDR_ROUTER" 32750 "GD_ID_ACM_ErrorManagement_Status" 32750 "GD_ID_ACM_ErrorManagement" 32767 "GD_ID_ACM_LifeMessage"  ;

SG_MUL_VAL_ 1557 GD_ID_DRIVE_AIR_PRESSURE DataIndex 2049-2049;
SG_MUL_VAL_ 1557 GD_ID_DRIVE_HYDRAULICS_ENABLE_Status DataIndex 2050-2050;
SG_MUL_VAL_ 1557 GD_ID_DRIVE_HYDRAULICS_ENABLE DataIndex 2050-2050;
SG_MUL_VAL_ 1557 GD_ID_DRIVE_REQUEST_HYD_ENABLE_OFF_Status DataIndex 2051-2051;
SG_MUL_VAL_ 1557 GD_ID_DRIVE_REQUEST_HYD_ENABLE_OFF DataIndex 2051-2051;
SG_MUL_VAL_ 1557 GD_ID_DRIVE_BRAKE_PEDAL_POSITION_A DataIndex 2052-2052;
SG_MUL_VAL_ 1557 GD_ID_DRIVE_BRAKE_PEDAL_POSITION_B DataIndex 2053-2053;
SG_MUL_VAL_ 1557 GD_ID_DRIVE_BRAKE_PEDAL_POSITION DataIndex 2054-2054;
SG_MUL_VAL_ 1557 GD_ID_DRIVE_HYD_MOT_RPM_FR DataIndex 2055-2055;
SG_MUL_VAL_ 1557 GD_ID_DRIVE_HYD_MOT_RPM_RR DataIndex 2056-2056;
SG_MUL_VAL_ 1557 GD_ID_DRIVE_HYD_MOT_RPM_RL DataIndex 2057-2057;
SG_MUL_VAL_ 1557 GD_ID_DRIVE_HYD_MOT_RPM_FL DataIndex 2058-2058;
SG_MUL_VAL_ 1557 GD_ID_DRIVE_FORWARD_SS_DEFAULT_SPEED DataIndex 2061-2061;
SG_MUL_VAL_ 1557 GD_ID_DRIVE_REVERSE_SS_DEFAULT_SPEED DataIndex 2062-2062;
SG_MUL_VAL_ 1557 GD_ID_DRIVE_WHEEL_BASED_MACHINE_SPEED DataIndex 2063-2063;
SG_MUL_VAL_ 1557 GD_ID_DRIVE_DANFOSS_IN_SV_STATE_COMMANDED_Status DataIndex 2064-2064;
SG_MUL_VAL_ 1557 GD_ID_DRIVE_DANFOSS_IN_SV_STATE_COMMANDED DataIndex 2064-2064;
SG_MUL_VAL_ 1557 GD_ID_DRIVE_DANFOSS_OUT_SV_STATE_ACTUAL_Status DataIndex 2065-2065;
SG_MUL_VAL_ 1557 GD_ID_DRIVE_DANFOSS_OUT_SV_STATE_ACTUAL DataIndex 2065-2065;
SG_MUL_VAL_ 1557 GD_ID_DRIVE_DANFOSS_IN_SV_SPEED DataIndex 2066-2066;
SG_MUL_VAL_ 1557 GD_ID_DRIVE_DANFOSS_OUT_DRIVE_MODE_ACTUAL_Status DataIndex 2067-2067;
SG_MUL_VAL_ 1557 GD_ID_DRIVE_DANFOSS_OUT_DRIVE_MODE_ACTUAL DataIndex 2067-2067;
SG_MUL_VAL_ 1557 GD_ID_DRIVE_DANFOSS_IN_DRIVE_MODE_COMMANDED_Status DataIndex 2068-2068;
SG_MUL_VAL_ 1557 GD_ID_DRIVE_DANFOSS_IN_DRIVE_MODE_COMMANDED DataIndex 2068-2068;
SG_MUL_VAL_ 1557 GD_ID_DRIVE_SV_1_Status DataIndex 2069-2069;
SG_MUL_VAL_ 1557 GD_ID_DRIVE_SV_1 DataIndex 2069-2069;
SG_MUL_VAL_ 1557 GD_ID_DRIVE_SV_2_Status DataIndex 2070-2070;
SG_MUL_VAL_ 1557 GD_ID_DRIVE_SV_2 DataIndex 2070-2070;
SG_MUL_VAL_ 1557 GD_ID_DRIVE_SV_STATE DataIndex 2071-2071;
SG_MUL_VAL_ 1557 GD_ID_DRIVE_MAX_ENGINE_DROP DataIndex 2072-2072;
SG_MUL_VAL_ 1557 GD_ID_DRIVE_CALIB_STATE_BRAKE_PEDAL_Status DataIndex 2076-2076;
SG_MUL_VAL_ 1557 GD_ID_DRIVE_CALIB_STATE_BRAKE_PEDAL DataIndex 2076-2076;
SG_MUL_VAL_ 1557 GD_ID_DRIVE_MAX_SV_SPEED DataIndex 2077-2077;
SG_MUL_VAL_ 1557 GD_ID_DRIVE_PRESSURE_A DataIndex 2078-2078;
SG_MUL_VAL_ 1557 GD_ID_DRIVE_PRESSURE_B DataIndex 2079-2079;
SG_MUL_VAL_ 1557 GD_ID_DRIVE_CHARGE_PRESSURE DataIndex 2080-2080;
SG_MUL_VAL_ 1557 GD_ID_DRIVE_DASH_DISPLAYED_ENGINE_SPEED DataIndex 2084-2084;
SG_MUL_VAL_ 1557 GD_ID_DRIVE_FRONT_STEER_ANGLE DataIndex 2085-2085;
SG_MUL_VAL_ 1557 GD_ID_DRIVE_DANFOSS_OUT_PARKBRK_REQUEST_Status DataIndex 2086-2086;
SG_MUL_VAL_ 1557 GD_ID_DRIVE_DANFOSS_OUT_PARKBRK_REQUEST DataIndex 2086-2086;
SG_MUL_VAL_ 1557 GD_ID_DRIVE_DANFOSS_OUT_CCO_VALVE_REQUEST_Status DataIndex 2087-2087;
SG_MUL_VAL_ 1557 GD_ID_DRIVE_DANFOSS_OUT_CCO_VALVE_REQUEST DataIndex 2087-2087;
SG_MUL_VAL_ 1557 GD_ID_DRIVE_CCO_VALVE_COMMAND_Status DataIndex 2088-2088;
SG_MUL_VAL_ 1557 GD_ID_DRIVE_CCO_VALVE_COMMAND DataIndex 2088-2088;
SG_MUL_VAL_ 1557 GD_ID_DRIVE_TIRE_RCI DataIndex 2092-2092;
SG_MUL_VAL_ 1557 GD_ID_DRIVE_DASH_DISPLAYED_MACHINE_SPEED2 DataIndex 2094-2094;
SG_MUL_VAL_ 1557 GD_ID_DRIVE_CARGO_OVER_WEIGHT_Status DataIndex 2095-2095;
SG_MUL_VAL_ 1557 GD_ID_DRIVE_CARGO_OVER_WEIGHT DataIndex 2095-2095;
SG_MUL_VAL_ 1557 GD_ID_DRIVE_ROGATOR_MACHINE_CONFIGURATION DataIndex 2096-2096;
SG_MUL_VAL_ 1557 GD_ID_DRIVE_TIRE_ROLLING_CIRCUMFERENCE DataIndex 2097-2097;
SG_MUL_VAL_ 1557 GD_ID_DRIVE_BRAKE_LIGHT_COMMAND_Status DataIndex 2098-2098;
SG_MUL_VAL_ 1557 GD_ID_DRIVE_BRAKE_LIGHT_COMMAND DataIndex 2098-2098;
SG_MUL_VAL_ 1557 GD_ID_DRIVE_TARGET_MACHINE_SPEED DataIndex 2099-2099;
SG_MUL_VAL_ 1557 GD_ID_DRIVE_MAX_MACHINE_SPEED DataIndex 2100-2100;
SG_MUL_VAL_ 1557 GD_ID_DRIVE_EXPECTED_MACHINE_SPEED DataIndex 2101-2101;
SG_MUL_VAL_ 1557 GD_ID_DRIVE_CALIB_BRAKE_PEDAL_START_Status DataIndex 2111-2111;
SG_MUL_VAL_ 1557 GD_ID_DRIVE_CALIB_BRAKE_PEDAL_START DataIndex 2111-2111;
SG_MUL_VAL_ 1557 GD_ID_DRIVE_CALIB_BRAKE_PEDAL_ACTIVE_Status DataIndex 2112-2112;
SG_MUL_VAL_ 1557 GD_ID_DRIVE_CALIB_BRAKE_PEDAL_ACTIVE DataIndex 2112-2112;
SG_MUL_VAL_ 1557 GD_ID_DRIVE_CALIB_BRAKE_PEDAL_DOWN_Status DataIndex 2113-2113;
SG_MUL_VAL_ 1557 GD_ID_DRIVE_CALIB_BRAKE_PEDAL_DOWN DataIndex 2113-2113;
SG_MUL_VAL_ 1557 GD_ID_DRIVE_CALIB_BRAKE_PEDAL_DOWN_RET_Status DataIndex 2114-2114;
SG_MUL_VAL_ 1557 GD_ID_DRIVE_CALIB_BRAKE_PEDAL_DOWN_RET DataIndex 2114-2114;
SG_MUL_VAL_ 1557 GD_ID_DRIVE_CALIB_BRAKE_PEDAL_UP_Status DataIndex 2115-2115;
SG_MUL_VAL_ 1557 GD_ID_DRIVE_CALIB_BRAKE_PEDAL_UP DataIndex 2115-2115;
SG_MUL_VAL_ 1557 GD_ID_DRIVE_CALIB_BRAKE_PEDAL_UP_RET_Status DataIndex 2116-2116;
SG_MUL_VAL_ 1557 GD_ID_DRIVE_CALIB_BRAKE_PEDAL_UP_RET DataIndex 2116-2116;
SG_MUL_VAL_ 1557 GD_ID_DRIVE_CALIB_BRAKE_PEDAL_ACCEPT_Status DataIndex 2117-2117;
SG_MUL_VAL_ 1557 GD_ID_DRIVE_CALIB_BRAKE_PEDAL_ACCEPT DataIndex 2117-2117;
SG_MUL_VAL_ 1557 GD_ID_DRIVE_CALIB_BRAKE_PEDAL_DECLINE_Status DataIndex 2118-2118;
SG_MUL_VAL_ 1557 GD_ID_DRIVE_CALIB_BRAKE_PEDAL_DECLINE DataIndex 2118-2118;
SG_MUL_VAL_ 1557 GD_ID_DRIVE_CALIB_BRAKE_PEDAL_PROCESSED_Status DataIndex 2119-2119;
SG_MUL_VAL_ 1557 GD_ID_DRIVE_CALIB_BRAKE_PEDAL_PROCESSED DataIndex 2119-2119;
SG_MUL_VAL_ 1557 GD_ID_DRIVE_CALIB_BRAKE_PEDAL_ERROR_Status DataIndex 2120-2120;
SG_MUL_VAL_ 1557 GD_ID_DRIVE_CALIB_BRAKE_PEDAL_ERROR DataIndex 2120-2120;
SG_MUL_VAL_ 1557 GD_ID_DRIVE_FIELD_STREET_STATE DataIndex 2121-2121;
SG_MUL_VAL_ 1557 GD_ID_DRIVE_DTM_ENALBED_IN_MANUAL_Status DataIndex 2122-2122;
SG_MUL_VAL_ 1557 GD_ID_DRIVE_DTM_ENALBED_IN_MANUAL DataIndex 2122-2122;
SG_MUL_VAL_ 1557 GD_ID_DRIVE_STATE DataIndex 2123-2123;
SG_MUL_VAL_ 1557 GD_ID_DRIVE_DTM_MIN_RPM DataIndex 2124-2124;
SG_MUL_VAL_ 1557 GD_ID_DRIVE_DTM_MAX_RPM DataIndex 2125-2125;
SG_MUL_VAL_ 1557 GD_ID_DRIVE_DRIVEPUMP_A_COMCURRENT DataIndex 2126-2126;
SG_MUL_VAL_ 1557 GD_ID_DRIVE_DRIVEPUMP_B_COMCURRENT DataIndex 2127-2127;
SG_MUL_VAL_ 1557 GD_ID_DRIVE_HYD_MOT_FR_COMCURRENT DataIndex 2128-2128;
SG_MUL_VAL_ 1557 GD_ID_DRIVE_HYD_MOT_RR_COMCURRENT DataIndex 2129-2129;
SG_MUL_VAL_ 1557 GD_ID_DRIVE_HYD_MOT_RL_COMCURRENT DataIndex 2130-2130;
SG_MUL_VAL_ 1557 GD_ID_DRIVE_HYD_MOT_FL_COMCURRENT DataIndex 2131-2131;
SG_MUL_VAL_ 1557 GD_ID_DRIVE_HYDRAULIC_OIl_TEMP DataIndex 2133-2133;
SG_MUL_VAL_ 1557 GD_ID_DRIVE_FUEL_LEVEL DataIndex 2135-2135;
SG_MUL_VAL_ 1557 GD_ID_DRIVE_PARKBRAKE_COMMAND_Status DataIndex 2137-2137;
SG_MUL_VAL_ 1557 GD_ID_DRIVE_PARKBRAKE_COMMAND DataIndex 2137-2137;
SG_MUL_VAL_ 1557 GD_ID_DRIVE_OPERATION_MODE DataIndex 2138-2138;
SG_MUL_VAL_ 1557 GD_ID_DRIVE_DRIVEPUMP_A_FEEDBACK_CURRENT DataIndex 2139-2139;
SG_MUL_VAL_ 1557 GD_ID_DRIVE_DRIVEPUMP_B_FEEDBACK_CURRENT DataIndex 2140-2140;
SG_MUL_VAL_ 1557 GD_ID_DRIVE_HYD_MOT_FR_FEEDBACK_CURRENT DataIndex 2141-2141;
SG_MUL_VAL_ 1557 GD_ID_DRIVE_HYD_MOT_RR_FEEDBACK_CURRENT DataIndex 2142-2142;
SG_MUL_VAL_ 1557 GD_ID_DRIVE_HYD_MOT_RL_FEEDBACK_CURRENT DataIndex 2143-2143;
SG_MUL_VAL_ 1557 GD_ID_DRIVE_HYD_MOT_FL_FEEDBACK_CURRENT DataIndex 2144-2144;
SG_MUL_VAL_ 1557 GD_ID_DRIVE_RADAR_SPEED DataIndex 2150-2150;
SG_MUL_VAL_ 1557 GD_ID_DRIVE_DASH_DISPLAYED_PARK_BRAKE_LED_Status DataIndex 2175-2175;
SG_MUL_VAL_ 1557 GD_ID_DRIVE_DASH_DISPLAYED_PARK_BRAKE_LED DataIndex 2175-2175;
SG_MUL_VAL_ 1557 GD_ID_DRIVE_CURRENT_GEAR DataIndex 2192-2192;
SG_MUL_VAL_ 1557 GD_ID_DRIVE_SELECTED_GEAR DataIndex 2193-2193;
SG_MUL_VAL_ 1557 GD_ID_DRIVE_DRIVE_PEDAL_POSITION DataIndex 2194-2194;
SG_MUL_VAL_ 1557 GD_ID_DRIVE_DASH_DISPLAYED_MACHINE_SPEED1 DataIndex 2207-2207;
SG_MUL_VAL_ 1557 GD_ID_DRIVE_DTM_COMMANDED_RPM DataIndex 2258-2258;
SG_MUL_VAL_ 1557 GD_ID_DRIVE_DISPLAY_UNITS_Status DataIndex 2300-2300;
SG_MUL_VAL_ 1557 GD_ID_DRIVE_DISPLAY_UNITS DataIndex 2300-2300;
SG_MUL_VAL_ 1557 GD_ID_DRIVE_RESET_DEFAULT_PROFILES_Status DataIndex 2348-2348;
SG_MUL_VAL_ 1557 GD_ID_DRIVE_RESET_DEFAULT_PROFILES DataIndex 2348-2348;
SG_MUL_VAL_ 1557 GD_ID_DRIVE_LEVER_ACCEL_PROFILE DataIndex 2349-2349;
SG_MUL_VAL_ 1557 GD_ID_DRIVE_LEVER_DECEL_PROFILE DataIndex 2350-2350;
SG_MUL_VAL_ 1557 GD_ID_DRIVE_PEDAL_ACCEL_PROFILE DataIndex 2351-2351;
SG_MUL_VAL_ 1557 GD_ID_DRIVE_PEDAL_DECEL_PROFILE DataIndex 2352-2352;
SG_MUL_VAL_ 1557 GD_ID_DRIVE_SV_ACCELDECEL_PROFILE DataIndex 2353-2353;
SG_MUL_VAL_ 1557 GD_ID_DRIVE_SHUTTLE_ACCELDECEL_PROFILE DataIndex 2355-2355;
SG_MUL_VAL_ 1557 GD_ID_DRIVE_DANFOSS_IN_OUTFAULTS DataIndex 2373-2373;
SG_MUL_VAL_ 1557 GD_ID_ASC_RAMP_RL_DECTM DataIndex 2374-2374;
SG_MUL_VAL_ 1557 GD_ID_ASC_PID_FL_KIUP_ASC DataIndex 2375-2375;
SG_MUL_VAL_ 1557 GD_ID_ASC_PID_FL_KIDOWN_ASC DataIndex 2376-2376;
SG_MUL_VAL_ 1557 GD_ID_ASC_PID_FL_KPUP_ASC DataIndex 2377-2377;
SG_MUL_VAL_ 1557 GD_ID_ASC_PID_FL_KPDOWN_ASC DataIndex 2378-2378;
SG_MUL_VAL_ 1557 GD_ID_ASC_PID_FL_KDUP_ASC DataIndex 2379-2379;
SG_MUL_VAL_ 1557 GD_ID_ASC_PID_FL_IRED DataIndex 2380-2380;
SG_MUL_VAL_ 1557 GD_ID_ASC_INCHING_INCHMODE DataIndex 2381-2381;
SG_MUL_VAL_ 1557 GD_ID_ASC_INCHING_TVOLINCH DataIndex 2382-2382;
SG_MUL_VAL_ 1557 GD_ID_ASC_REFSPDDISABLE_ABS_MINREFSPD_MMSEC DataIndex 2383-2383;
SG_MUL_VAL_ 1557 GD_ID_ASC_REFSPDDISABLE_ASC_MINREFSPD_MMSEC DataIndex 2384-2384;
SG_MUL_VAL_ 1557 GD_ID_ASC_REFSPDDISABLE_ABS_DECRAMP60K DataIndex 2385-2385;
SG_MUL_VAL_ 1557 GD_ID_ASC_FFPROFILES_REVBRAKINGFRONT_Y4_PTC2 DataIndex 2386-2386;
SG_MUL_VAL_ 1557 GD_ID_ASC_FFPROFILES_REVBRAKINGFRONT_Y5_PTC2 DataIndex 2387-2387;
SG_MUL_VAL_ 1557 GD_ID_ASC_FFPROFILES_REVBRAKINGFRONT_Y6_PTC2 DataIndex 2388-2388;
SG_MUL_VAL_ 1557 GD_ID_ASC_FFPROFILES_FWDBRAKINGREAR_Y5_PTC2_LD DataIndex 2389-2389;
SG_MUL_VAL_ 1557 GD_ID_ASC_FFPROFILES_FWDBRAKINGREAR_Y5_PTC2 DataIndex 2390-2390;
SG_MUL_VAL_ 1557 GD_ID_ASC_FFPROFILES_FWDBRAKINGREAR_Y6_PTC2_LD DataIndex 2391-2391;
SG_MUL_VAL_ 1557 GD_ID_ASC_FFPROFILES_FWDBRAKINGREAR_Y6_PTC2 DataIndex 2392-2392;
SG_MUL_VAL_ 1557 GD_ID_ASC_CORE_ASC_MINTOLERANCE_PCT2 DataIndex 2393-2393;
SG_MUL_VAL_ 1557 GD_ID_ASC_PID_RL_KDUP_ASC DataIndex 2394-2394;
SG_MUL_VAL_ 1557 GD_ID_ASC_PID_RL_KPUP_ASC DataIndex 2395-2395;
SG_MUL_VAL_ 1557 GD_ID_ASC_PID_RL_KPDN_ASC DataIndex 2396-2396;
SG_MUL_VAL_ 1557 GD_ID_ASC_PID_RL_KIUP_ASC DataIndex 2397-2397;
SG_MUL_VAL_ 1557 GD_ID_ASC_PID_RL_KIDN_ASC DataIndex 2398-2398;
SG_MUL_VAL_ 1557 GD_ID_ASC_PID_RL_IRED DataIndex 2399-2399;
SG_MUL_VAL_ 1557 GD_ID_BRK_Y5 DataIndex 2400-2400;
SG_MUL_VAL_ 1557 GD_ID_ENGADJLD_FILTERTM_MS DataIndex 2401-2401;
SG_MUL_VAL_ 1557 GD_ID_ENGADJLD_Y4 DataIndex 2402-2402;
SG_MUL_VAL_ 1557 GD_ID_MV_I_INT_I_GAIN DataIndex 2403-2403;
SG_MUL_VAL_ 1557 GD_ID_MISC_PR_PERACT_Y3 DataIndex 2404-2404;
SG_MUL_VAL_ 1557 GD_ID_MISC_PR_PERACT_Y4 DataIndex 2405-2405;
SG_MUL_VAL_ 1557 GD_ID_MISC_PR_PERACT_Y5 DataIndex 2406-2406;
SG_MUL_VAL_ 1557 GD_ID_ASC_Core_ABS_Ang_Y1_ptc2 DataIndex 2407-2407;
SG_MUL_VAL_ 1557 GD_ID_ASC_Core_ABS_Ang_Y2_ptc2 DataIndex 2408-2408;
SG_MUL_VAL_ 1557 GD_ID_ASC_Core_ABS_Ang_Y3_ptc2 DataIndex 2409-2409;
SG_MUL_VAL_ 1557 GD_ID_ASC_Core_ABS_Ang_Y4_ptc2 DataIndex 2410-2410;
SG_MUL_VAL_ 1557 GD_ID_ASC_Core_ABS_Ang_Y5_ptc2 DataIndex 2411-2411;
SG_MUL_VAL_ 1557 GD_ID_ASC_Core_ABS_MinTolerance_pct2 DataIndex 2412-2412;
SG_MUL_VAL_ 1557 GD_ID_ASC_Core_ASC_Ang_Y1_ptc2 DataIndex 2413-2413;
SG_MUL_VAL_ 1557 GD_ID_ASC_Core_ASC_Ang_Y2_ptc2 DataIndex 2414-2414;
SG_MUL_VAL_ 1557 GD_ID_ASC_Core_ASC_Ang_Y3_ptc2 DataIndex 2415-2415;
SG_MUL_VAL_ 1557 GD_ID_ASC_Core_ASC_Ang_Y4_ptc2 DataIndex 2416-2416;
SG_MUL_VAL_ 1557 GD_ID_ASC_Core_ASC_Ang_Y5_ptc2 DataIndex 2417-2417;
SG_MUL_VAL_ 1557 GD_ID_DRIVE_PEDAL_CAL_COMMAND_Status DataIndex 2458-2458;
SG_MUL_VAL_ 1557 GD_ID_DRIVE_PEDAL_CAL_COMMAND DataIndex 2458-2458;
SG_MUL_VAL_ 1557 GD_ID_DRIVE_PEDAL_CAL_STATE_Status DataIndex 2459-2459;
SG_MUL_VAL_ 1557 GD_ID_DRIVE_PEDAL_CAL_STATE DataIndex 2459-2459;
SG_MUL_VAL_ 1557 GD_ID_DRIVE_BRAKE_PEDAL_CAL_COMMAND_Status DataIndex 2460-2460;
SG_MUL_VAL_ 1557 GD_ID_DRIVE_BRAKE_PEDAL_CAL_COMMAND DataIndex 2460-2460;
SG_MUL_VAL_ 1557 GD_ID_DRIVE_BRAKE_PEDAL_CAL_STATE_Status DataIndex 2461-2461;
SG_MUL_VAL_ 1557 GD_ID_DRIVE_BRAKE_PEDAL_CAL_STATE DataIndex 2461-2461;
SG_MUL_VAL_ 1557 GD_ID_DRIVE_WAS_CAL_COMMAND_Status DataIndex 2462-2462;
SG_MUL_VAL_ 1557 GD_ID_DRIVE_WAS_CAL_COMMAND DataIndex 2462-2462;
SG_MUL_VAL_ 1557 GD_ID_DRIVE_WAS_CAL_STATE_Status DataIndex 2463-2463;
SG_MUL_VAL_ 1557 GD_ID_DRIVE_WAS_CAL_STATE DataIndex 2463-2463;
SG_MUL_VAL_ 1557 GD_ID_DRIVE_HYDRO_CAL_COMMAND_Status DataIndex 2464-2464;
SG_MUL_VAL_ 1557 GD_ID_DRIVE_HYDRO_CAL_COMMAND DataIndex 2464-2464;
SG_MUL_VAL_ 1557 GD_ID_DRIVE_HYDRO_CAL_STATE_Status DataIndex 2465-2465;
SG_MUL_VAL_ 1557 GD_ID_DRIVE_HYDRO_CAL_STATE DataIndex 2465-2465;
SG_MUL_VAL_ 1557 GD_ID_DRIVE_WHEEL_SPEED_CALIBRATION_COMMAND_Status DataIndex 2468-2468;
SG_MUL_VAL_ 1557 GD_ID_DRIVE_WHEEL_SPEED_CALIBRATION_COMMAND DataIndex 2468-2468;
SG_MUL_VAL_ 1557 GD_ID_DRIVE_WHEEL_SPEED_CALIBRATION_STATE_Status DataIndex 2469-2469;
SG_MUL_VAL_ 1557 GD_ID_DRIVE_WHEEL_SPEED_CALIBRATION_STATE DataIndex 2469-2469;
SG_MUL_VAL_ 1557 GD_ID_DRIVE_WHEEL_SPEED_CALIBRATION_USER_DISTANCE_Status DataIndex 2470-2470;
SG_MUL_VAL_ 1557 GD_ID_DRIVE_WHEEL_SPEED_CALIBRATION_USER_DISTANCE DataIndex 2470-2470;
SG_MUL_VAL_ 1557 GD_ID_DRIVE_RADAR_CALIBRATION_COMMAND_Status DataIndex 2471-2471;
SG_MUL_VAL_ 1557 GD_ID_DRIVE_RADAR_CALIBRATION_COMMAND DataIndex 2471-2471;
SG_MUL_VAL_ 1557 GD_ID_DRIVE_RADAR_CALIBRATION_STATE_Status DataIndex 2472-2472;
SG_MUL_VAL_ 1557 GD_ID_DRIVE_RADAR_CALIBRATION_STATE DataIndex 2472-2472;
SG_MUL_VAL_ 1557 GD_ID_DRIVE_RADAR_CALIBRATION_USER_DISTANCE_Status DataIndex 2473-2473;
SG_MUL_VAL_ 1557 GD_ID_DRIVE_RADAR_CALIBRATION_USER_DISTANCE DataIndex 2473-2473;
SG_MUL_VAL_ 1557 GD_ID_DRIVE_COMBO_CALIBRATION_COMMAND_Status DataIndex 2474-2474;
SG_MUL_VAL_ 1557 GD_ID_DRIVE_COMBO_CALIBRATION_COMMAND DataIndex 2474-2474;
SG_MUL_VAL_ 1557 GD_ID_DRIVE_COMBO_CALIBRATION_STATE_Status DataIndex 2475-2475;
SG_MUL_VAL_ 1557 GD_ID_DRIVE_COMBO_CALIBRATION_STATE DataIndex 2475-2475;
SG_MUL_VAL_ 1557 GD_ID_DRIVE_COMBO_CALIBRATION_USER_DISTANCE_Status DataIndex 2476-2476;
SG_MUL_VAL_ 1557 GD_ID_DRIVE_COMBO_CALIBRATION_USER_DISTANCE DataIndex 2476-2476;
SG_MUL_VAL_ 1557 GD_ID_DRIVE_DRIVEPUMP_A_START_CAL_CURRENT_STORED DataIndex 2498-2498;
SG_MUL_VAL_ 1557 GD_ID_DRIVE_DRIVEPUMP_A_END_CAL_CURRENT_STORED DataIndex 2499-2499;
SG_MUL_VAL_ 1557 GD_ID_DRIVE_DRIVEPUMP_B_START_CAL_CURRENT_STORED DataIndex 2500-2500;
SG_MUL_VAL_ 1557 GD_ID_DRIVE_DRIVEPUMP_B_END_CAL_CURRENT_STORED DataIndex 2501-2501;
SG_MUL_VAL_ 1557 GD_ID_DRIVE_MOTOR_FL_START_CAL_CURRENT_STORED DataIndex 2502-2502;
SG_MUL_VAL_ 1557 GD_ID_DRIVE_MOTOR_FL_END_CAL_CURRENT_STORED DataIndex 2503-2503;
SG_MUL_VAL_ 1557 GD_ID_DRIVE_MOTOR_FR_START_CAL_CURRENT_STORED DataIndex 2504-2504;
SG_MUL_VAL_ 1557 GD_ID_DRIVE_MOTOR_FR_END_CAL_CURRENT_STORED DataIndex 2505-2505;
SG_MUL_VAL_ 1557 GD_ID_DRIVE_MOTOR_RL_START_CAL_CURRENT_STORED DataIndex 2506-2506;
SG_MUL_VAL_ 1557 GD_ID_DRIVE_MOTOR_RL_END_CAL_CURRENT_STORED DataIndex 2507-2507;
SG_MUL_VAL_ 1557 GD_ID_DRIVE_MOTOR_RR_START_CAL_CURRENT_STORED DataIndex 2508-2508;
SG_MUL_VAL_ 1557 GD_ID_DRIVE_MOTOR_RR_END_CAL_CURRENT_STORED DataIndex 2509-2509;
SG_MUL_VAL_ 1557 GD_ID_DRIVE_DRIVEPUMP_A_START_CAL_CURRENT_NEW DataIndex 2510-2510;
SG_MUL_VAL_ 1557 GD_ID_DRIVE_DRIVEPUMP_A_END_CAL_CURRENT_NEW DataIndex 2511-2511;
SG_MUL_VAL_ 1557 GD_ID_DRIVE_DRIVEPUMP_B_START_CAL_CURRENT_NEW DataIndex 2512-2512;
SG_MUL_VAL_ 1557 GD_ID_DRIVE_DRIVEPUMP_B_END_CAL_CURRENT_NEW DataIndex 2513-2513;
SG_MUL_VAL_ 1557 GD_ID_DRIVE_MOTOR_FL_START_CAL_CURRENT_NEW DataIndex 2514-2514;
SG_MUL_VAL_ 1557 GD_ID_DRIVE_MOTOR_FL_END_CAL_CURRENT_NEW DataIndex 2515-2515;
SG_MUL_VAL_ 1557 GD_ID_DRIVE_MOTOR_FR_START_CAL_CURRENT_NEW DataIndex 2516-2516;
SG_MUL_VAL_ 1557 GD_ID_DRIVE_MOTOR_FR_END_CAL_CURRENT_NEW DataIndex 2517-2517;
SG_MUL_VAL_ 1557 GD_ID_DRIVE_MOTOR_RL_START_CAL_CURRENT_NEW DataIndex 2518-2518;
SG_MUL_VAL_ 1557 GD_ID_DRIVE_MOTOR_RL_END_CAL_CURRENT_NEW DataIndex 2519-2519;
SG_MUL_VAL_ 1557 GD_ID_DRIVE_MOTOR_RR_START_CAL_CURRENT_NEW DataIndex 2520-2520;
SG_MUL_VAL_ 1557 GD_ID_DRIVE_MOTOR_RR_END_CAL_CURRENT_NEW DataIndex 2521-2521;
SG_MUL_VAL_ 1557 GD_ID_DRIVE_DANFOSS_CAL_REQUEST DataIndex 2523-2523;
SG_MUL_VAL_ 1557 GD_ID_DRIVE_WHEEL_BASED_MACHINE_SPEED_KPH DataIndex 2525-2525;
SG_MUL_VAL_ 1557 GD_ID_DRIVE_NORMALIZED_WHEEL_SPEED_FL DataIndex 2526-2526;
SG_MUL_VAL_ 1557 GD_ID_DRIVE_NORMALIZED_WHEEL_SPEED_FR DataIndex 2527-2527;
SG_MUL_VAL_ 1557 GD_ID_DRIVE_NORMALIZED_WHEEL_SPEED_RL DataIndex 2528-2528;
SG_MUL_VAL_ 1557 GD_ID_DRIVE_NORMALIZED_WHEEL_SPEED_RR DataIndex 2529-2529;
SG_MUL_VAL_ 1557 GD_ID_DRIVE_AIRBAG_DEFLATE_Status DataIndex 2530-2530;
SG_MUL_VAL_ 1557 GD_ID_DRIVE_AIRBAG_DEFLATE DataIndex 2530-2530;
SG_MUL_VAL_ 1557 GD_ID_DRIVE_ERRORMANAGEMENT_Status DataIndex 2542-2542;
SG_MUL_VAL_ 1557 GD_ID_DRIVE_ERRORMANAGEMENT DataIndex 2542-2542;
SG_MUL_VAL_ 1557 GD_ID_DRIVE_LIFEMESSAGE DataIndex 2559-2559;
SG_MUL_VAL_ 1557 SendInfoTcrr ServiceType 415-415;
SG_MUL_VAL_ 1557 PlausibilityCheck ServiceType 509-509, 359-359, 390-390, 422-422, 423-423, 394-394, 427-427, 404-404, 375-375, 406-406, 414-414;
SG_MUL_VAL_ 1557 LowerHysteresis ServiceType 405-405, 407-407;
SG_MUL_VAL_ 1557 DataIndex ServiceType 509-509, 359-359, 390-390, 422-422, 423-423, 394-394, 427-427, 404-404, 375-375, 406-406, 414-414;
SG_MUL_VAL_ 1557 ErrorId ServiceType 509-509, 359-359, 390-390, 422-422, 423-423, 394-394, 427-427, 404-404, 375-375, 406-406, 414-414;
SG_MUL_VAL_ 1557 CanError ServiceType 509-509, 359-359, 390-390, 422-422, 423-423, 394-394, 427-427, 404-404, 375-375, 406-406, 414-414;
SG_MUL_VAL_ 1557 CalErrorState ServiceType 509-509, 359-359, 390-390, 422-422, 423-423, 394-394, 427-427, 404-404, 375-375, 406-406, 414-414;
SG_MUL_VAL_ 1557 BlockSize ServiceType 399-399;
SG_MUL_VAL_ 1557 RequestType ServiceType 399-399;
SG_MUL_VAL_ 1557 DataByte1 ServiceType 430-430, 431-431;
SG_MUL_VAL_ 1557 DataByte2 ServiceType 430-430, 431-431;
SG_MUL_VAL_ 1557 DataByte3 ServiceType 430-430, 431-431;
SG_MUL_VAL_ 1557 DataByte4 ServiceType 430-430, 431-431;
SG_MUL_VAL_ 1557 CRC_ChecksumOrBlockSizeError ServiceType 398-398;
SG_MUL_VAL_ 1557 ControlType ServiceType 398-398;
SG_MUL_VAL_ 1557 ControlOrErrorCode ServiceType 398-398;

SG_MUL_VAL_ 1557 GD_ID_SCT_ENABLE DataIndex 12288-12288;
SG_MUL_VAL_ 1557 GD_ID_SCT_MODUL_OUT_STATUS DataIndex 12289-12289;
SG_MUL_VAL_ 1557 GD_ID_SCT_MODUL_IN_STATUS DataIndex 12290-12290;
SG_MUL_VAL_ 1557 GD_ID_SCT_STATUSDISPLAY_TERMINAL DataIndex 12298-12298;
SG_MUL_VAL_ 1557 GD_ID_SCT_TURNING_OFF_REASON DataIndex 12303-12303;
SG_MUL_VAL_ 1557 GD_ID_SCT_STATE DataIndex 12304-12304;
SG_MUL_VAL_ 1557 GD_ID_SCT_VOTED_ACTIVE_CLASS_1 DataIndex 12305-12305;
SG_MUL_VAL_ 1557 GD_ID_SCT_VOTED_ACTIVE_CLASS_2 DataIndex 12306-12306;
SG_MUL_VAL_ 1557 GD_ID_SCT_SETPOINT_Status DataIndex 12312-12312;
SG_MUL_VAL_ 1557 GD_ID_SCT_SETPOINT DataIndex 12312-12312;
SG_MUL_VAL_ 1557 GD_ID_SCT_SETPOINT_FEELER_GUIDANCE_Status DataIndex 12313-12313;
SG_MUL_VAL_ 1557 GD_ID_SCT_SETPOINT_FEELER_GUIDANCE DataIndex 12313-12313;
SG_MUL_VAL_ 1557 GD_ID_SCT_SETPOINT_CURVATURE_Status DataIndex 12314-12314;
SG_MUL_VAL_ 1557 GD_ID_SCT_SETPOINT_CURVATURE DataIndex 12314-12314;
SG_MUL_VAL_ 1557 GD_ID_SCT_SETPOINT_CURVATURE_TIM_Status DataIndex 12315-12315;
SG_MUL_VAL_ 1557 GD_ID_SCT_SETPOINT_CURVATURE_TIM DataIndex 12315-12315;
SG_MUL_VAL_ 1557 GD_ID_SCT_SETPOINT_CURVATURE_FEELER_GUIDANCE_Status DataIndex 12316-12316;
SG_MUL_VAL_ 1557 GD_ID_SCT_SETPOINT_CURVATURE_FEELER_GUIDANCE DataIndex 12316-12316;
SG_MUL_VAL_ 1557 GD_ID_SCT_WAS_RAW_VALUE DataIndex 12320-12320;
SG_MUL_VAL_ 1557 GD_ID_SCT_WAS_SCALED_VALUE DataIndex 12321-12321;
SG_MUL_VAL_ 1557 GD_ID_SCT_WAS_SENSOR_ANGLE DataIndex 12322-12322;
SG_MUL_VAL_ 1557 GD_ID_SCT_WAS_MEDIAN_ANGLE DataIndex 12323-12323;
SG_MUL_VAL_ 1557 GD_ID_SCT_WAS_MEDIAN_ANGLE_MAX DataIndex 12324-12324;
SG_MUL_VAL_ 1557 GD_ID_SCT_WAS_VIRTUAL_ANGLE DataIndex 12325-12325;
SG_MUL_VAL_ 1557 GD_ID_SCT_WAS_MEDIAN_CURVATURE DataIndex 12328-12328;
SG_MUL_VAL_ 1557 GD_ID_SCT_WAS_MEDIAN_CURVATURE_MAX DataIndex 12329-12329;
SG_MUL_VAL_ 1557 GD_ID_SCT_WAS_CALIB_COMMAND DataIndex 12334-12334;
SG_MUL_VAL_ 1557 GD_ID_SCT_WAS_CALIB_STATUS DataIndex 12335-12335;
SG_MUL_VAL_ 1557 GD_ID_SCT_SWS_RAW_VALUE_Status DataIndex 12336-12336;
SG_MUL_VAL_ 1557 GD_ID_SCT_SWS_RAW_VALUE DataIndex 12336-12336;
SG_MUL_VAL_ 1557 GD_ID_SCT_SWS_LIMITED_ANGLE_Status DataIndex 12338-12338;
SG_MUL_VAL_ 1557 GD_ID_SCT_SWS_LIMITED_ANGLE DataIndex 12338-12338;
SG_MUL_VAL_ 1557 GD_ID_SCT_SWS_CONTINUED_ANGLE_Status DataIndex 12339-12339;
SG_MUL_VAL_ 1557 GD_ID_SCT_SWS_CONTINUED_ANGLE DataIndex 12339-12339;
SG_MUL_VAL_ 1557 GD_ID_SCT_SWS_ROTATIONAL_SPEED DataIndex 12340-12340;
SG_MUL_VAL_ 1557 GD_ID_SCT_VALVE_SETPOINT DataIndex 12352-12352;
SG_MUL_VAL_ 1557 GD_ID_SCT_VALVE_POSITION DataIndex 12353-12353;
SG_MUL_VAL_ 1557 GD_ID_SCT_VALVE_CALIB_COMMAND DataIndex 12366-12366;
SG_MUL_VAL_ 1557 GD_ID_SCT_VALVE_CALIB_STATUS DataIndex 12367-12367;
SG_MUL_VAL_ 1557 GD_ID_SCT_PILOTVALVE_STATUS_Status DataIndex 12368-12368;
SG_MUL_VAL_ 1557 GD_ID_SCT_PILOTVALVE_STATUS DataIndex 12368-12368;
SG_MUL_VAL_ 1557 GD_ID_SCT_OLAY_STEER_FACTOR DataIndex 12388-12388;
SG_MUL_VAL_ 1557 GD_ID_SCT_HEADLAND_CMD_Status DataIndex 12416-12416;
SG_MUL_VAL_ 1557 GD_ID_SCT_HEADLAND_CMD DataIndex 12416-12416;
SG_MUL_VAL_ 1557 GD_ID_SCT_3RDPARTY_READY_STATUS_Status DataIndex 12417-12417;
SG_MUL_VAL_ 1557 GD_ID_SCT_3RDPARTY_READY_STATUS DataIndex 12417-12417;
SG_MUL_VAL_ 1557 GD_ID_SCT_3RDPARTY_POSITION_STATUS_Status DataIndex 12418-12418;
SG_MUL_VAL_ 1557 GD_ID_SCT_3RDPARTY_POSITION_STATUS DataIndex 12418-12418;
SG_MUL_VAL_ 1557 GD_ID_SCT_3RDPARTY_CANCEL_REQUEST_Status DataIndex 12419-12419;
SG_MUL_VAL_ 1557 GD_ID_SCT_3RDPARTY_CANCEL_REQUEST DataIndex 12419-12419;
SG_MUL_VAL_ 1557 GD_ID_SCT_3RDPARTY_COMMAND_GUIDANCE_Status DataIndex 12420-12420;
SG_MUL_VAL_ 1557 GD_ID_SCT_3RDPARTY_COMMAND_GUIDANCE DataIndex 12420-12420;
SG_MUL_VAL_ 1557 GD_ID_SCT_TSD_MIN_SPEED_FORWARD DataIndex 12544-12544;
SG_MUL_VAL_ 1557 GD_ID_SCT_TSD_MAX_SPEED_FORWARD DataIndex 12545-12545;
SG_MUL_VAL_ 1557 GD_ID_SCT_TSD_MIN_MACHINE_RADIUS DataIndex 12546-12546;
SG_MUL_VAL_ 1557 GD_ID_SCT_TSD_MAX_ACQUISITION_ANGLE DataIndex 12547-12547;
SG_MUL_VAL_ 1557 GD_ID_SCT_GUIDANCE_CONFIGURATION_DATA_Status DataIndex 12560-12560;
SG_MUL_VAL_ 1557 GD_ID_SCT_GUIDANCE_CONFIGURATION_DATA DataIndex 12560-12560;
SG_MUL_VAL_ 1557 GD_ID_SCT_STEERING_MODE_Status DataIndex 12568-12568;
SG_MUL_VAL_ 1557 GD_ID_SCT_STEERING_MODE DataIndex 12568-12568;
SG_MUL_VAL_ 1557 GD_ID_SCT_SECONDARY_WAS_RAW_VALUE_Status DataIndex 12569-12569;
SG_MUL_VAL_ 1557 GD_ID_SCT_SECONDARY_WAS_RAW_VALUE DataIndex 12569-12569;
SG_MUL_VAL_ 1557 GD_ID_SCT_SECONDARY_WAS_SENSOR_ANGLE_Status DataIndex 12570-12570;
SG_MUL_VAL_ 1557 GD_ID_SCT_SECONDARY_WAS_SENSOR_ANGLE DataIndex 12570-12570;
SG_MUL_VAL_ 1557 GD_ID_SCT_SECONDARY_WAS_MEDIAN_ANGLE_Status DataIndex 12571-12571;
SG_MUL_VAL_ 1557 GD_ID_SCT_SECONDARY_WAS_MEDIAN_ANGLE DataIndex 12571-12571;
SG_MUL_VAL_ 1557 GD_ID_SCT_SECONDARY_WAS_MEDIAN_ANGLE_MAX_Status DataIndex 12572-12572;
SG_MUL_VAL_ 1557 GD_ID_SCT_SECONDARY_WAS_MEDIAN_ANGLE_MAX DataIndex 12572-12572;
SG_MUL_VAL_ 1557 GD_ID_SCT_ALS_X_OFFSET_Status DataIndex 12573-12573;
SG_MUL_VAL_ 1557 GD_ID_SCT_ALS_X_OFFSET DataIndex 12573-12573;
SG_MUL_VAL_ 1557 GD_ID_SCT_ALS_Y_OFFSET_Status DataIndex 12574-12574;
SG_MUL_VAL_ 1557 GD_ID_SCT_ALS_Y_OFFSET DataIndex 12574-12574;
SG_MUL_VAL_ 1557 GD_ID_SCT_ADDITIONAL_WORKING_HEIGHT DataIndex 12575-12575;
SG_MUL_VAL_ 1557 GD_ID_SCT_VEHICLE_CURRENT_PAYLOAD_Status DataIndex 12576-12576;
SG_MUL_VAL_ 1557 GD_ID_SCT_VEHICLE_CURRENT_PAYLOAD DataIndex 12576-12576;
SG_MUL_VAL_ 1557 GD_ID_SCT_ISO_STATE DataIndex 12598-12598;
SG_MUL_VAL_ 1557 GD_ID_SCT_VEHICLE_SPEED_Status DataIndex 12599-12599;
SG_MUL_VAL_ 1557 GD_ID_SCT_VEHICLE_SPEED DataIndex 12599-12599;
SG_MUL_VAL_ 1557 GD_ID_SCT_VEHICLE_MOVEMENT_Status DataIndex 12600-12600;
SG_MUL_VAL_ 1557 GD_ID_SCT_VEHICLE_MOVEMENT DataIndex 12600-12600;
SG_MUL_VAL_ 1557 GD_ID_SCT_PARKING_BRAKE_Status DataIndex 12601-12601;
SG_MUL_VAL_ 1557 GD_ID_SCT_PARKING_BRAKE DataIndex 12601-12601;
SG_MUL_VAL_ 1557 GD_ID_SCT_CONTROL_MSG_TERMINAL DataIndex 12608-12608;
SG_MUL_VAL_ 1557 GD_ID_SCT_CONTROL_MSG_GUIDEANCE DataIndex 12609-12609;
SG_MUL_VAL_ 1557 GD_ID_SCT_MODIFIED_REFERENCE_POINT_HEIGHT DataIndex 12610-12610;
SG_MUL_VAL_ 1557 GD_ID_SCT_MODIFIED_GNSS_ANTENNA_X_OFFSET DataIndex 12611-12611;
SG_MUL_VAL_ 1557 GD_ID_SCT_MODIFIED_GNSS_ANTENNA_Y_OFFSET DataIndex 12612-12612;
SG_MUL_VAL_ 1557 GD_ID_SCT_MODIFIED_GNSS_ANTENNA_Z_OFFSET DataIndex 12613-12613;
SG_MUL_VAL_ 1557 GD_ID_SCT_MODIFIED_TRACK_WIDTH DataIndex 12614-12614;
SG_MUL_VAL_ 1557 GD_ID_SCT_MODIFIED_MOUNTING_ERROR_Y_OFFSET DataIndex 12615-12615;
SG_MUL_VAL_ 1557 GD_ID_SCT_TRACTOR_SN_TYPE DataIndex 12736-12736;
SG_MUL_VAL_ 1557 GD_ID_SCT_TRACTOR_SN_GROUP DataIndex 12737-12737;
SG_MUL_VAL_ 1557 GD_ID_SCT_TRACTOR_SN_NUMBER DataIndex 12738-12738;
SG_MUL_VAL_ 1557 GD_ID_SCT_ERROR_ACKNOWLEDGE_Status DataIndex 12782-12782;
SG_MUL_VAL_ 1557 GD_ID_SCT_ERROR_ACKNOWLEDGE DataIndex 12782-12782;
SG_MUL_VAL_ 1557 GD_ID_SCT_ACTIVATE_DIAGNOSTICS DataIndex 12784-12784;
SG_MUL_VAL_ 1557 GD_ID_SCT_SAFETY_VERSION_Status DataIndex 12788-12788;
SG_MUL_VAL_ 1557 GD_ID_SCT_SAFETY_VERSION DataIndex 12788-12788;
SG_MUL_VAL_ 1557 GD_ID_SCT_LIB_SAFETY_VERSION DataIndex 12789-12789;
SG_MUL_VAL_ 1557 GD_ID_SCT_RECIPE_ACCESS_SETPOINT DataIndex 12792-12792;
SG_MUL_VAL_ 1557 GD_ID_SCT_TI_ACCESS_SETPOINT DataIndex 12793-12793;
SG_MUL_VAL_ 1557 GD_ID_SCT_TI_ACCESS_STATE DataIndex 12794-12794;
SG_MUL_VAL_ 1557 GD_ID_SCT_TI_ACCESS_STATE_KL15 DataIndex 12795-12795;
SG_MUL_VAL_ 1557 GD_ID_SCT_TI_SUB_STATE DataIndex 12797-12797;
SG_MUL_VAL_ 1557 GD_ID_SCT_ErrorManagement_Status DataIndex 12782-12782;
SG_MUL_VAL_ 1557 GD_ID_SCT_ErrorManagement DataIndex 12782-12782;
SG_MUL_VAL_ 1557 GD_ID_SCT_LifeMessage DataIndex 12799-12799;

SG_MUL_VAL_ 1557 GD_ID_Engine_Rpm DataIndex 12800-12800;
SG_MUL_VAL_ 1557 GD_ID_Engine_Load DataIndex 12801-12801;
SG_MUL_VAL_ 1557 GD_ID_Engine_Coolant_Temp_Status DataIndex 12802-12802;
SG_MUL_VAL_ 1557 GD_ID_Engine_Coolant_Temp DataIndex 12802-12802;
SG_MUL_VAL_ 1557 GD_ID_Engine_Air_Intake_Temp DataIndex 12803-12803;
SG_MUL_VAL_ 1557 GD_ID_Engine_Battery_Power_Status DataIndex 12804-12804;
SG_MUL_VAL_ 1557 GD_ID_Engine_Battery_Power DataIndex 12804-12804;
SG_MUL_VAL_ 1557 GD_ID_Engine_Air_Intake_Pressure DataIndex 12805-12805;
SG_MUL_VAL_ 1557 GD_ID_Engine_Oil_Pressure DataIndex 12806-12806;
SG_MUL_VAL_ 1557 GD_ID_Engine_Rpm_Setpoint_Status DataIndex 12807-12807;
SG_MUL_VAL_ 1557 GD_ID_Engine_Rpm_Setpoint DataIndex 12807-12807;
SG_MUL_VAL_ 1557 GD_ID_Engine_Standing_Still_Status DataIndex 12808-12808;
SG_MUL_VAL_ 1557 GD_ID_Engine_Standing_Still DataIndex 12808-12808;
SG_MUL_VAL_ 1557 GD_ID_Engine_Oil_Pressure_Low_Status DataIndex 12809-12809;
SG_MUL_VAL_ 1557 GD_ID_Engine_Oil_Pressure_Low DataIndex 12809-12809;
SG_MUL_VAL_ 1557 GD_ID_Engine_Oil_Service_Interval_Status DataIndex 12810-12810;
SG_MUL_VAL_ 1557 GD_ID_Engine_Oil_Service_Interval DataIndex 12810-12810;
SG_MUL_VAL_ 1557 GD_ID_Engine_Hours DataIndex 12811-12811;
SG_MUL_VAL_ 1557 GD_ID_Engine_Amber_Warning_Lamp_Status DataIndex 12812-12812;
SG_MUL_VAL_ 1557 GD_ID_Engine_Amber_Warning_Lamp DataIndex 12812-12812;
SG_MUL_VAL_ 1557 GD_ID_Engine_Red_Stop_Lamp_Status DataIndex 12813-12813;
SG_MUL_VAL_ 1557 GD_ID_Engine_Red_Stop_Lamp DataIndex 12813-12813;
SG_MUL_VAL_ 1557 GD_ID_Alt_Low_Idle DataIndex 12814-12814;
SG_MUL_VAL_ 1557 GD_ID_Engine_Audible_Warning_Status DataIndex 12815-12815;
SG_MUL_VAL_ 1557 GD_ID_Engine_Audible_Warning DataIndex 12815-12815;
SG_MUL_VAL_ 1557 GD_ID_Ambient_Temp DataIndex 12816-12816;
SG_MUL_VAL_ 1557 GD_ID_Ecu_Temp DataIndex 12817-12817;
SG_MUL_VAL_ 1557 GD_ID_Fuel_Rate DataIndex 12820-12820;
SG_MUL_VAL_ 1557 GD_ID_Trip_Fuel DataIndex 12821-12821;
SG_MUL_VAL_ 1557 GD_ID_Trip_DEF DataIndex 12822-12822;
SG_MUL_VAL_ 1557 GD_ID_DEF_Level DataIndex 12823-12823;
SG_MUL_VAL_ 1557 GD_ID_Water_In_Fuel_Status DataIndex 12824-12824;
SG_MUL_VAL_ 1557 GD_ID_Water_In_Fuel DataIndex 12824-12824;
SG_MUL_VAL_ 1557 GD_ID_Engine_Malfunction_Lamp_Status DataIndex 12825-12825;
SG_MUL_VAL_ 1557 GD_ID_Engine_Malfunction_Lamp DataIndex 12825-12825;
SG_MUL_VAL_ 1557 GD_ID_DEF_Level_Warning_Status DataIndex 12826-12826;
SG_MUL_VAL_ 1557 GD_ID_DEF_Level_Warning DataIndex 12826-12826;
SG_MUL_VAL_ 1557 GD_ID_Engine_WaitToStart_Status DataIndex 12827-12827;
SG_MUL_VAL_ 1557 GD_ID_Engine_WaitToStart DataIndex 12827-12827;
SG_MUL_VAL_ 1557 GD_ID_Engine_Operating_State DataIndex 12828-12828;
SG_MUL_VAL_ 1557 GD_ID_Engine_Start_Enable_Status DataIndex 12829-12829;
SG_MUL_VAL_ 1557 GD_ID_Engine_Start_Enable DataIndex 12829-12829;
SG_MUL_VAL_ 1557 GD_ID_Implement_Transport_State_Status DataIndex 12830-12830;
SG_MUL_VAL_ 1557 GD_ID_Implement_Transport_State DataIndex 12830-12830;
SG_MUL_VAL_ 1557 GD_ID_Implement_Work_State_Status DataIndex 12831-12831;
SG_MUL_VAL_ 1557 GD_ID_Implement_Work_State DataIndex 12831-12831;
SG_MUL_VAL_ 1557 GD_ID_Implement_Actual_Working_Width DataIndex 12832-12832;
SG_MUL_VAL_ 1557 GD_ID_Implement_Actual_Flow DataIndex 12833-12833;
SG_MUL_VAL_ 1557 GD_ID_Implement_ReadyForFieldWork_Status DataIndex 12834-12834;
SG_MUL_VAL_ 1557 GD_ID_Implement_ReadyForFieldWork DataIndex 12834-12834;
SG_MUL_VAL_ 1557 GD_ID_WheelBasedDistance_km DataIndex 12840-12840;
SG_MUL_VAL_ 1557 GD_ID_WheelBasedDistance_m DataIndex 12841-12841;
SG_MUL_VAL_ 1557 GD_ID_GroundBasedDistance_km DataIndex 12842-12842;
SG_MUL_VAL_ 1557 GD_ID_GroundBasedDistance_m DataIndex 12843-12843;
SG_MUL_VAL_ 1557 GD_ID_SelectedSpeedDistance_km DataIndex 12844-12844;
SG_MUL_VAL_ 1557 GD_ID_SelectedSpeedDistance_m DataIndex 12845-12845;
SG_MUL_VAL_ 1557 GD_ID_MachineSelectedSpeed DataIndex 12846-12846;
SG_MUL_VAL_ 1557 GD_ID_WBZ_MACHINE_SELECTED_SOURCE DataIndex 12847-12847;
SG_MUL_VAL_ 1557 GD_ID_WBZ_MAX_ENG_RPM DataIndex 12848-12848;
SG_MUL_VAL_ 1557 GD_ID_Working_Time_SecMin_VD DataIndex 12850-12850;
SG_MUL_VAL_ 1557 GD_ID_Working_Time_Hours_VD DataIndex 12851-12851;
SG_MUL_VAL_ 1557 GD_ID_Worked_Area_Ha_VD DataIndex 12852-12852;
SG_MUL_VAL_ 1557 GD_ID_Worked_Area_0001Ha_VD DataIndex 12853-12853;
SG_MUL_VAL_ 1557 GD_ID_Used_Fuel_VD DataIndex 12854-12854;
SG_MUL_VAL_ 1557 GD_ID_Remaining_Time_SecMin_VD DataIndex 12855-12855;
SG_MUL_VAL_ 1557 GD_ID_Remaining_Time_Hours_VD DataIndex 12856-12856;
SG_MUL_VAL_ 1557 GD_ID_Remaining_Area_Ha_VD DataIndex 12857-12857;
SG_MUL_VAL_ 1557 GD_ID_Remaining_Area_0001Ha_VD DataIndex 12858-12858;
SG_MUL_VAL_ 1557 GD_ID_Required_Fuel_VD DataIndex 12859-12859;
SG_MUL_VAL_ 1557 GD_ID_Field_Size_Ha_VD DataIndex 12860-12860;
SG_MUL_VAL_ 1557 GD_ID_Field_Size_0001Ha_VD DataIndex 12861-12861;
SG_MUL_VAL_ 1557 GD_ID_Reset_VD_Status DataIndex 12862-12862;
SG_MUL_VAL_ 1557 GD_ID_Reset_VD DataIndex 12862-12862;
SG_MUL_VAL_ 1557 GD_Iso_IsoState_state_RW DataIndex 12870-12870;
SG_MUL_VAL_ 1557 GD_ID_WBZ_TERMINAL_PAGE_SIZE DataIndex 12871-12871;
SG_MUL_VAL_ 1557 GD_ID_WBZ_ENG_DEF_LVL_LAMP_Status DataIndex 12878-12878;
SG_MUL_VAL_ 1557 GD_ID_WBZ_ENG_DEF_LVL_LAMP DataIndex 12878-12878;
SG_MUL_VAL_ 1557 GD_ID_WBZ_ENG_DEF_MIL_LAMP_Status DataIndex 12879-12879;
SG_MUL_VAL_ 1557 GD_ID_WBZ_ENG_DEF_MIL_LAMP DataIndex 12879-12879;
SG_MUL_VAL_ 1557 GD_ID_IgnitionState_Status DataIndex 12880-12880;
SG_MUL_VAL_ 1557 GD_ID_IgnitionState DataIndex 12880-12880;
SG_MUL_VAL_ 1557 GD_ID_WBZ_ENG_FAN_RPM DataIndex 12881-12881;
SG_MUL_VAL_ 1557 GD_ID_WBZ_ENG_FUEL_TEMP DataIndex 12882-12882;
SG_MUL_VAL_ 1557 GD_ID_WBZ_ENG_AUXIO1_01 DataIndex 12883-12883;
SG_MUL_VAL_ 1557 GD_ID_WBZ_ENG_FAN_DUTY_CYCLE DataIndex 12884-12884;
SG_MUL_VAL_ 1557 GD_ID_WBZ_DEF_TEMP DataIndex 12885-12885;
SG_MUL_VAL_ 1557 GD_ID_WBZ_EXHAUST_TEMP DataIndex 12886-12886;
SG_MUL_VAL_ 1557 GD_ID_WBZ_FUEL_PRESSURE DataIndex 12887-12887;
SG_MUL_VAL_ 1557 GD_ID_WBZ_CURVATURE_SETPOINT DataIndex 12888-12888;
SG_MUL_VAL_ 1557 GD_ID_WBZ_CURVATURE_ENABLE_Status DataIndex 12889-12889;
SG_MUL_VAL_ 1557 GD_ID_WBZ_CURVATURE_ENABLE DataIndex 12889-12889;
SG_MUL_VAL_ 1557 GD_ID_WBZ_ENG_START_CMD_Status DataIndex 12890-12890;
SG_MUL_VAL_ 1557 GD_ID_WBZ_ENG_START_CMD DataIndex 12890-12890;
SG_MUL_VAL_ 1557 GD_ID_WBZ_THIRD_PARTY_MANUS_Status DataIndex 12891-12891;
SG_MUL_VAL_ 1557 GD_ID_WBZ_THIRD_PARTY_MANUS DataIndex 12891-12891;
SG_MUL_VAL_ 1557 GD_ID_WBZ_NEW_LEADER_ACL_Status DataIndex 12892-12892;
SG_MUL_VAL_ 1557 GD_ID_WBZ_NEW_LEADER_ACL DataIndex 12892-12892;
SG_MUL_VAL_ 1557 GD_ID_WBZ_AUXIO1_01_FI02 DataIndex 12901-12901;
SG_MUL_VAL_ 1557 GD_ID_WBZ_AUXIO1_02_FI02 DataIndex 12902-12902;
SG_MUL_VAL_ 1557 GD_ID_WBZ_AUXIO1_03_FI02 DataIndex 12903-12903;
SG_MUL_VAL_ 1557 GD_ID_WBZ_AUXIO1_04_FI02 DataIndex 12904-12904;
SG_MUL_VAL_ 1557 GD_ID_WBZ_AUXIO1_05_FI02 DataIndex 12905-12905;
SG_MUL_VAL_ 1557 GD_ID_WBZ_AUXIO1_06_FI02 DataIndex 12906-12906;
SG_MUL_VAL_ 1557 GD_ID_WBZ_AUXIO1_07_FI02 DataIndex 12907-12907;
SG_MUL_VAL_ 1557 GD_ID_WBZ_AUXIO1_08_FI02 DataIndex 12908-12908;
SG_MUL_VAL_ 1557 GD_ID_WBZ_AUXIO1_09_FI02 DataIndex 12909-12909;
SG_MUL_VAL_ 1557 GD_ID_WBZ_AUXIO1_10_FI02 DataIndex 12910-12910;
SG_MUL_VAL_ 1557 GD_ID_WBZ_AUXIO1_11_FI02 DataIndex 12911-12911;
SG_MUL_VAL_ 1557 GD_ID_WBZ_AUXIO1_12_FI02 DataIndex 12912-12912;
SG_MUL_VAL_ 1557 GD_ID_WBZ_AUXIO2_17_FI02 DataIndex 12917-12917;
SG_MUL_VAL_ 1557 GD_ID_WBZ_AUXIO2_18_FI02 DataIndex 12918-12918;
SG_MUL_VAL_ 1557 GD_ID_WBZ_AUXIO1_01_FI00 DataIndex 12919-12919;
SG_MUL_VAL_ 1557 GD_ID_WBZ_AUXIO1_02_FI00 DataIndex 12920-12920;
SG_MUL_VAL_ 1557 GD_ID_WBZ_AUXIO1_03_FI00 DataIndex 12921-12921;
SG_MUL_VAL_ 1557 GD_ID_WBZ_AUXIO1_04_FI00 DataIndex 12922-12922;
SG_MUL_VAL_ 1557 GD_ID_WBZ_AUXIO1_05_FI00 DataIndex 12923-12923;
SG_MUL_VAL_ 1557 GD_ID_WBZ_AUXIO1_06_FI00 DataIndex 12924-12924;
SG_MUL_VAL_ 1557 GD_ID_WBZ_AUXIO1_07_FI00 DataIndex 12925-12925;
SG_MUL_VAL_ 1557 GD_ID_WBZ_AUXIO1_08_FI00 DataIndex 12926-12926;
SG_MUL_VAL_ 1557 GD_ID_WBZ_AUXIO1_09_FI00 DataIndex 12927-12927;
SG_MUL_VAL_ 1557 GD_ID_WBZ_AUXIO1_10_FI00 DataIndex 12928-12928;
SG_MUL_VAL_ 1557 GD_ID_WBZ_AUXIO1_11_FI00 DataIndex 12929-12929;
SG_MUL_VAL_ 1557 GD_ID_WBZ_AUXIO1_12_FI00 DataIndex 12930-12930;
SG_MUL_VAL_ 1557 GD_ID_WBZ_AUXIO1_13_FI00 DataIndex 12931-12931;
SG_MUL_VAL_ 1557 GD_ID_WBZ_AUXIO1_14_FI00 DataIndex 12932-12932;
SG_MUL_VAL_ 1557 GD_ID_WBZ_AUXIO1_15_FI00 DataIndex 12933-12933;
SG_MUL_VAL_ 1557 GD_ID_WBZ_AUXIO1_16_FI00 DataIndex 12934-12934;
SG_MUL_VAL_ 1557 GD_ID_WBZ_AUXIO1_CH2 DataIndex 12935-12935;
SG_MUL_VAL_ 1557 GD_ID_WBZ_AUXIO2_17_FI00 DataIndex 12936-12936;
SG_MUL_VAL_ 1557 GD_ID_WBZ_AUXIO2_18_FI00 DataIndex 12937-12937;
SG_MUL_VAL_ 1557 GD_ID_WBZ_AUXIO2_21_FI00 DataIndex 12940-12940;
SG_MUL_VAL_ 1557 GD_ID_WBZ_AUXIO2_22_FI00 DataIndex 12941-12941;
SG_MUL_VAL_ 1557 GD_ID_WBZ_AUXIO2_26_FI00 DataIndex 12945-12945;
SG_MUL_VAL_ 1557 GD_ID_WBZ_AUXIO2_27_FI00 DataIndex 12946-12946;
SG_MUL_VAL_ 1557 GD_ID_WBZ_AUXIO2_28_FI00 DataIndex 12947-12947;
SG_MUL_VAL_ 1557 GD_ID_WBZ_AUXIO2_29_FI00 DataIndex 12948-12948;
SG_MUL_VAL_ 1557 GD_ID_WBZ_AUXIO2_30_FI00 DataIndex 12949-12949;
SG_MUL_VAL_ 1557 GD_ID_WBZ_AUXIO2_31_FI00 DataIndex 12950-12950;
SG_MUL_VAL_ 1557 GD_ID_WBZ_AUXIO2_32_FI00 DataIndex 12951-12951;
SG_MUL_VAL_ 1557 GD_ID_WBZ_AUXIO1_01_FI01 DataIndex 12952-12952;
SG_MUL_VAL_ 1557 GD_ID_WBZ_AUXIO1_02_FI01 DataIndex 12953-12953;
SG_MUL_VAL_ 1557 GD_ID_WBZ_AUXIO1_03_FI01 DataIndex 12954-12954;
SG_MUL_VAL_ 1557 GD_ID_WBZ_AUXIO1_04_FI01 DataIndex 12955-12955;
SG_MUL_VAL_ 1557 GD_ID_WBZ_AUXIO1_05_FI01 DataIndex 12956-12956;
SG_MUL_VAL_ 1557 GD_ID_WBZ_AUXIO1_06_FI01 DataIndex 12957-12957;
SG_MUL_VAL_ 1557 GD_ID_WBZ_AUXIO1_07_FI01 DataIndex 12958-12958;
SG_MUL_VAL_ 1557 GD_ID_WBZ_AUXIO1_08_FI01 DataIndex 12959-12959;
SG_MUL_VAL_ 1557 GD_ID_WBZ_AUXIO1_09_FI01 DataIndex 12960-12960;
SG_MUL_VAL_ 1557 GD_ID_WBZ_AUXIO1_10_FI01 DataIndex 12961-12961;
SG_MUL_VAL_ 1557 GD_ID_WBZ_AUXIO1_11_FI01 DataIndex 12962-12962;
SG_MUL_VAL_ 1557 GD_ID_WBZ_AUXIO1_12_FI01 DataIndex 12963-12963;
SG_MUL_VAL_ 1557 GD_ID_WBZ_AUXIO1_13_FI01 DataIndex 12964-12964;
SG_MUL_VAL_ 1557 GD_ID_WBZ_AUXIO1_14_FI01 DataIndex 12965-12965;
SG_MUL_VAL_ 1557 GD_ID_WBZ_AUXIO1_15_FI01 DataIndex 12966-12966;
SG_MUL_VAL_ 1557 GD_ID_WBZ_AUXIO1_16_FI01 DataIndex 12967-12967;
SG_MUL_VAL_ 1557 GD_ID_WBZ_AUXIO2_17_FI01 DataIndex 12969-12969;
SG_MUL_VAL_ 1557 GD_ID_WBZ_AUXIO2_18_FI01 DataIndex 12970-12970;
SG_MUL_VAL_ 1557 GD_ID_WBZ_AUXIO2_21_FI01 DataIndex 12973-12973;
SG_MUL_VAL_ 1557 GD_ID_WBZ_AUXIO2_22_FI01 DataIndex 12974-12974;
SG_MUL_VAL_ 1557 GD_ID_WBZ_AUXIO2_26_FI01 DataIndex 12978-12978;
SG_MUL_VAL_ 1557 GD_ID_WBZ_AUXIO2_27_FI01 DataIndex 12979-12979;
SG_MUL_VAL_ 1557 GD_ID_WBZ_AUXIO2_28_FI01 DataIndex 12980-12980;
SG_MUL_VAL_ 1557 GD_ID_WBZ_AUXIO2_29_FI01 DataIndex 12981-12981;
SG_MUL_VAL_ 1557 GD_ID_WBZ_AUXIO2_30_FI01 DataIndex 12982-12982;
SG_MUL_VAL_ 1557 GD_ID_WBZ_AUXIO2_31_FI01 DataIndex 12983-12983;
SG_MUL_VAL_ 1557 GD_ID_WBZ_AUXIO2_32_FI01 DataIndex 12984-12984;
SG_MUL_VAL_ 1557 GD_ID_WBZ_AUXIO2_21_FI02 DataIndex 12985-12985;
SG_MUL_VAL_ 1557 GD_ID_WBZ_AUXIO2_22_FI02 DataIndex 12986-12986;
SG_MUL_VAL_ 1557 GD_ID_WBZ_TI_ACCESS DataIndex 13000-13000;
SG_MUL_VAL_ 1557 GD_ID_Unknown_Engine_Error_Part1 DataIndex 13052-13052;
SG_MUL_VAL_ 1557 GD_ID_Unknown_Engine_Error_Part2 DataIndex 13053-13053;
SG_MUL_VAL_ 1557 GD_ID_WBZ_DPF_WARNING_LAMP_Status DataIndex 13120-13120;
SG_MUL_VAL_ 1557 GD_ID_WBZ_DPF_WARNING_LAMP DataIndex 13120-13120;
SG_MUL_VAL_ 1557 GD_ID_WBZ_DPF_HEST_LAMP_Status DataIndex 13121-13121;
SG_MUL_VAL_ 1557 GD_ID_WBZ_DPF_HEST_LAMP DataIndex 13121-13121;
SG_MUL_VAL_ 1557 GD_ID_WBZ_DPF_SOOT_ASH DataIndex 13123-13123;
SG_MUL_VAL_ 1557 GD_ID_WBZ_DPF_HOURS_SINCE_REGEN DataIndex 13124-13124;
SG_MUL_VAL_ 1557 GD_ID_WBZ_DPF_MINUTES_SINCE_REGEN DataIndex 13125-13125;
SG_MUL_VAL_ 1557 GD_ID_WBZ_DPF_STATI DataIndex 13126-13126;
SG_MUL_VAL_ 1557 GD_ID_WBZ_DPF_INHIBITED_STATI DataIndex 13128-13128;
SG_MUL_VAL_ 1557 GD_ID_WBZ_DPF_CONTROL_REGEN DataIndex 13129-13129;
SG_MUL_VAL_ 1557 GD_ID_WBZ_DPF_ENABLE_REGEN_Status DataIndex 13130-13130;
SG_MUL_VAL_ 1557 GD_ID_WBZ_DPF_ENABLE_REGEN DataIndex 13130-13130;
SG_MUL_VAL_ 1557 GD_ID_WBZ_ErrorManagement_Status DataIndex 13294-13294;
SG_MUL_VAL_ 1557 GD_ID_WBZ_ErrorManagement DataIndex 13294-13294;
SG_MUL_VAL_ 1557 GD_ID_WBZ_LifeMessage DataIndex 13311-13311;

SG_MUL_VAL_ 1557 GD_ID_Current_Track_Width DataIndex 13824-13824;
SG_MUL_VAL_ 1557 GD_ID_TA_Min_Track_Width DataIndex 13825-13825;
SG_MUL_VAL_ 1557 GD_ID_Max_Track_Width DataIndex 13826-13826;
SG_MUL_VAL_ 1557 GD_ID_Calib_State_Track_Width_Status DataIndex 13827-13827;
SG_MUL_VAL_ 1557 GD_ID_Calib_State_Track_Width DataIndex 13827-13827;
SG_MUL_VAL_ 1557 GD_ID_TA_Front_Axle_Width DataIndex 13828-13828;
SG_MUL_VAL_ 1557 GD_ID_TA_Front_Track_Width DataIndex 13829-13829;
SG_MUL_VAL_ 1557 GD_ID_TA_Rear_Axle_Width DataIndex 13830-13830;
SG_MUL_VAL_ 1557 GD_ID_TA_Rear_Track_Width DataIndex 13831-13831;
SG_MUL_VAL_ 1557 GD_ID_Track_Adjust_Errors_Status DataIndex 13832-13832;
SG_MUL_VAL_ 1557 GD_ID_Track_Adjust_Errors DataIndex 13832-13832;
SG_MUL_VAL_ 1557 GD_ID_TA_Calibration_Command DataIndex 13833-13833;
SG_MUL_VAL_ 1557 GD_ID_TA_Calibration_State DataIndex 13834-13834;
SG_MUL_VAL_ 1557 GD_ID_TA_MANUAL_IN_Status DataIndex 13835-13835;
SG_MUL_VAL_ 1557 GD_ID_TA_MANUAL_IN DataIndex 13835-13835;
SG_MUL_VAL_ 1557 GD_ID_TA_MANUAL_OUT_Status DataIndex 13836-13836;
SG_MUL_VAL_ 1557 GD_ID_TA_MANUAL_OUT DataIndex 13836-13836;
SG_MUL_VAL_ 1557 GD_ID_TA_Actual_Front_In_R_Status DataIndex 13839-13839;
SG_MUL_VAL_ 1557 GD_ID_TA_Actual_Front_In_R DataIndex 13839-13839;
SG_MUL_VAL_ 1557 GD_ID_TA_Actual_Front_Out_R_Status DataIndex 13840-13840;
SG_MUL_VAL_ 1557 GD_ID_TA_Actual_Front_Out_R DataIndex 13840-13840;
SG_MUL_VAL_ 1557 GD_ID_TA_Actual_Rear_In_R_Status DataIndex 13841-13841;
SG_MUL_VAL_ 1557 GD_ID_TA_Actual_Rear_In_R DataIndex 13841-13841;
SG_MUL_VAL_ 1557 GD_ID_TA_Actual_Rear_Out_R_Status DataIndex 13842-13842;
SG_MUL_VAL_ 1557 GD_ID_TA_Actual_Rear_Out_R DataIndex 13842-13842;
SG_MUL_VAL_ 1557 GD_ID_TA_Actual_Front_In_Status DataIndex 13843-13843;
SG_MUL_VAL_ 1557 GD_ID_TA_Actual_Front_In DataIndex 13843-13843;
SG_MUL_VAL_ 1557 GD_ID_TA_Actual_Front_Out_Status DataIndex 13844-13844;
SG_MUL_VAL_ 1557 GD_ID_TA_Actual_Front_Out DataIndex 13844-13844;
SG_MUL_VAL_ 1557 GD_ID_TA_Actual_Rear_In_Status DataIndex 13845-13845;
SG_MUL_VAL_ 1557 GD_ID_TA_Actual_Rear_In DataIndex 13845-13845;
SG_MUL_VAL_ 1557 GD_ID_TA_Actual_Rear_Out_Status DataIndex 13846-13846;
SG_MUL_VAL_ 1557 GD_ID_TA_Actual_Rear_Out DataIndex 13846-13846;
SG_MUL_VAL_ 1557 GD_ID_Track_Adjust_Equipped_Status DataIndex 13847-13847;
SG_MUL_VAL_ 1557 GD_ID_Track_Adjust_Equipped DataIndex 13847-13847;
SG_MUL_VAL_ 1557 GD_ID_TA_Min_Tire_Track_Width DataIndex 13848-13848;
SG_MUL_VAL_ 1557 GD_ID_Current_Axle_Width DataIndex 13849-13849;
SG_MUL_VAL_ 1557 GD_ID_TA_Operation_State_Status DataIndex 13850-13850;
SG_MUL_VAL_ 1557 GD_ID_TA_Operation_State DataIndex 13850-13850;
SG_MUL_VAL_ 1557 GD_ID_TA_In_Tolerance_Status DataIndex 13851-13851;
SG_MUL_VAL_ 1557 GD_ID_TA_In_Tolerance DataIndex 13851-13851;
SG_MUL_VAL_ 1557 GD_ID_TA_Auto_Enable_A_Status DataIndex 13852-13852;
SG_MUL_VAL_ 1557 GD_ID_TA_Auto_Enable_A DataIndex 13852-13852;
SG_MUL_VAL_ 1557 GD_ID_TA_Auto_Enable_B_Status DataIndex 13853-13853;
SG_MUL_VAL_ 1557 GD_ID_TA_Auto_Enable_B DataIndex 13853-13853;
SG_MUL_VAL_ 1557 GD_ID_TA_Auto_Enable_Dual_Status DataIndex 13854-13854;
SG_MUL_VAL_ 1557 GD_ID_TA_Auto_Enable_Dual DataIndex 13854-13854;
SG_MUL_VAL_ 1557 GD_ID_TA_Setpoint_A DataIndex 13855-13855;
SG_MUL_VAL_ 1557 GD_ID_TA_Setpoint_B DataIndex 13856-13856;
SG_MUL_VAL_ 1557 GD_ID_TA_Setpoint_Dual_Front DataIndex 13857-13857;
SG_MUL_VAL_ 1557 GD_ID_TA_Setpoint_Dual_Rear DataIndex 13858-13858;
SG_MUL_VAL_ 1557 GD_ID_TA_Equipped_Status DataIndex 13864-13864;
SG_MUL_VAL_ 1557 GD_ID_TA_Equipped DataIndex 13864-13864;
SG_MUL_VAL_ 1557 GD_ID_TA_FL_POSITION DataIndex 13874-13874;
SG_MUL_VAL_ 1557 GD_ID_TA_FR_POSITION DataIndex 13875-13875;
SG_MUL_VAL_ 1557 GD_ID_TA_RL_POSITION DataIndex 13876-13876;
SG_MUL_VAL_ 1557 GD_ID_TA_RR_POSITION DataIndex 13877-13877;
SG_MUL_VAL_ 1557 GD_ID_TA_Setpoint_A_Rear_Status DataIndex 13878-13878;
SG_MUL_VAL_ 1557 GD_ID_TA_Setpoint_A_Rear DataIndex 13878-13878;
SG_MUL_VAL_ 1557 GD_ID_TA_Setpoint_B_Rear_Status DataIndex 13879-13879;
SG_MUL_VAL_ 1557 GD_ID_TA_Setpoint_B_Rear DataIndex 13879-13879;
SG_MUL_VAL_ 1557 GD_ID_TA_TARGET_TRACKWIDTH_FL DataIndex 13880-13880;
SG_MUL_VAL_ 1557 GD_ID_TA_TARGET_TRACKWIDTH_FR DataIndex 13881-13881;
SG_MUL_VAL_ 1557 GD_ID_TA_TARGET_TRACKWIDTH_RL DataIndex 13882-13882;
SG_MUL_VAL_ 1557 GD_ID_TA_TARGET_TRACKWIDTH_RR DataIndex 13883-13883;
SG_MUL_VAL_ 1557 GD_ID_TA_ADDITIONAL_WIDTH_FL DataIndex 13884-13884;
SG_MUL_VAL_ 1557 GD_ID_TA_ADDITIONAL_WIDTH_FR DataIndex 13885-13885;
SG_MUL_VAL_ 1557 GD_ID_TA_ADDITIONAL_WIDTH_RL DataIndex 13886-13886;
SG_MUL_VAL_ 1557 GD_ID_TA_ADDITIONAL_WIDTH_RR DataIndex 13887-13887;
SG_MUL_VAL_ 1557 GD_ID_TA_ErrorManagement_Status DataIndex 14318-14318;
SG_MUL_VAL_ 1557 GD_ID_TA_ErrorManagement DataIndex 14318-14318;
SG_MUL_VAL_ 1557 GD_ID_TA_LifeMessage DataIndex 14335-14335;

SG_MUL_VAL_ 1557 GD_ID_EMM_SIGNAL_LN00_ERROR_W_Status DataIndex 15872-15872;
SG_MUL_VAL_ 1557 GD_ID_EMM_SIGNAL_LN00_ERROR_W DataIndex 15872-15872;
SG_MUL_VAL_ 1557 GD_ID_EMM_SIGNAL_LN01_ERROR_W_Status DataIndex 15873-15873;
SG_MUL_VAL_ 1557 GD_ID_EMM_SIGNAL_LN01_ERROR_W DataIndex 15873-15873;
SG_MUL_VAL_ 1557 GD_ID_EMM_SIGNAL_LN02_ERROR_W_Status DataIndex 15874-15874;
SG_MUL_VAL_ 1557 GD_ID_EMM_SIGNAL_LN02_ERROR_W DataIndex 15874-15874;
SG_MUL_VAL_ 1557 GD_ID_EMM_SIGNAL_LN03_ERROR_W_Status DataIndex 15875-15875;
SG_MUL_VAL_ 1557 GD_ID_EMM_SIGNAL_LN03_ERROR_W DataIndex 15875-15875;
SG_MUL_VAL_ 1557 GD_ID_EMM_SIGNAL_LN04_ERROR_W_Status DataIndex 15876-15876;
SG_MUL_VAL_ 1557 GD_ID_EMM_SIGNAL_LN04_ERROR_W DataIndex 15876-15876;
SG_MUL_VAL_ 1557 GD_ID_EMM_SIGNAL_LN05_ERROR_W_Status DataIndex 15877-15877;
SG_MUL_VAL_ 1557 GD_ID_EMM_SIGNAL_LN05_ERROR_W DataIndex 15877-15877;
SG_MUL_VAL_ 1557 GD_ID_EMM_SIGNAL_LN06_ERROR_W_Status DataIndex 15878-15878;
SG_MUL_VAL_ 1557 GD_ID_EMM_SIGNAL_LN06_ERROR_W DataIndex 15878-15878;
SG_MUL_VAL_ 1557 GD_ID_EMM_SIGNAL_LN07_ERROR_W_Status DataIndex 15879-15879;
SG_MUL_VAL_ 1557 GD_ID_EMM_SIGNAL_LN07_ERROR_W DataIndex 15879-15879;
SG_MUL_VAL_ 1557 GD_ID_EMM_SIGNAL_LN08_ERROR_W_Status DataIndex 15880-15880;
SG_MUL_VAL_ 1557 GD_ID_EMM_SIGNAL_LN08_ERROR_W DataIndex 15880-15880;
SG_MUL_VAL_ 1557 GD_ID_EMM_SIGNAL_LN09_ERROR_W_Status DataIndex 15881-15881;
SG_MUL_VAL_ 1557 GD_ID_EMM_SIGNAL_LN09_ERROR_W DataIndex 15881-15881;
SG_MUL_VAL_ 1557 GD_ID_EMM_SIGNAL_LN10_ERROR_W_Status DataIndex 15882-15882;
SG_MUL_VAL_ 1557 GD_ID_EMM_SIGNAL_LN10_ERROR_W DataIndex 15882-15882;
SG_MUL_VAL_ 1557 GD_ID_EMM_SIGNAL_LN11_ERROR_W_Status DataIndex 15883-15883;
SG_MUL_VAL_ 1557 GD_ID_EMM_SIGNAL_LN11_ERROR_W DataIndex 15883-15883;
SG_MUL_VAL_ 1557 GD_ID_EMM_SIGNAL_LN12_ERROR_W_Status DataIndex 15884-15884;
SG_MUL_VAL_ 1557 GD_ID_EMM_SIGNAL_LN12_ERROR_W DataIndex 15884-15884;
SG_MUL_VAL_ 1557 GD_ID_EMM_SIGNAL_LN13_ERROR_W_Status DataIndex 15885-15885;
SG_MUL_VAL_ 1557 GD_ID_EMM_SIGNAL_LN13_ERROR_W DataIndex 15885-15885;
SG_MUL_VAL_ 1557 GD_ID_EMM_SIGNAL_LN14_ERROR_W_Status DataIndex 15886-15886;
SG_MUL_VAL_ 1557 GD_ID_EMM_SIGNAL_LN14_ERROR_W DataIndex 15886-15886;
SG_MUL_VAL_ 1557 GD_ID_EMM_SIGNAL_LN15_ERROR_W_Status DataIndex 15887-15887;
SG_MUL_VAL_ 1557 GD_ID_EMM_SIGNAL_LN15_ERROR_W DataIndex 15887-15887;
SG_MUL_VAL_ 1557 GD_ID_EMM_SIGNAL_LN16_ERROR_W_Status DataIndex 15888-15888;
SG_MUL_VAL_ 1557 GD_ID_EMM_SIGNAL_LN16_ERROR_W DataIndex 15888-15888;
SG_MUL_VAL_ 1557 GD_ID_EMM_SIGNAL_LN17_ERROR_W_Status DataIndex 15889-15889;
SG_MUL_VAL_ 1557 GD_ID_EMM_SIGNAL_LN17_ERROR_W DataIndex 15889-15889;
SG_MUL_VAL_ 1557 GD_ID_EMM_SIGNAL_LN18_ERROR_W_Status DataIndex 15890-15890;
SG_MUL_VAL_ 1557 GD_ID_EMM_SIGNAL_LN18_ERROR_W DataIndex 15890-15890;
SG_MUL_VAL_ 1557 GD_ID_EMM_SIGNAL_LN19_ERROR_W_Status DataIndex 15891-15891;
SG_MUL_VAL_ 1557 GD_ID_EMM_SIGNAL_LN19_ERROR_W DataIndex 15891-15891;
SG_MUL_VAL_ 1557 GD_ID_EMM_SIGNAL_LN20_ERROR_W_Status DataIndex 15892-15892;
SG_MUL_VAL_ 1557 GD_ID_EMM_SIGNAL_LN20_ERROR_W DataIndex 15892-15892;
SG_MUL_VAL_ 1557 GD_ID_EMM_SIGNAL_LN21_ERROR_W_Status DataIndex 15893-15893;
SG_MUL_VAL_ 1557 GD_ID_EMM_SIGNAL_LN21_ERROR_W DataIndex 15893-15893;
SG_MUL_VAL_ 1557 GD_ID_EMM_SIGNAL_LN22_ERROR_W_Status DataIndex 15894-15894;
SG_MUL_VAL_ 1557 GD_ID_EMM_SIGNAL_LN22_ERROR_W DataIndex 15894-15894;
SG_MUL_VAL_ 1557 GD_ID_EMM_SIGNAL_LN23_ERROR_W_Status DataIndex 15895-15895;
SG_MUL_VAL_ 1557 GD_ID_EMM_SIGNAL_LN23_ERROR_W DataIndex 15895-15895;
SG_MUL_VAL_ 1557 GD_ID_EMM_SIGNAL_LN24_ERROR_W_Status DataIndex 15896-15896;
SG_MUL_VAL_ 1557 GD_ID_EMM_SIGNAL_LN24_ERROR_W DataIndex 15896-15896;
SG_MUL_VAL_ 1557 GD_ID_EMM_SIGNAL_LN25_ERROR_W_Status DataIndex 15897-15897;
SG_MUL_VAL_ 1557 GD_ID_EMM_SIGNAL_LN25_ERROR_W DataIndex 15897-15897;
SG_MUL_VAL_ 1557 GD_ID_EMM_SIGNAL_LN26_ERROR_W_Status DataIndex 15898-15898;
SG_MUL_VAL_ 1557 GD_ID_EMM_SIGNAL_LN26_ERROR_W DataIndex 15898-15898;
SG_MUL_VAL_ 1557 GD_ID_EMM_SIGNAL_LN27_ERROR_W_Status DataIndex 15899-15899;
SG_MUL_VAL_ 1557 GD_ID_EMM_SIGNAL_LN27_ERROR_W DataIndex 15899-15899;
SG_MUL_VAL_ 1557 GD_ID_EMM_SIGNAL_LN28_ERROR_W_Status DataIndex 15900-15900;
SG_MUL_VAL_ 1557 GD_ID_EMM_SIGNAL_LN28_ERROR_W DataIndex 15900-15900;
SG_MUL_VAL_ 1557 GD_ID_EMM_SIGNAL_LN29_ERROR_W_Status DataIndex 15901-15901;
SG_MUL_VAL_ 1557 GD_ID_EMM_SIGNAL_LN29_ERROR_W DataIndex 15901-15901;
SG_MUL_VAL_ 1557 GD_ID_EMM_SIGNAL_LN30_ERROR_W_Status DataIndex 15902-15902;
SG_MUL_VAL_ 1557 GD_ID_EMM_SIGNAL_LN30_ERROR_W DataIndex 15902-15902;
SG_MUL_VAL_ 1557 GD_ID_EMM_SIGNAL_LN31_ERROR_W_Status DataIndex 15903-15903;
SG_MUL_VAL_ 1557 GD_ID_EMM_SIGNAL_LN31_ERROR_W DataIndex 15903-15903;
SG_MUL_VAL_ 1557 GD_ID_EMM_SIGNAL_LN32_ERROR_W_Status DataIndex 15904-15904;
SG_MUL_VAL_ 1557 GD_ID_EMM_SIGNAL_LN32_ERROR_W DataIndex 15904-15904;
SG_MUL_VAL_ 1557 GD_ID_EMM_SIGNAL_LN33_ERROR_W_Status DataIndex 15905-15905;
SG_MUL_VAL_ 1557 GD_ID_EMM_SIGNAL_LN33_ERROR_W DataIndex 15905-15905;
SG_MUL_VAL_ 1557 GD_ID_EMM_SIGNAL_LN34_ERROR_W_Status DataIndex 15906-15906;
SG_MUL_VAL_ 1557 GD_ID_EMM_SIGNAL_LN34_ERROR_W DataIndex 15906-15906;
SG_MUL_VAL_ 1557 GD_ID_EMM_SIGNAL_LN35_ERROR_W_Status DataIndex 15907-15907;
SG_MUL_VAL_ 1557 GD_ID_EMM_SIGNAL_LN35_ERROR_W DataIndex 15907-15907;
SG_MUL_VAL_ 1557 GD_ID_EMM_SIGNAL_LN36_ERROR_W_Status DataIndex 15908-15908;
SG_MUL_VAL_ 1557 GD_ID_EMM_SIGNAL_LN36_ERROR_W DataIndex 15908-15908;
SG_MUL_VAL_ 1557 GD_ID_EMM_SIGNAL_LN37_ERROR_W_Status DataIndex 15909-15909;
SG_MUL_VAL_ 1557 GD_ID_EMM_SIGNAL_LN37_ERROR_W DataIndex 15909-15909;
SG_MUL_VAL_ 1557 GD_ID_EMM_SIGNAL_LN38_ERROR_W_Status DataIndex 15910-15910;
SG_MUL_VAL_ 1557 GD_ID_EMM_SIGNAL_LN38_ERROR_W DataIndex 15910-15910;
SG_MUL_VAL_ 1557 GD_ID_EMM_SIGNAL_LN39_ERROR_W_Status DataIndex 15911-15911;
SG_MUL_VAL_ 1557 GD_ID_EMM_SIGNAL_LN39_ERROR_W DataIndex 15911-15911;
SG_MUL_VAL_ 1557 GD_ID_EMM_SIGNAL_LN40_ERROR_W_Status DataIndex 15912-15912;
SG_MUL_VAL_ 1557 GD_ID_EMM_SIGNAL_LN40_ERROR_W DataIndex 15912-15912;
SG_MUL_VAL_ 1557 GD_ID_EMM_SIGNAL_LN41_ERROR_W_Status DataIndex 15913-15913;
SG_MUL_VAL_ 1557 GD_ID_EMM_SIGNAL_LN41_ERROR_W DataIndex 15913-15913;
SG_MUL_VAL_ 1557 GD_ID_EMM_SIGNAL_LN42_ERROR_W_Status DataIndex 15914-15914;
SG_MUL_VAL_ 1557 GD_ID_EMM_SIGNAL_LN42_ERROR_W DataIndex 15914-15914;
SG_MUL_VAL_ 1557 GD_ID_EMM_SIGNAL_LN43_ERROR_W_Status DataIndex 15915-15915;
SG_MUL_VAL_ 1557 GD_ID_EMM_SIGNAL_LN43_ERROR_W DataIndex 15915-15915;
SG_MUL_VAL_ 1557 GD_ID_EMM_SIGNAL_LN44_ERROR_W_Status DataIndex 15916-15916;
SG_MUL_VAL_ 1557 GD_ID_EMM_SIGNAL_LN44_ERROR_W DataIndex 15916-15916;
SG_MUL_VAL_ 1557 GD_ID_EMM_SIGNAL_LN45_ERROR_W_Status DataIndex 15917-15917;
SG_MUL_VAL_ 1557 GD_ID_EMM_SIGNAL_LN45_ERROR_W DataIndex 15917-15917;
SG_MUL_VAL_ 1557 GD_ID_EMM_SIGNAL_LN46_ERROR_W_Status DataIndex 15918-15918;
SG_MUL_VAL_ 1557 GD_ID_EMM_SIGNAL_LN46_ERROR_W DataIndex 15918-15918;
SG_MUL_VAL_ 1557 GD_ID_EMM_SIGNAL_LN47_ERROR_W_Status DataIndex 15919-15919;
SG_MUL_VAL_ 1557 GD_ID_EMM_SIGNAL_LN47_ERROR_W DataIndex 15919-15919;
SG_MUL_VAL_ 1557 GD_ID_EMM_SIGNAL_LN48_ERROR_W_Status DataIndex 15920-15920;
