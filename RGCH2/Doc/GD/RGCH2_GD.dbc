VERSION "HIPBNYYYYYYYYYYYYYYYYYYYYYYYYYYYNNNNNNNNNN/4/%%%/4/'%**4NNN///"

NS_ :

BS_:

BU_: ecuDASH ecuCHS ecuNT01 ecuMFA ecuDIAGNOSE ecuVD03 ecuZE ecuLCP ecu ecuACM

BA_DEF_ BO_  "VFrameFormat" ENUM  "StandardCAN","ExtendedCAN","reserved","J1939PG";
BA_DEF_DEF_  "VFrameFormat" "J1939PG";
BA_ "VFrameFormat" BO_ 1552 0;
BA_ "VFrameFormat" BO_ 1559 0;
VAL_ 1552 Index 1024 "GD_ID_NT01_Date_Year" 1025 "GD_ID_NT01_Date_Month" 1026 "GD_ID_NT01_Date_Day" 1027 "GD_ID_NT01_Date_WeekDay" 1028 "GD_ID_NT01_Time_Hours" 1029 "GD_ID_NT01_Time_Minutes" 1030 "GD_ID_NT01_Time_Seconds" 1045 "GD_ID_NT01_MainBoardTemp" 1056 "GD_ID_NT01_LightSensor_Status" 1056 "GD_ID_NT01_LightSensor" 1281 "GD_ID_NT01_Software_Version" 1282 "GD_ID_NT01_Software_Revision" 1283 "GD_ID_NT01_Build_Date_Day_Month" 1284 "GD_ID_NT01_Build_Date_Year" 1285 "GD_ID_NT01_Build_Time_Hrs_Min" 1286 "GD_ID_NT01_Build_Time_Seconds" 1036 "GD_ID_Time_Seconds" 1037 "GD_ID_Time_Hours_Minutes" 1038 "GD_ID_Date_Month_Day" 1039 "GD_ID_Date_Year" 1518 "GD_ID_NT01_ErrorManagement_Status" 1518 "GD_ID_NT01_ErrorManagement" 1535 "GD_ID_NT01_LifeMessage" 1536 "GD_ID_MFA_A19_Status" 1536 "GD_ID_MFA_A19" 1544 "GD_ID_MFA_A11_Status" 1544 "GD_ID_MFA_A11" 1545 "GD_ID_MFA_A11_LED" 1546 "GD_ID_MFA_A12_Status" 1546 "GD_ID_MFA_A12" 1547 "GD_ID_MFA_A12_LED" 1548 "GD_ID_MFA_A13_Status" 1548 "GD_ID_MFA_A13" 1549 "GD_ID_MFA_A13_LED" 1550 "GD_ID_MFA_A14_Status" 1550 "GD_ID_MFA_A14" 1551 "GD_ID_MFA_A14_LED" 1562 "GD_ID_MFA_A1_Status" 1562 "GD_ID_MFA_A1" 1563 "GD_ID_MFA_A2_Status" 1563 "GD_ID_MFA_A2" 1568 "GD_ID_MFA_A10_Status" 1568 "GD_ID_MFA_A10" 1569 "GD_ID_MFA_A8_Status" 1569 "GD_ID_MFA_A8" 1570 "GD_ID_MFA_A7_Status" 1570 "GD_ID_MFA_A7" 1571 "GD_ID_MFA_A24_Status" 1571 "GD_ID_MFA_A24" 1572 "GD_ID_MFA_A9_Status" 1572 "GD_ID_MFA_A9" 1573 "GD_ID_MFA_A26_Status" 1573 "GD_ID_MFA_A26" 1574 "GD_ID_MFA_A17_Status" 1574 "GD_ID_MFA_A17" 1575 "GD_ID_MFA_A18_Status" 1575 "GD_ID_MFA_A18" 1576 "GD_ID_MFA_A15_Status" 1576 "GD_ID_MFA_A15" 1577 "GD_ID_MFA_A16_Status" 1577 "GD_ID_MFA_A16" 1578 "GD_ID_MFA_A3_Status" 1578 "GD_ID_MFA_A3" 1579 "GD_ID_MFA_A20_Status" 1579 "GD_ID_MFA_A20" 1580 "GD_ID_MFA_A5_Status" 1580 "GD_ID_MFA_A5" 1581 "GD_ID_MFA_A22_Status" 1581 "GD_ID_MFA_A22" 1582 "GD_ID_MFA_A4_Status" 1582 "GD_ID_MFA_A4" 1583 "GD_ID_MFA_A6_Status" 1583 "GD_ID_MFA_A6" 1584 "GD_ID_MFA_E1_Status" 1584 "GD_ID_MFA_E1" 1585 "GD_ID_MFA_E2_Status" 1585 "GD_ID_MFA_E2" 1586 "GD_ID_MFA_E3_Status" 1586 "GD_ID_MFA_E3" 1587 "GD_ID_MFA_E4_Status" 1587 "GD_ID_MFA_E4" 1590 "GD_ID_MFA_ZONE_D_ROCKER_1" 1591 "GD_ID_MFA_ZONE_D_LED_ROCKER_1" 1592 "GD_ID_MFA_ZONE_D_ROCKER_2" 1593 "GD_ID_MFA_ZONE_D_LED_ROCKER_2" 1594 "GD_ID_MFA_ZONE_D_ROCKER_3" 1595 "GD_ID_MFA_ZONE_D_LED_ROCKER_3" 1596 "GD_ID_MFA_ZONE_D_ROCKER_4" 1597 "GD_ID_MFA_ZONE_D_LED_ROCKER_4" 1598 "GD_ID_MFA_ZONE_D_ROCKER_5" 1599 "GD_ID_MFA_ZONE_D_LED_ROCKER_5" 1600 "GD_ID_MFA_B1_Status" 1600 "GD_ID_MFA_B1" 1601 "GD_ID_MFA_F1_Status" 1601 "GD_ID_MFA_F1" 1632 "GD_ID_MFA_C17_Status" 1632 "GD_ID_MFA_C17" 1633 "GD_ID_MFA_C17_LED" 1634 "GD_ID_MFA_C18_Status" 1634 "GD_ID_MFA_C18" 1635 "GD_ID_MFA_C18_LED" 1636 "GD_ID_MFA_C9_Status" 1636 "GD_ID_MFA_C9" 1637 "GD_ID_MFA_C9_LED" 1638 "GD_ID_MFA_C10_Status" 1638 "GD_ID_MFA_C10" 1639 "GD_ID_MFA_C10_LED" 1640 "GD_ID_MFA_C1_Status" 1640 "GD_ID_MFA_C1" 1641 "GD_ID_MFA_C1_LED" 1642 "GD_ID_MFA_C2_Status" 1642 "GD_ID_MFA_C2" 1643 "GD_ID_MFA_C2_LED" 1644 "GD_ID_MFA_ZONE_D_BUTTON_LEFT_INSIDE_Status" 1644 "GD_ID_MFA_ZONE_D_BUTTON_LEFT_INSIDE" 1645 "GD_ID_MFA_ZONE_D_LED_LEFT_INSIDE" 1646 "GD_ID_MFA_ZONE_D_BUTTON_LEFT_OUTSIDE_Status" 1646 "GD_ID_MFA_ZONE_D_BUTTON_LEFT_OUTSIDE" 1647 "GD_ID_MFA_ZONE_D_LED_LEFT_OUTSIDE" 1648 "GD_ID_MFA_C19_Status" 1648 "GD_ID_MFA_C19" 1649 "GD_ID_MFA_C19_LED" 1650 "GD_ID_MFA_C20_Status" 1650 "GD_ID_MFA_C20" 1651 "GD_ID_MFA_C20_LED" 1652 "GD_ID_MFA_C11_Status" 1652 "GD_ID_MFA_C11" 1653 "GD_ID_MFA_C11_LED" 1654 "GD_ID_MFA_C12_Status" 1654 "GD_ID_MFA_C12" 1655 "GD_ID_MFA_C12_LED" 1656 "GD_ID_MFA_C3_Status" 1656 "GD_ID_MFA_C3" 1657 "GD_ID_MFA_C3_LED" 1658 "GD_ID_MFA_C4_Status" 1658 "GD_ID_MFA_C4" 1659 "GD_ID_MFA_C4_LED" 1660 "GD_ID_MFA_ZONE_D_BUTTON_RIGHT_INSIDE_Status" 1660 "GD_ID_MFA_ZONE_D_BUTTON_RIGHT_INSIDE" 1661 "GD_ID_MFA_ZONE_D_LED_RIGHT_INSIDE" 1662 "GD_ID_MFA_ZONE_D_BUTTON_RIGHT_OUTSIDE_Status" 1662 "GD_ID_MFA_ZONE_D_BUTTON_RIGHT_OUTSIDE" 1663 "GD_ID_MFA_ZONE_D_LED_RIGHT_OUTSIDE" 1664 "GD_ID_MFA_C21_Status" 1664 "GD_ID_MFA_C21" 1665 "GD_ID_MFA_C21_LED" 1666 "GD_ID_MFA_C22_Status" 1666 "GD_ID_MFA_C22" 1667 "GD_ID_MFA_C22_LED" 1668 "GD_ID_MFA_C13_Status" 1668 "GD_ID_MFA_C13" 1669 "GD_ID_MFA_C13_LED" 1670 "GD_ID_MFA_C14_Status" 1670 "GD_ID_MFA_C14" 1671 "GD_ID_MFA_C14_LED" 1672 "GD_ID_MFA_C5_Status" 1672 "GD_ID_MFA_C5" 1673 "GD_ID_MFA_C5_LED" 1674 "GD_ID_MFA_C6_Status" 1674 "GD_ID_MFA_C6" 1675 "GD_ID_MFA_C6_LED" 1680 "GD_ID_MFA_C23_Status" 1680 "GD_ID_MFA_C23" 1681 "GD_ID_MFA_C23_LED" 1682 "GD_ID_MFA_C24_Status" 1682 "GD_ID_MFA_C24" 1683 "GD_ID_MFA_C24_LED" 1684 "GD_ID_MFA_C15_Status" 1684 "GD_ID_MFA_C15" 1685 "GD_ID_MFA_C15_LED" 1686 "GD_ID_MFA_C16_Status" 1686 "GD_ID_MFA_C16" 1687 "GD_ID_MFA_C16_LED" 1688 "GD_ID_MFA_C7_Status" 1688 "GD_ID_MFA_C7" 1689 "GD_ID_MFA_C7_LED" 1690 "GD_ID_MFA_C8_Status" 1690 "GD_ID_MFA_C8" 1691 "GD_ID_MFA_C8_LED" 1696 "GD_ID_MFA_FunctionLighting" 1697 "GD_ID_MFA_NightDesign" 1736 "GD_ID_MFA_Throttle_CalibCmd" 1737 "GD_ID_MFA_Throttle_CalibState" 1738 "GD_ID_MFA_UNKNOWN_Calibration_Cmd" 1739 "GD_ID_MFA_UNKNOWN_Calibration_Status" 1740 "GD_ID_LM1_CalibrationCommand" 1741 "GD_ID_LM1_CalibrationStatus" 1742 "GD_ID_MFA_Lever_CalibCmd" 1743 "GD_ID_MFA_Lever_CalibState" 1744 "GD_ID_LM3_CalibrationCommand" 1745 "GD_ID_LM3_CalibrationStatus" 1746 "GD_ID_LM4_CalibrationCommand" 1747 "GD_ID_LM4_CalibrationStatus" 2030 "GD_ID_MFA_ErrorManagement_Status" 2030 "GD_ID_MFA_ErrorManagement" 2032 "GD_ID_HwConfigMFA" 2033 "GD_ID_IdentificationModule" 2036 "GD_ID_MFA_SoftwareVersion" 2037 "GD_ID_SwVersionAJS" 2040 "GD_ID_SerialNumber1st" 2041 "GD_ID_SerialNumber2nd" 2047 "GD_ID_MFA_LifeMessage" 2049 "GD_ID_DRIVE_AIR_PRESSURE" 2050 "GD_ID_DRIVE_HYDRAULICS_ENABLE_Status" 2050 "GD_ID_DRIVE_HYDRAULICS_ENABLE" 2051 "GD_ID_DRIVE_REQUEST_HYD_ENABLE_OFF_Status" 2051 "GD_ID_DRIVE_REQUEST_HYD_ENABLE_OFF" 2052 "GD_ID_DRIVE_BRAKE_PEDAL_POSITION_A" 2053 "GD_ID_DRIVE_BRAKE_PEDAL_POSITION_B" 2054 "GD_ID_DRIVE_BRAKE_PEDAL_POSITION" 2055 "GD_ID_DRIVE_HYD_MOT_RPM_FR" 2056 "GD_ID_DRIVE_HYD_MOT_RPM_RR" 2057 "GD_ID_DRIVE_HYD_MOT_RPM_RL" 2058 "GD_ID_DRIVE_HYD_MOT_RPM_FL" 2061 "GD_ID_DRIVE_FORWARD_SS_DEFAULT_SPEED" 2062 "GD_ID_DRIVE_REVERSE_SS_DEFAULT_SPEED" 2063 "GD_ID_DRIVE_WHEEL_BASED_MACHINE_SPEED" 2064 "GD_ID_DRIVE_DANFOSS_IN_SV_STATE_COMMANDED_Status" 2064 "GD_ID_DRIVE_DANFOSS_IN_SV_STATE_COMMANDED" 2065 "GD_ID_DRIVE_DANFOSS_OUT_SV_STATE_ACTUAL_Status" 2065 "GD_ID_DRIVE_DANFOSS_OUT_SV_STATE_ACTUAL" 2066 "GD_ID_DRIVE_DANFOSS_IN_SV_SPEED" 2067 "GD_ID_DRIVE_DANFOSS_OUT_DRIVE_MODE_ACTUAL_Status" 2067 "GD_ID_DRIVE_DANFOSS_OUT_DRIVE_MODE_ACTUAL" 2068 "GD_ID_DRIVE_DANFOSS_IN_DRIVE_MODE_COMMANDED_Status" 2068 "GD_ID_DRIVE_DANFOSS_IN_DRIVE_MODE_COMMANDED" 2069 "GD_ID_DRIVE_SV_1_Status" 2069 "GD_ID_DRIVE_SV_1" 2070 "GD_ID_DRIVE_SV_2_Status" 2070 "GD_ID_DRIVE_SV_2" 2071 "GD_ID_DRIVE_SV_STATE" 2072 "GD_ID_DRIVE_MAX_ENGINE_DROP" 2076 "GD_ID_DRIVE_CALIB_STATE_BRAKE_PEDAL_Status" 2076 "GD_ID_DRIVE_CALIB_STATE_BRAKE_PEDAL" 2077 "GD_ID_DRIVE_MAX_SV_SPEED" 2078 "GD_ID_DRIVE_PRESSURE_A" 2079 "GD_ID_DRIVE_PRESSURE_B" 2080 "GD_ID_DRIVE_CHARGE_PRESSURE" 2084 "GD_ID_DRIVE_DASH_DISPLAYED_ENGINE_SPEED" 2085 "GD_ID_DRIVE_FRONT_STEER_ANGLE" 2086 "GD_ID_DRIVE_DANFOSS_OUT_PARKBRK_REQUEST_Status" 2086 "GD_ID_DRIVE_DANFOSS_OUT_PARKBRK_REQUEST" 2087 "GD_ID_DRIVE_DANFOSS_OUT_CCO_VALVE_REQUEST_Status" 2087 "GD_ID_DRIVE_DANFOSS_OUT_CCO_VALVE_REQUEST" 2088 "GD_ID_DRIVE_CCO_VALVE_COMMAND_Status" 2088 "GD_ID_DRIVE_CCO_VALVE_COMMAND" 2092 "GD_ID_DRIVE_TIRE_RCI" 2094 "GD_ID_DRIVE_DASH_DISPLAYED_MACHINE_SPEED2" 2095 "GD_ID_DRIVE_CARGO_OVER_WEIGHT_Status" 2095 "GD_ID_DRIVE_CARGO_OVER_WEIGHT" 2096 "GD_ID_DRIVE_ROGATOR_MACHINE_CONFIGURATION" 2097 "GD_ID_DRIVE_TIRE_ROLLING_CIRCUMFERENCE" 2098 "GD_ID_DRIVE_BRAKE_LIGHT_COMMAND_Status" 2098 "GD_ID_DRIVE_BRAKE_LIGHT_COMMAND" 2099 "GD_ID_DRIVE_TARGET_MACHINE_SPEED" 2100 "GD_ID_DRIVE_MAX_MACHINE_SPEED" 2101 "GD_ID_DRIVE_EXPECTED_MACHINE_SPEED" 2111 "GD_ID_DRIVE_CALIB_BRAKE_PEDAL_START_Status" 2111 "GD_ID_DRIVE_CALIB_BRAKE_PEDAL_START" 2112 "GD_ID_DRIVE_CALIB_BRAKE_PEDAL_ACTIVE_Status" 2112 "GD_ID_DRIVE_CALIB_BRAKE_PEDAL_ACTIVE" 2113 "GD_ID_DRIVE_CALIB_BRAKE_PEDAL_DOWN_Status" 2113 "GD_ID_DRIVE_CALIB_BRAKE_PEDAL_DOWN" 2114 "GD_ID_DRIVE_CALIB_BRAKE_PEDAL_DOWN_RET_Status" 2114 "GD_ID_DRIVE_CALIB_BRAKE_PEDAL_DOWN_RET" 2115 "GD_ID_DRIVE_CALIB_BRAKE_PEDAL_UP_Status" 2115 "GD_ID_DRIVE_CALIB_BRAKE_PEDAL_UP" 2116 "GD_ID_DRIVE_CALIB_BRAKE_PEDAL_UP_RET_Status" 2116 "GD_ID_DRIVE_CALIB_BRAKE_PEDAL_UP_RET" 2117 "GD_ID_DRIVE_CALIB_BRAKE_PEDAL_ACCEPT_Status" 2117 "GD_ID_DRIVE_CALIB_BRAKE_PEDAL_ACCEPT" 2118 "GD_ID_DRIVE_CALIB_BRAKE_PEDAL_DECLINE_Status" 2118 "GD_ID_DRIVE_CALIB_BRAKE_PEDAL_DECLINE" 2119 "GD_ID_DRIVE_CALIB_BRAKE_PEDAL_PROCESSED_Status" 2119 "GD_ID_DRIVE_CALIB_BRAKE_PEDAL_PROCESSED" 2120 "GD_ID_DRIVE_CALIB_BRAKE_PEDAL_ERROR_Status" 2120 "GD_ID_DRIVE_CALIB_BRAKE_PEDAL_ERROR" 2121 "GD_ID_DRIVE_FIELD_STREET_STATE" 2122 "GD_ID_DRIVE_DTM_ENALBED_IN_MANUAL_Status" 2122 "GD_ID_DRIVE_DTM_ENALBED_IN_MANUAL" 2123 "GD_ID_DRIVE_STATE" 2124 "GD_ID_DRIVE_DTM_MIN_RPM" 2125 "GD_ID_DRIVE_DTM_MAX_RPM" 2126 "GD_ID_DRIVE_DRIVEPUMP_A_COMCURRENT" 2127 "GD_ID_DRIVE_DRIVEPUMP_B_COMCURRENT" 2128 "GD_ID_DRIVE_HYD_MOT_FR_COMCURRENT" 2129 "GD_ID_DRIVE_HYD_MOT_RR_COMCURRENT" 2130 "GD_ID_DRIVE_HYD_MOT_RL_COMCURRENT" 2131 "GD_ID_DRIVE_HYD_MOT_FL_COMCURRENT" 2133 "GD_ID_DRIVE_HYDRAULIC_OIl_TEMP" 2135 "GD_ID_DRIVE_FUEL_LEVEL" 2137 "GD_ID_DRIVE_PARKBRAKE_COMMAND_Status" 2137 "GD_ID_DRIVE_PARKBRAKE_COMMAND" 2138 "GD_ID_DRIVE_OPERATION_MODE" 2139 "GD_ID_DRIVE_DRIVEPUMP_A_FEEDBACK_CURRENT" 2140 "GD_ID_DRIVE_DRIVEPUMP_B_FEEDBACK_CURRENT" 2141 "GD_ID_DRIVE_HYD_MOT_FR_FEEDBACK_CURRENT" 2142 "GD_ID_DRIVE_HYD_MOT_RR_FEEDBACK_CURRENT" 2143 "GD_ID_DRIVE_HYD_MOT_RL_FEEDBACK_CURRENT" 2144 "GD_ID_DRIVE_HYD_MOT_FL_FEEDBACK_CURRENT" 2150 "GD_ID_DRIVE_RADAR_SPEED" 2175 "GD_ID_DRIVE_DASH_DISPLAYED_PARK_BRAKE_LED_Status" 2175 "GD_ID_DRIVE_DASH_DISPLAYED_PARK_BRAKE_LED" 2192 "GD_ID_DRIVE_CURRENT_GEAR" 2193 "GD_ID_DRIVE_SELECTED_GEAR" 2194 "GD_ID_DRIVE_DRIVE_PEDAL_POSITION" 2207 "GD_ID_DRIVE_DASH_DISPLAYED_MACHINE_SPEED1" 2258 "GD_ID_DRIVE_DTM_COMMANDED_RPM" 2300 "GD_ID_DRIVE_DISPLAY_UNITS_Status" 2300 "GD_ID_DRIVE_DISPLAY_UNITS" 2348 "GD_ID_DRIVE_RESET_DEFAULT_PROFILES_Status" 2348 "GD_ID_DRIVE_RESET_DEFAULT_PROFILES" 2349 "GD_ID_DRIVE_LEVER_ACCEL_PROFILE" 2350 "GD_ID_DRIVE_LEVER_DECEL_PROFILE" 2351 "GD_ID_DRIVE_PEDAL_ACCEL_PROFILE" 2352 "GD_ID_DRIVE_PEDAL_DECEL_PROFILE" 2353 "GD_ID_DRIVE_SV_ACCELDECEL_PROFILE" 2355 "GD_ID_DRIVE_SHUTTLE_ACCELDECEL_PROFILE" 2373 "GD_ID_DRIVE_DANFOSS_IN_OUTFAULTS" 2374 "GD_ID_ASC_RAMP_RL_DECTM" 2375 "GD_ID_ASC_PID_FL_KIUP_ASC" 2376 "GD_ID_ASC_PID_FL_KIDOWN_ASC" 2377 "GD_ID_ASC_PID_FL_KPUP_ASC" 2378 "GD_ID_ASC_PID_FL_KPDOWN_ASC" 2379 "GD_ID_ASC_PID_FL_KDUP_ASC" 2380 "GD_ID_ASC_PID_FL_IRED" 2381 "GD_ID_ASC_INCHING_INCHMODE" 2382 "GD_ID_ASC_INCHING_TVOLINCH" 2383 "GD_ID_ASC_REFSPDDISABLE_ABS_MINREFSPD_MMSEC" 2384 "GD_ID_ASC_REFSPDDISABLE_ASC_MINREFSPD_MMSEC" 2385 "GD_ID_ASC_REFSPDDISABLE_ABS_DECRAMP60K" 2386 "GD_ID_ASC_FFPROFILES_REVBRAKINGFRONT_Y4_PTC2" 2387 "GD_ID_ASC_FFPROFILES_REVBRAKINGFRONT_Y5_PTC2" 2388 "GD_ID_ASC_FFPROFILES_REVBRAKINGFRONT_Y6_PTC2" 2389 "GD_ID_ASC_FFPROFILES_FWDBRAKINGREAR_Y5_PTC2_LD" 2390 "GD_ID_ASC_FFPROFILES_FWDBRAKINGREAR_Y5_PTC2" 2391 "GD_ID_ASC_FFPROFILES_FWDBRAKINGREAR_Y6_PTC2_LD" 2392 "GD_ID_ASC_FFPROFILES_FWDBRAKINGREAR_Y6_PTC2" 2393 "GD_ID_ASC_CORE_ASC_MINTOLERANCE_PCT2" 2394 "GD_ID_ASC_PID_RL_KDUP_ASC" 2395 "GD_ID_ASC_PID_RL_KPUP_ASC" 2396 "GD_ID_ASC_PID_RL_KPDN_ASC" 2397 "GD_ID_ASC_PID_RL_KIUP_ASC" 2398 "GD_ID_ASC_PID_RL_KIDN_ASC" 2399 "GD_ID_ASC_PID_RL_IRED" 2400 "GD_ID_BRK_Y5" 2401 "GD_ID_ENGADJLD_FILTERTM_MS" 2402 "GD_ID_ENGADJLD_Y4" 2403 "GD_ID_MV_I_INT_I_GAIN" 2404 "GD_ID_MISC_PR_PERACT_Y3" 2405 "GD_ID_MISC_PR_PERACT_Y4" 2406 "GD_ID_MISC_PR_PERACT_Y5" 2407 "GD_ID_ASC_Core_ABS_Ang_Y1_ptc2" 2408 "GD_ID_ASC_Core_ABS_Ang_Y2_ptc2" 2409 "GD_ID_ASC_Core_ABS_Ang_Y3_ptc2" 2410 "GD_ID_ASC_Core_ABS_Ang_Y4_ptc2" 2411 "GD_ID_ASC_Core_ABS_Ang_Y5_ptc2" 2412 "GD_ID_ASC_Core_ABS_MinTolerance_pct2" 2413 "GD_ID_ASC_Core_ASC_Ang_Y1_ptc2" 2414 "GD_ID_ASC_Core_ASC_Ang_Y2_ptc2" 2415 "GD_ID_ASC_Core_ASC_Ang_Y3_ptc2" 2416 "GD_ID_ASC_Core_ASC_Ang_Y4_ptc2" 2417 "GD_ID_ASC_Core_ASC_Ang_Y5_ptc2" 2458 "GD_ID_DRIVE_PEDAL_CAL_COMMAND_Status" 2458 "GD_ID_DRIVE_PEDAL_CAL_COMMAND" 2459 "GD_ID_DRIVE_PEDAL_CAL_STATE_Status" 2459 "GD_ID_DRIVE_PEDAL_CAL_STATE" 2460 "GD_ID_DRIVE_BRAKE_PEDAL_CAL_COMMAND_Status" 2460 "GD_ID_DRIVE_BRAKE_PEDAL_CAL_COMMAND" 2461 "GD_ID_DRIVE_BRAKE_PEDAL_CAL_STATE_Status" 2461 "GD_ID_DRIVE_BRAKE_PEDAL_CAL_STATE" 2462 "GD_ID_DRIVE_WAS_CAL_COMMAND_Status" 2462 "GD_ID_DRIVE_WAS_CAL_COMMAND" 2463 "GD_ID_DRIVE_WAS_CAL_STATE_Status" 2463 "GD_ID_DRIVE_WAS_CAL_STATE" 2464 "GD_ID_DRIVE_HYDRO_CAL_COMMAND_Status" 2464 "GD_ID_DRIVE_HYDRO_CAL_COMMAND" 2465 "GD_ID_DRIVE_HYDRO_CAL_STATE_Status" 2465 "GD_ID_DRIVE_HYDRO_CAL_STATE" 2468 "GD_ID_DRIVE_WHEEL_SPEED_CALIBRATION_COMMAND_Status" 2468 "GD_ID_DRIVE_WHEEL_SPEED_CALIBRATION_COMMAND" 2469 "GD_ID_DRIVE_WHEEL_SPEED_CALIBRATION_STATE_Status" 2469 "GD_ID_DRIVE_WHEEL_SPEED_CALIBRATION_STATE" 2470 "GD_ID_DRIVE_WHEEL_SPEED_CALIBRATION_USER_DISTANCE_Status" 2470 "GD_ID_DRIVE_WHEEL_SPEED_CALIBRATION_USER_DISTANCE" 2471 "GD_ID_DRIVE_RADAR_CALIBRATION_COMMAND_Status" 2471 "GD_ID_DRIVE_RADAR_CALIBRATION_COMMAND" 2472 "GD_ID_DRIVE_RADAR_CALIBRATION_STATE_Status" 2472 "GD_ID_DRIVE_RADAR_CALIBRATION_STATE" 2473 "GD_ID_DRIVE_RADAR_CALIBRATION_USER_DISTANCE_Status" 2473 "GD_ID_DRIVE_RADAR_CALIBRATION_USER_DISTANCE" 2474 "GD_ID_DRIVE_COMBO_CALIBRATION_COMMAND_Status" 2474 "GD_ID_DRIVE_COMBO_CALIBRATION_COMMAND" 2475 "GD_ID_DRIVE_COMBO_CALIBRATION_STATE_Status" 2475 "GD_ID_DRIVE_COMBO_CALIBRATION_STATE" 2476 "GD_ID_DRIVE_COMBO_CALIBRATION_USER_DISTANCE_Status" 2476 "GD_ID_DRIVE_COMBO_CALIBRATION_USER_DISTANCE" 2498 "GD_ID_DRIVE_DRIVEPUMP_A_START_CAL_CURRENT_STORED" 2499 "GD_ID_DRIVE_DRIVEPUMP_A_END_CAL_CURRENT_STORED" 2500 "GD_ID_DRIVE_DRIVEPUMP_B_START_CAL_CURRENT_STORED" 2501 "GD_ID_DRIVE_DRIVEPUMP_B_END_CAL_CURRENT_STORED" 2502 "GD_ID_DRIVE_MOTOR_FL_START_CAL_CURRENT_STORED" 2503 "GD_ID_DRIVE_MOTOR_FL_END_CAL_CURRENT_STORED" 2504 "GD_ID_DRIVE_MOTOR_FR_START_CAL_CURRENT_STORED" 2505 "GD_ID_DRIVE_MOTOR_FR_END_CAL_CURRENT_STORED" 2506 "GD_ID_DRIVE_MOTOR_RL_START_CAL_CURRENT_STORED" 2507 "GD_ID_DRIVE_MOTOR_RL_END_CAL_CURRENT_STORED" 2508 "GD_ID_DRIVE_MOTOR_RR_START_CAL_CURRENT_STORED" 2509 "GD_ID_DRIVE_MOTOR_RR_END_CAL_CURRENT_STORED" 2510 "GD_ID_DRIVE_DRIVEPUMP_A_START_CAL_CURRENT_NEW" 2511 "GD_ID_DRIVE_DRIVEPUMP_A_END_CAL_CURRENT_NEW" 2512 "GD_ID_DRIVE_DRIVEPUMP_B_START_CAL_CURRENT_NEW" 2513 "GD_ID_DRIVE_DRIVEPUMP_B_END_CAL_CURRENT_NEW" 2514 "GD_ID_DRIVE_MOTOR_FL_START_CAL_CURRENT_NEW" 2515 "GD_ID_DRIVE_MOTOR_FL_END_CAL_CURRENT_NEW" 2516 "GD_ID_DRIVE_MOTOR_FR_START_CAL_CURRENT_NEW" 2517 "GD_ID_DRIVE_MOTOR_FR_END_CAL_CURRENT_NEW" 2518 "GD_ID_DRIVE_MOTOR_RL_START_CAL_CURRENT_NEW" 2519 "GD_ID_DRIVE_MOTOR_RL_END_CAL_CURRENT_NEW" 2520 "GD_ID_DRIVE_MOTOR_RR_START_CAL_CURRENT_NEW" 2521 "GD_ID_DRIVE_MOTOR_RR_END_CAL_CURRENT_NEW" 2523 "GD_ID_DRIVE_DANFOSS_CAL_REQUEST" 2525 "GD_ID_DRIVE_WHEEL_BASED_MACHINE_SPEED_KPH" 2526 "GD_ID_DRIVE_NORMALIZED_WHEEL_SPEED_FL" 2527 "GD_ID_DRIVE_NORMALIZED_WHEEL_SPEED_FR" 2528 "GD_ID_DRIVE_NORMALIZED_WHEEL_SPEED_RL" 2529 "GD_ID_DRIVE_NORMALIZED_WHEEL_SPEED_RR" 2530 "GD_ID_DRIVE_AIRBAG_DEFLATE_Status" 2530 "GD_ID_DRIVE_AIRBAG_DEFLATE" 2542 "GD_ID_DRIVE_ERRORMANAGEMENT_Status" 2542 "GD_ID_DRIVE_ERRORMANAGEMENT" 2559 "GD_ID_DRIVE_LIFEMESSAGE" 12288 "GD_ID_SCT_ENABLE" 12289 "GD_ID_SCT_MODUL_OUT_STATUS" 12290 "GD_ID_SCT_MODUL_IN_STATUS" 12298 "GD_ID_SCT_STATUSDISPLAY_TERMINAL" 12303 "GD_ID_SCT_TURNING_OFF_REASON" 12304 "GD_ID_SCT_STATE" 12305 "GD_ID_SCT_VOTED_ACTIVE_CLASS_1" 12306 "GD_ID_SCT_VOTED_ACTIVE_CLASS_2" 12312 "GD_ID_SCT_SETPOINT_Status" 12312 "GD_ID_SCT_SETPOINT" 12313 "GD_ID_SCT_SETPOINT_FEELER_GUIDANCE_Status" 12313 "GD_ID_SCT_SETPOINT_FEELER_GUIDANCE" 12314 "GD_ID_SCT_SETPOINT_CURVATURE_Status" 12314 "GD_ID_SCT_SETPOINT_CURVATURE" 12315 "GD_ID_SCT_SETPOINT_CURVATURE_TIM_Status" 12315 "GD_ID_SCT_SETPOINT_CURVATURE_TIM" 12316 "GD_ID_SCT_SETPOINT_CURVATURE_FEELER_GUIDANCE_Status" 12316 "GD_ID_SCT_SETPOINT_CURVATURE_FEELER_GUIDANCE" 12320 "GD_ID_SCT_WAS_RAW_VALUE" 12321 "GD_ID_SCT_WAS_SCALED_VALUE" 12322 "GD_ID_SCT_WAS_SENSOR_ANGLE" 12323 "GD_ID_SCT_WAS_MEDIAN_ANGLE" 12324 "GD_ID_SCT_WAS_MEDIAN_ANGLE_MAX" 12325 "GD_ID_SCT_WAS_VIRTUAL_ANGLE" 12328 "GD_ID_SCT_WAS_MEDIAN_CURVATURE" 12329 "GD_ID_SCT_WAS_MEDIAN_CURVATURE_MAX" 12334 "GD_ID_SCT_WAS_CALIB_COMMAND" 12335 "GD_ID_SCT_WAS_CALIB_STATUS" 12336 "GD_ID_SCT_SWS_RAW_VALUE_Status" 12336 "GD_ID_SCT_SWS_RAW_VALUE" 12338 "GD_ID_SCT_SWS_LIMITED_ANGLE_Status" 12338 "GD_ID_SCT_SWS_LIMITED_ANGLE" 12339 "GD_ID_SCT_SWS_CONTINUED_ANGLE_Status" 12339 "GD_ID_SCT_SWS_CONTINUED_ANGLE" 12340 "GD_ID_SCT_SWS_ROTATIONAL_SPEED" 12352 "GD_ID_SCT_VALVE_SETPOINT" 12353 "GD_ID_SCT_VALVE_POSITION" 12366 "GD_ID_SCT_VALVE_CALIB_COMMAND" 12367 "GD_ID_SCT_VALVE_CALIB_STATUS" 12368 "GD_ID_SCT_PILOTVALVE_STATUS_Status" 12368 "GD_ID_SCT_PILOTVALVE_STATUS" 12388 "GD_ID_SCT_OLAY_STEER_FACTOR" 12416 "GD_ID_SCT_HEADLAND_CMD_Status" 12416 "GD_ID_SCT_HEADLAND_CMD" 12417 "GD_ID_SCT_3RDPARTY_READY_STATUS_Status" 12417 "GD_ID_SCT_3RDPARTY_READY_STATUS" 12418 "GD_ID_SCT_3RDPARTY_POSITION_STATUS_Status" 12418 "GD_ID_SCT_3RDPARTY_POSITION_STATUS" 12419 "GD_ID_SCT_3RDPARTY_CANCEL_REQUEST_Status" 12419 "GD_ID_SCT_3RDPARTY_CANCEL_REQUEST" 12420 "GD_ID_SCT_3RDPARTY_COMMAND_GUIDANCE_Status" 12420 "GD_ID_SCT_3RDPARTY_COMMAND_GUIDANCE" 12544 "GD_ID_SCT_TSD_MIN_SPEED_FORWARD" 12545 "GD_ID_SCT_TSD_MAX_SPEED_FORWARD" 12546 "GD_ID_SCT_TSD_MIN_MACHINE_RADIUS" 12547 "GD_ID_SCT_TSD_MAX_ACQUISITION_ANGLE" 12560 "GD_ID_SCT_GUIDANCE_CONFIGURATION_DATA_Status" 12560 "GD_ID_SCT_GUIDANCE_CONFIGURATION_DATA" 12568 "GD_ID_SCT_STEERING_MODE_Status" 12568 "GD_ID_SCT_STEERING_MODE" 12569 "GD_ID_SCT_SECONDARY_WAS_RAW_VALUE_Status" 12569 "GD_ID_SCT_SECONDARY_WAS_RAW_VALUE" 12570 "GD_ID_SCT_SECONDARY_WAS_SENSOR_ANGLE_Status" 12570 "GD_ID_SCT_SECONDARY_WAS_SENSOR_ANGLE" 12571 "GD_ID_SCT_SECONDARY_WAS_MEDIAN_ANGLE_Status" 12571 "GD_ID_SCT_SECONDARY_WAS_MEDIAN_ANGLE" 12572 "GD_ID_SCT_SECONDARY_WAS_MEDIAN_ANGLE_MAX_Status" 12572 "GD_ID_SCT_SECONDARY_WAS_MEDIAN_ANGLE_MAX" 12573 "GD_ID_SCT_ALS_X_OFFSET_Status" 12573 "GD_ID_SCT_ALS_X_OFFSET" 12574 "GD_ID_SCT_ALS_Y_OFFSET_Status" 12574 "GD_ID_SCT_ALS_Y_OFFSET" 12575 "GD_ID_SCT_ADDITIONAL_WORKING_HEIGHT" 12576 "GD_ID_SCT_VEHICLE_CURRENT_PAYLOAD_Status" 12576 "GD_ID_SCT_VEHICLE_CURRENT_PAYLOAD" 12598 "GD_ID_SCT_ISO_STATE" 12599 "GD_ID_SCT_VEHICLE_SPEED_Status" 12599 "GD_ID_SCT_VEHICLE_SPEED" 12600 "GD_ID_SCT_VEHICLE_MOVEMENT_Status" 12600 "GD_ID_SCT_VEHICLE_MOVEMENT" 12601 "GD_ID_SCT_PARKING_BRAKE_Status" 12601 "GD_ID_SCT_PARKING_BRAKE" 12608 "GD_ID_SCT_CONTROL_MSG_TERMINAL" 12609 "GD_ID_SCT_CONTROL_MSG_GUIDEANCE" 12610 "GD_ID_SCT_MODIFIED_REFERENCE_POINT_HEIGHT" 12611 "GD_ID_SCT_MODIFIED_GNSS_ANTENNA_X_OFFSET" 12612 "GD_ID_SCT_MODIFIED_GNSS_ANTENNA_Y_OFFSET" 12613 "GD_ID_SCT_MODIFIED_GNSS_ANTENNA_Z_OFFSET" 12614 "GD_ID_SCT_MODIFIED_TRACK_WIDTH" 12615 "GD_ID_SCT_MODIFIED_MOUNTING_ERROR_Y_OFFSET" 12736 "GD_ID_SCT_TRACTOR_SN_TYPE" 12737 "GD_ID_SCT_TRACTOR_SN_GROUP" 12738 "GD_ID_SCT_TRACTOR_SN_NUMBER" 12782 "GD_ID_SCT_ERROR_ACKNOWLEDGE_Status" 12782 "GD_ID_SCT_ERROR_ACKNOWLEDGE" 12784 "GD_ID_SCT_ACTIVATE_DIAGNOSTICS" 12788 "GD_ID_SCT_SAFETY_VERSION_Status" 12788 "GD_ID_SCT_SAFETY_VERSION" 12789 "GD_ID_SCT_LIB_SAFETY_VERSION" 12792 "GD_ID_SCT_RECIPE_ACCESS_SETPOINT" 12793 "GD_ID_SCT_TI_ACCESS_SETPOINT" 12794 "GD_ID_SCT_TI_ACCESS_STATE" 12795 "GD_ID_SCT_TI_ACCESS_STATE_KL15" 12797 "GD_ID_SCT_TI_SUB_STATE" 12782 "GD_ID_SCT_ErrorManagement_Status" 12782 "GD_ID_SCT_ErrorManagement" 12799 "GD_ID_SCT_LifeMessage" 12800 "GD_ID_Engine_Rpm" 12801 "GD_ID_Engine_Load" 12802 "GD_ID_Engine_Coolant_Temp_Status" 12802 "GD_ID_Engine_Coolant_Temp" 12803 "GD_ID_Engine_Air_Intake_Temp" 12804 "GD_ID_Engine_Battery_Power_Status" 12804 "GD_ID_Engine_Battery_Power" 12805 "GD_ID_Engine_Air_Intake_Pressure" 12806 "GD_ID_Engine_Oil_Pressure" 12807 "GD_ID_Engine_Rpm_Setpoint_Status" 12807 "GD_ID_Engine_Rpm_Setpoint" 12808 "GD_ID_Engine_Standing_Still_Status" 12808 "GD_ID_Engine_Standing_Still" 12809 "GD_ID_Engine_Oil_Pressure_Low_Status" 12809 "GD_ID_Engine_Oil_Pressure_Low" 12810 "GD_ID_Engine_Oil_Service_Interval_Status" 12810 "GD_ID_Engine_Oil_Service_Interval" 12811 "GD_ID_Engine_Hours" 12812 "GD_ID_Engine_Amber_Warning_Lamp_Status" 12812 "GD_ID_Engine_Amber_Warning_Lamp" 12813 "GD_ID_Engine_Red_Stop_Lamp_Status" 12813 "GD_ID_Engine_Red_Stop_Lamp" 12814 "GD_ID_Alt_Low_Idle" 12815 "GD_ID_Engine_Audible_Warning_Status" 12815 "GD_ID_Engine_Audible_Warning" 12816 "GD_ID_Ambient_Temp" 12817 "GD_ID_Ecu_Temp" 12820 "GD_ID_Fuel_Rate" 12821 "GD_ID_Trip_Fuel" 12822 "GD_ID_Trip_DEF" 12823 "GD_ID_DEF_Level" 12824 "GD_ID_Water_In_Fuel_Status" 12824 "GD_ID_Water_In_Fuel" 12825 "GD_ID_Engine_Malfunction_Lamp_Status" 12825 "GD_ID_Engine_Malfunction_Lamp" 12826 "GD_ID_DEF_Level_Warning_Status" 12826 "GD_ID_DEF_Level_Warning" 12827 "GD_ID_Engine_WaitToStart_Status" 12827 "GD_ID_Engine_WaitToStart" 12828 "GD_ID_Engine_Operating_State" 12829 "GD_ID_Engine_Start_Enable_Status" 12829 "GD_ID_Engine_Start_Enable" 12830 "GD_ID_Implement_Transport_State_Status" 12830 "GD_ID_Implement_Transport_State" 12831 "GD_ID_Implement_Work_State_Status" 12831 "GD_ID_Implement_Work_State" 12832 "GD_ID_Implement_Actual_Working_Width" 12833 "GD_ID_Implement_Actual_Flow" 12834 "GD_ID_Implement_ReadyForFieldWork_Status" 12834 "GD_ID_Implement_ReadyForFieldWork" 12840 "GD_ID_WheelBasedDistance_km" 12841 "GD_ID_WheelBasedDistance_m" 12842 "GD_ID_GroundBasedDistance_km" 12843 "GD_ID_GroundBasedDistance_m" 12844 "GD_ID_SelectedSpeedDistance_km" 12845 "GD_ID_SelectedSpeedDistance_m" 12846 "GD_ID_MachineSelectedSpeed" 12847 "GD_ID_WBZ_MACHINE_SELECTED_SOURCE" 12848 "GD_ID_WBZ_MAX_ENG_RPM" 12850 "GD_ID_Working_Time_SecMin_VD" 12851 "GD_ID_Working_Time_Hours_VD" 12852 "GD_ID_Worked_Area_Ha_VD" 12853 "GD_ID_Worked_Area_0001Ha_VD" 12854 "GD_ID_Used_Fuel_VD" 12855 "GD_ID_Remaining_Time_SecMin_VD" 12856 "GD_ID_Remaining_Time_Hours_VD" 12857 "GD_ID_Remaining_Area_Ha_VD" 12858 "GD_ID_Remaining_Area_0001Ha_VD" 12859 "GD_ID_Required_Fuel_VD" 12860 "GD_ID_Field_Size_Ha_VD" 12861 "GD_ID_Field_Size_0001Ha_VD" 12862 "GD_ID_Reset_VD_Status" 12862 "GD_ID_Reset_VD" 12870 "GD_Iso_IsoState_state_RW" 12871 "GD_ID_WBZ_TERMINAL_PAGE_SIZE" 12878 "GD_ID_WBZ_ENG_DEF_LVL_LAMP_Status" 12878 "GD_ID_WBZ_ENG_DEF_LVL_LAMP" 12879 "GD_ID_WBZ_ENG_DEF_MIL_LAMP_Status" 12879 "GD_ID_WBZ_ENG_DEF_MIL_LAMP" 12880 "GD_ID_IgnitionState_Status" 12880 "GD_ID_IgnitionState" 12881 "GD_ID_WBZ_ENG_FAN_RPM" 12882 "GD_ID_WBZ_ENG_FUEL_TEMP" 12883 "GD_ID_WBZ_ENG_AUXIO1_01" 12884 "GD_ID_WBZ_ENG_FAN_DUTY_CYCLE" 12885 "GD_ID_WBZ_DEF_TEMP" 12886 "GD_ID_WBZ_EXHAUST_TEMP" 12887 "GD_ID_WBZ_FUEL_PRESSURE" 12888 "GD_ID_WBZ_CURVATURE_SETPOINT" 12889 "GD_ID_WBZ_CURVATURE_ENABLE_Status" 12889 "GD_ID_WBZ_CURVATURE_ENABLE" 12890 "GD_ID_WBZ_ENG_START_CMD_Status" 12890 "GD_ID_WBZ_ENG_START_CMD" 12891 "GD_ID_WBZ_THIRD_PARTY_MANUS_Status" 12891 "GD_ID_WBZ_THIRD_PARTY_MANUS" 12892 "GD_ID_WBZ_NEW_LEADER_ACL_Status" 12892 "GD_ID_WBZ_NEW_LEADER_ACL" 12901 "GD_ID_WBZ_AUXIO1_01_FI02" 12902 "GD_ID_WBZ_AUXIO1_02_FI02" 12903 "GD_ID_WBZ_AUXIO1_03_FI02" 12904 "GD_ID_WBZ_AUXIO1_04_FI02" 12905 "GD_ID_WBZ_AUXIO1_05_FI02" 12906 "GD_ID_WBZ_AUXIO1_06_FI02" 12907 "GD_ID_WBZ_AUXIO1_07_FI02" 12908 "GD_ID_WBZ_AUXIO1_08_FI02" 12909 "GD_ID_WBZ_AUXIO1_09_FI02" 12910 "GD_ID_WBZ_AUXIO1_10_FI02" 12911 "GD_ID_WBZ_AUXIO1_11_FI02" 12912 "GD_ID_WBZ_AUXIO1_12_FI02" 12917 "GD_ID_WBZ_AUXIO2_17_FI02" 12918 "GD_ID_WBZ_AUXIO2_18_FI02" 12919 "GD_ID_WBZ_AUXIO1_01_FI00" 12920 "GD_ID_WBZ_AUXIO1_02_FI00" 12921 "GD_ID_WBZ_AUXIO1_03_FI00" 12922 "GD_ID_WBZ_AUXIO1_04_FI00" 12923 "GD_ID_WBZ_AUXIO1_05_FI00" 12924 "GD_ID_WBZ_AUXIO1_06_FI00" 12925 "GD_ID_WBZ_AUXIO1_07_FI00" 12926 "GD_ID_WBZ_AUXIO1_08_FI00" 12927 "GD_ID_WBZ_AUXIO1_09_FI00" 12928 "GD_ID_WBZ_AUXIO1_10_FI00" 12929 "GD_ID_WBZ_AUXIO1_11_FI00" 12930 "GD_ID_WBZ_AUXIO1_12_FI00" 12931 "GD_ID_WBZ_AUXIO1_13_FI00" 12932 "GD_ID_WBZ_AUXIO1_14_FI00" 12933 "GD_ID_WBZ_AUXIO1_15_FI00" 12934 "GD_ID_WBZ_AUXIO1_16_FI00" 12935 "GD_ID_WBZ_AUXIO1_CH2" 12936 "GD_ID_WBZ_AUXIO2_17_FI00" 12937 "GD_ID_WBZ_AUXIO2_18_FI00" 12940 "GD_ID_WBZ_AUXIO2_21_FI00" 12941 "GD_ID_WBZ_AUXIO2_22_FI00" 12945 "GD_ID_WBZ_AUXIO2_26_FI00" 12946 "GD_ID_WBZ_AUXIO2_27_FI00" 12947 "GD_ID_WBZ_AUXIO2_28_FI00" 12948 "GD_ID_WBZ_AUXIO2_29_FI00" 12949 "GD_ID_WBZ_AUXIO2_30_FI00" 12950 "GD_ID_WBZ_AUXIO2_31_FI00" 12951 "GD_ID_WBZ_AUXIO2_32_FI00" 12952 "GD_ID_WBZ_AUXIO1_01_FI01" 12953 "GD_ID_WBZ_AUXIO1_02_FI01" 12954 "GD_ID_WBZ_AUXIO1_03_FI01" 12955 "GD_ID_WBZ_AUXIO1_04_FI01" 12956 "GD_ID_WBZ_AUXIO1_05_FI01" 12957 "GD_ID_WBZ_AUXIO1_06_FI01" 12958 "GD_ID_WBZ_AUXIO1_07_FI01" 12959 "GD_ID_WBZ_AUXIO1_08_FI01" 12960 "GD_ID_WBZ_AUXIO1_09_FI01" 12961 "GD_ID_WBZ_AUXIO1_10_FI01" 12962 "GD_ID_WBZ_AUXIO1_11_FI01" 12963 "GD_ID_WBZ_AUXIO1_12_FI01" 12964 "GD_ID_WBZ_AUXIO1_13_FI01" 12965 "GD_ID_WBZ_AUXIO1_14_FI01" 12966 "GD_ID_WBZ_AUXIO1_15_FI01" 12967 "GD_ID_WBZ_AUXIO1_16_FI01" 12969 "GD_ID_WBZ_AUXIO2_17_FI01" 12970 "GD_ID_WBZ_AUXIO2_18_FI01" 12973 "GD_ID_WBZ_AUXIO2_21_FI01" 12974 "GD_ID_WBZ_AUXIO2_22_FI01" 12978 "GD_ID_WBZ_AUXIO2_26_FI01" 12979 "GD_ID_WBZ_AUXIO2_27_FI01" 12980 "GD_ID_WBZ_AUXIO2_28_FI01" 12981 "GD_ID_WBZ_AUXIO2_29_FI01" 12982 "GD_ID_WBZ_AUXIO2_30_FI01" 12983 "GD_ID_WBZ_AUXIO2_31_FI01" 12984 "GD_ID_WBZ_AUXIO2_32_FI01" 12985 "GD_ID_WBZ_AUXIO2_21_FI02" 12986 "GD_ID_WBZ_AUXIO2_22_FI02" 13000 "GD_ID_WBZ_TI_ACCESS" 13052 "GD_ID_Unknown_Engine_Error_Part1" 13053 "GD_ID_Unknown_Engine_Error_Part2" 13120 "GD_ID_WBZ_DPF_WARNING_LAMP_Status" 13120 "GD_ID_WBZ_DPF_WARNING_LAMP" 13121 "GD_ID_WBZ_DPF_HEST_LAMP_Status" 13121 "GD_ID_WBZ_DPF_HEST_LAMP" 13123 "GD_ID_WBZ_DPF_SOOT_ASH" 13124 "GD_ID_WBZ_DPF_HOURS_SINCE_REGEN" 13125 "GD_ID_WBZ_DPF_MINUTES_SINCE_REGEN" 13126 "GD_ID_WBZ_DPF_STATI" 13128 "GD_ID_WBZ_DPF_INHIBITED_STATI" 13129 "GD_ID_WBZ_DPF_CONTROL_REGEN" 13130 "GD_ID_WBZ_DPF_ENABLE_REGEN_Status" 13130 "GD_ID_WBZ_DPF_ENABLE_REGEN" 13294 "GD_ID_WBZ_ErrorManagement_Status" 13294 "GD_ID_WBZ_ErrorManagement" 13311 "GD_ID_WBZ_LifeMessage" 13824 "GD_ID_Current_Track_Width" 13825 "GD_ID_TA_Min_Track_Width" 13826 "GD_ID_Max_Track_Width" 13827 "GD_ID_Calib_State_Track_Width_Status" 13827 "GD_ID_Calib_State_Track_Width" 13828 "GD_ID_TA_Front_Axle_Width" 13829 "GD_ID_TA_Front_Track_Width" 13830 "GD_ID_TA_Rear_Axle_Width" 13831 "GD_ID_TA_Rear_Track_Width" 13832 "GD_ID_Track_Adjust_Errors_Status" 13832 "GD_ID_Track_Adjust_Errors" 13833 "GD_ID_TA_Calibration_Command" 13834 "GD_ID_TA_Calibration_State" 13835 "GD_ID_TA_MANUAL_IN_Status" 13835 "GD_ID_TA_MANUAL_IN" 13836 "GD_ID_TA_MANUAL_OUT_Status" 13836 "GD_ID_TA_MANUAL_OUT" 13839 "GD_ID_TA_Actual_Front_In_R_Status" 13839 "GD_ID_TA_Actual_Front_In_R" 13840 "GD_ID_TA_Actual_Front_Out_R_Status" 13840 "GD_ID_TA_Actual_Front_Out_R" 13841 "GD_ID_TA_Actual_Rear_In_R_Status" 13841 "GD_ID_TA_Actual_Rear_In_R" 13842 "GD_ID_TA_Actual_Rear_Out_R_Status" 13842 "GD_ID_TA_Actual_Rear_Out_R" 13843 "GD_ID_TA_Actual_Front_In_Status" 13843 "GD_ID_TA_Actual_Front_In" 13844 "GD_ID_TA_Actual_Front_Out_Status" 13844 "GD_ID_TA_Actual_Front_Out" 13845 "GD_ID_TA_Actual_Rear_In_Status" 13845 "GD_ID_TA_Actual_Rear_In" 13846 "GD_ID_TA_Actual_Rear_Out_Status" 13846 "GD_ID_TA_Actual_Rear_Out" 13847 "GD_ID_Track_Adjust_Equipped_Status" 13847 "GD_ID_Track_Adjust_Equipped" 13848 "GD_ID_TA_Min_Tire_Track_Width" 13849 "GD_ID_Current_Axle_Width" 13850 "GD_ID_TA_Operation_State_Status" 13850 "GD_ID_TA_Operation_State" 13851 "GD_ID_TA_In_Tolerance_Status" 13851 "GD_ID_TA_In_Tolerance" 13852 "GD_ID_TA_Auto_Enable_A_Status" 13852 "GD_ID_TA_Auto_Enable_A" 13853 "GD_ID_TA_Auto_Enable_B_Status" 13853 "GD_ID_TA_Auto_Enable_B" 13854 "GD_ID_TA_Auto_Enable_Dual_Status" 13854 "GD_ID_TA_Auto_Enable_Dual" 13855 "GD_ID_TA_Setpoint_A" 13856 "GD_ID_TA_Setpoint_B" 13857 "GD_ID_TA_Setpoint_Dual_Front" 13858 "GD_ID_TA_Setpoint_Dual_Rear" 13864 "GD_ID_TA_Equipped_Status" 13864 "GD_ID_TA_Equipped" 13874 "GD_ID_TA_FL_POSITION" 13875 "GD_ID_TA_FR_POSITION" 13876 "GD_ID_TA_RL_POSITION" 13877 "GD_ID_TA_RR_POSITION" 13878 "GD_ID_TA_Setpoint_A_Rear_Status" 13878 "GD_ID_TA_Setpoint_A_Rear" 13879 "GD_ID_TA_Setpoint_B_Rear_Status" 13879 "GD_ID_TA_Setpoint_B_Rear" 13880 "GD_ID_TA_TARGET_TRACKWIDTH_FL" 13881 "GD_ID_TA_TARGET_TRACKWIDTH_FR" 13882 "GD_ID_TA_TARGET_TRACKWIDTH_RL" 13883 "GD_ID_TA_TARGET_TRACKWIDTH_RR" 13884 "GD_ID_TA_ADDITIONAL_WIDTH_FL" 13885 "GD_ID_TA_ADDITIONAL_WIDTH_FR" 13886 "GD_ID_TA_ADDITIONAL_WIDTH_RL" 13887 "GD_ID_TA_ADDITIONAL_WIDTH_RR" 14318 "GD_ID_TA_ErrorManagement_Status" 14318 "GD_ID_TA_ErrorManagement" 14335 "GD_ID_TA_LifeMessage" 15872 "GD_ID_EMM_SIGNAL_LN00_ERROR_W_Status" 15872 "GD_ID_EMM_SIGNAL_LN00_ERROR_W" 15873 "GD_ID_EMM_SIGNAL_LN01_ERROR_W_Status" 15873 "GD_ID_EMM_SIGNAL_LN01_ERROR_W" 15874 "GD_ID_EMM_SIGNAL_LN02_ERROR_W_Status" 15874 "GD_ID_EMM_SIGNAL_LN02_ERROR_W" 15875 "GD_ID_EMM_SIGNAL_LN03_ERROR_W_Status" 15875 "GD_ID_EMM_SIGNAL_LN03_ERROR_W" 15876 "GD_ID_EMM_SIGNAL_LN04_ERROR_W_Status" 15876 "GD_ID_EMM_SIGNAL_LN04_ERROR_W" 15877 "GD_ID_EMM_SIGNAL_LN05_ERROR_W_Status" 15877 "GD_ID_EMM_SIGNAL_LN05_ERROR_W" 15878 "GD_ID_EMM_SIGNAL_LN06_ERROR_W_Status" 15878 "GD_ID_EMM_SIGNAL_LN06_ERROR_W" 15879 "GD_ID_EMM_SIGNAL_LN07_ERROR_W_Status" 15879 "GD_ID_EMM_SIGNAL_LN07_ERROR_W" 15880 "GD_ID_EMM_SIGNAL_LN08_ERROR_W_Status" 15880 "GD_ID_EMM_SIGNAL_LN08_ERROR_W" 15881 "GD_ID_EMM_SIGNAL_LN09_ERROR_W_Status" 15881 "GD_ID_EMM_SIGNAL_LN09_ERROR_W" 15882 "GD_ID_EMM_SIGNAL_LN10_ERROR_W_Status" 15882 "GD_ID_EMM_SIGNAL_LN10_ERROR_W" 15883 "GD_ID_EMM_SIGNAL_LN11_ERROR_W_Status" 15883 "GD_ID_EMM_SIGNAL_LN11_ERROR_W" 15884 "GD_ID_EMM_SIGNAL_LN12_ERROR_W_Status" 15884 "GD_ID_EMM_SIGNAL_LN12_ERROR_W" 15885 "GD_ID_EMM_SIGNAL_LN13_ERROR_W_Status" 15885 "GD_ID_EMM_SIGNAL_LN13_ERROR_W" 15886 "GD_ID_EMM_SIGNAL_LN14_ERROR_W_Status" 15886 "GD_ID_EMM_SIGNAL_LN14_ERROR_W" 15887 "GD_ID_EMM_SIGNAL_LN15_ERROR_W_Status" 15887 "GD_ID_EMM_SIGNAL_LN15_ERROR_W" 15888 "GD_ID_EMM_SIGNAL_LN16_ERROR_W_Status" 15888 "GD_ID_EMM_SIGNAL_LN16_ERROR_W" 15889 "GD_ID_EMM_SIGNAL_LN17_ERROR_W_Status" 15889 "GD_ID_EMM_SIGNAL_LN17_ERROR_W" 15890 "GD_ID_EMM_SIGNAL_LN18_ERROR_W_Status" 15890 "GD_ID_EMM_SIGNAL_LN18_ERROR_W" 15891 "GD_ID_EMM_SIGNAL_LN19_ERROR_W_Status" 15891 "GD_ID_EMM_SIGNAL_LN19_ERROR_W" 15892 "GD_ID_EMM_SIGNAL_LN20_ERROR_W_Status" 15892 "GD_ID_EMM_SIGNAL_LN20_ERROR_W" 15893 "GD_ID_EMM_SIGNAL_LN21_ERROR_W_Status" 15893 "GD_ID_EMM_SIGNAL_LN21_ERROR_W" 15894 "GD_ID_EMM_SIGNAL_LN22_ERROR_W_Status" 15894 "GD_ID_EMM_SIGNAL_LN22_ERROR_W" 15895 "GD_ID_EMM_SIGNAL_LN23_ERROR_W_Status" 15895 "GD_ID_EMM_SIGNAL_LN23_ERROR_W" 15896 "GD_ID_EMM_SIGNAL_LN24_ERROR_W_Status" 15896 "GD_ID_EMM_SIGNAL_LN24_ERROR_W" 15897 "GD_ID_EMM_SIGNAL_LN25_ERROR_W_Status" 15897 "GD_ID_EMM_SIGNAL_LN25_ERROR_W" 15898 "GD_ID_EMM_SIGNAL_LN26_ERROR_W_Status" 15898 "GD_ID_EMM_SIGNAL_LN26_ERROR_W" 15899 "GD_ID_EMM_SIGNAL_LN27_ERROR_W_Status" 15899 "GD_ID_EMM_SIGNAL_LN27_ERROR_W" 15900 "GD_ID_EMM_SIGNAL_LN28_ERROR_W_Status" 15900 "GD_ID_EMM_SIGNAL_LN28_ERROR_W" 15901 "GD_ID_EMM_SIGNAL_LN29_ERROR_W_Status" 15901 "GD_ID_EMM_SIGNAL_LN29_ERROR_W" 15902 "GD_ID_EMM_SIGNAL_LN30_ERROR_W_Status" 15902 "GD_ID_EMM_SIGNAL_LN30_ERROR_W" 15903 "GD_ID_EMM_SIGNAL_LN31_ERROR_W_Status" 15903 "GD_ID_EMM_SIGNAL_LN31_ERROR_W" 15904 "GD_ID_EMM_SIGNAL_LN32_ERROR_W_Status" 15904 "GD_ID_EMM_SIGNAL_LN32_ERROR_W" 15905 "GD_ID_EMM_SIGNAL_LN33_ERROR_W_Status" 15905 "GD_ID_EMM_SIGNAL_LN33_ERROR_W" 15906 "GD_ID_EMM_SIGNAL_LN34_ERROR_W_Status" 15906 "GD_ID_EMM_SIGNAL_LN34_ERROR_W" 15907 "GD_ID_EMM_SIGNAL_LN35_ERROR_W_Status" 15907 "GD_ID_EMM_SIGNAL_LN35_ERROR_W" 15908 "GD_ID_EMM_SIGNAL_LN36_ERROR_W_Status" 15908 "GD_ID_EMM_SIGNAL_LN36_ERROR_W" 15909 "GD_ID_EMM_SIGNAL_LN37_ERROR_W_Status" 15909 "GD_ID_EMM_SIGNAL_LN37_ERROR_W" 15910 "GD_ID_EMM_SIGNAL_LN38_ERROR_W_Status" 15910 "GD_ID_EMM_SIGNAL_LN38_ERROR_W" 15911 "GD_ID_EMM_SIGNAL_LN39_ERROR_W_Status" 15911 "GD_ID_EMM_SIGNAL_LN39_ERROR_W" 15912 "GD_ID_EMM_SIGNAL_LN40_ERROR_W_Status" 15912 "GD_ID_EMM_SIGNAL_LN40_ERROR_W" 15913 "GD_ID_EMM_SIGNAL_LN41_ERROR_W_Status" 15913 "GD_ID_EMM_SIGNAL_LN41_ERROR_W" 15914 "GD_ID_EMM_SIGNAL_LN42_ERROR_W_Status" 15914 "GD_ID_EMM_SIGNAL_LN42_ERROR_W" 15915 "GD_ID_EMM_SIGNAL_LN43_ERROR_W_Status" 15915 "GD_ID_EMM_SIGNAL_LN43_ERROR_W" 15916 "GD_ID_EMM_SIGNAL_LN44_ERROR_W_Status" 15916 "GD_ID_EMM_SIGNAL_LN44_ERROR_W" 15917 "GD_ID_EMM_SIGNAL_LN45_ERROR_W_Status" 15917 "GD_ID_EMM_SIGNAL_LN45_ERROR_W" 15918 "GD_ID_EMM_SIGNAL_LN46_ERROR_W_Status" 15918 "GD_ID_EMM_SIGNAL_LN46_ERROR_W" 15919 "GD_ID_EMM_SIGNAL_LN47_ERROR_W_Status" 15919 "GD_ID_EMM_SIGNAL_LN47_ERROR_W" 15920 "GD_ID_EMM_SIGNAL_LN48_ERROR_W_Status" 15920 "GD_ID_EMM_SIGNAL_LN48_ERROR_W" 15921 "GD_ID_EMM_SIGNAL_LN49_ERROR_W_Status" 15921 "GD_ID_EMM_SIGNAL_LN49_ERROR_W" 15922 "GD_ID_EMM_SIGNAL_LN50_ERROR_W_Status" 15922 "GD_ID_EMM_SIGNAL_LN50_ERROR_W" 15923 "GD_ID_EMM_SIGNAL_LN51_ERROR_W_Status" 15923 "GD_ID_EMM_SIGNAL_LN51_ERROR_W" 15924 "GD_ID_EMM_SIGNAL_LN52_ERROR_W_Status" 15924 "GD_ID_EMM_SIGNAL_LN52_ERROR_W" 15925 "GD_ID_EMM_SIGNAL_LN53_ERROR_W_Status" 15925 "GD_ID_EMM_SIGNAL_LN53_ERROR_W" 15926 "GD_ID_EMM_SIGNAL_LN54_ERROR_W_Status" 15926 "GD_ID_EMM_SIGNAL_LN54_ERROR_W" 15927 "GD_ID_EMM_SIGNAL_LN55_ERROR_W_Status" 15927 "GD_ID_EMM_SIGNAL_LN55_ERROR_W" 15928 "GD_ID_EMM_SIGNAL_LN56_ERROR_W_Status" 15928 "GD_ID_EMM_SIGNAL_LN56_ERROR_W" 15929 "GD_ID_EMM_SIGNAL_LN57_ERROR_W_Status" 15929 "GD_ID_EMM_SIGNAL_LN57_ERROR_W" 15930 "GD_ID_EMM_SIGNAL_LN58_ERROR_W_Status" 15930 "GD_ID_EMM_SIGNAL_LN58_ERROR_W" 15931 "GD_ID_EMM_SIGNAL_LN59_ERROR_W_Status" 15931 "GD_ID_EMM_SIGNAL_LN59_ERROR_W" 15932 "GD_ID_EMM_SIGNAL_LN60_ERROR_W_Status" 15932 "GD_ID_EMM_SIGNAL_LN60_ERROR_W" 15933 "GD_ID_EMM_SIGNAL_LN61_ERROR_W_Status" 15933 "GD_ID_EMM_SIGNAL_LN61_ERROR_W" 15934 "GD_ID_EMM_SIGNAL_LN62_ERROR_W_Status" 15934 "GD_ID_EMM_SIGNAL_LN62_ERROR_W" 15935 "GD_ID_EMM_SIGNAL_LN63_ERROR_W_Status" 15935 "GD_ID_EMM_SIGNAL_LN63_ERROR_W" 15938 "GD_ID_EMM_TERMINAL_TRANSFER_R_Status" 15938 "GD_ID_EMM_TERMINAL_TRANSFER_R" 15939 "GD_ID_EMM_ACM_TRANSFER_R_Status" 15939 "GD_ID_EMM_ACM_TRANSFER_R" 15970 "GD_ID_EMM_TERMINAL_ACKNOWLEDGE_W_Status" 15970 "GD_ID_EMM_TERMINAL_ACKNOWLEDGE_W" 16000 "GD_ID_EMM_REQUEST_ENVVAR_W" 16001 "GD_ID_EMM_ENV_VAR_VALUE1" 16002 "GD_ID_EMM_ENV_VAR_VALUE2" 16003 "GD_ID_EMM_ENV_VAR_VALUE3" 16004 "GD_ID_EMM_ENV_VAR_VALUE4" 16005 "GD_ID_EMM_ENV_VAR_VALUE5" 16006 "GD_ID_EMM_ENV_VAR_OPERATING_HOUR" 16007 "GD_ID_EMM_ENV_VAR_ERROR_COUNTER" 16008 "GD_ID_EMM_ENV_VAR_DATE1" 16009 "GD_ID_EMM_ENV_VAR_DATE2" 16010 "GD_ID_EMM_ENV_VAR_TIME1" 16011 "GD_ID_EMM_ENV_VAR_TIME2" 16012 "GD_ID_EMM_ENV_VAR_STATUS" 16127 "GD_ID_EMM_DEBUG_SET_RESET_ERROR" 16128 "GD_ID_EMM_STATUS_R" 16172 "GD_ID_EMM_ERR_LOG_DELETED_Status" 16172 "GD_ID_EMM_ERR_LOG_DELETED" 16222 "GD_ID_EMM_ERR_ACTIVE_Status" 16222 "GD_ID_EMM_ERR_ACTIVE" 16366 "GD_ID_EMM_ErrorManagement_Status" 16366 "GD_ID_EMM_ErrorManagement" 16383 "GD_ID_EMM_LifeMessage" 28161 "GD_ID_4WS_REQUESTED_MODE" 28162 "GD_ID_4WS_CURRENT_MODE" 28166 "GD_ID_4WS_JOG_LEFT_Status" 28166 "GD_ID_4WS_JOG_LEFT" 28167 "GD_ID_4WS_JOG_RIGHT_Status" 28167 "GD_ID_4WS_JOG_RIGHT" 28168 "GD_ID_4WS_JOG_CLEAR_Status" 28168 "GD_ID_4WS_JOG_CLEAR" 28169 "GD_ID_4WS_JOG_ANGLE_Status" 28169 "GD_ID_4WS_JOG_ANGLE" 28175 "GD_ID_4WS_UI_FRONT_ANGLE_Status" 28175 "GD_ID_4WS_UI_FRONT_ANGLE" 28176 "GD_ID_4WS_UI_REAR_ANGLE_Status" 28176 "GD_ID_4WS_UI_REAR_ANGLE" 28178 "GD_ID_4WS_MACHINE_REAR_ANGLE" 28179 "GD_ID_4WS_REAR_ANGLE_SETPOINT" 28180 "GD_ID_4WS_REAR_ANGLE_SENSOR_VALUE" 28183 "GD_ID_4WS_CURRENT_CONTROL_KP_Status" 28183 "GD_ID_4WS_CURRENT_CONTROL_KP" 28184 "GD_ID_4WS_CURRENT_CONTROL_KI_Status" 28184 "GD_ID_4WS_CURRENT_CONTROL_KI" 28185 "GD_ID_4WS_REAR_ANGLE_TARGET_Status" 28185 "GD_ID_4WS_REAR_ANGLE_TARGET" 28186 "GD_ID_4WS_LEFT_PWM_Status" 28186 "GD_ID_4WS_LEFT_PWM" 28187 "GD_ID_4WS_RIGHT_PWM_Status" 28187 "GD_ID_4WS_RIGHT_PWM" 28191 "GD_ID_4WS_RIGHT_VALVE_COIL_CURRENT" 28192 "GD_ID_4WS_LEFT_VALVE_COIL_CURRENT" 28193 "GD_ID_4WS_ANGLE_CONTROL_KP_Status" 28193 "GD_ID_4WS_ANGLE_CONTROL_KP" 28194 "GD_ID_4WS_ANGLE_CONTROL_KI_Status" 28194 "GD_ID_4WS_ANGLE_CONTROL_KI" 28195 "GD_ID_4WS_TARGET_CURRENT_Status" 28195 "GD_ID_4WS_TARGET_CURRENT" 28196 "GD_ID_4WS_CURRENT_CONTROL_KC_Status" 28196 "GD_ID_4WS_CURRENT_CONTROL_KC" 28201 "GD_ID_4WS_COMMAND_CURRENT_Status" 28201 "GD_ID_4WS_COMMAND_CURRENT" 28202 "GD_ID_4WS_ACTIVE_CURRENT_LOOP" 28203 "GD_ID_4WS_UNFILTERED_REAR_ANGLE_Status" 28203 "GD_ID_4WS_UNFILTERED_REAR_ANGLE" 28210 "GD_ID_4WS_START_CURRENT_CALIB_COMMAND" 28211 "GD_ID_4WS_START_CURRENT_CALIB_STATUS" 28260 "GD_ID_4WS_REAR_ANGLE_CALIB_COMMAND" 28261 "GD_ID_4WS_REAR_ANGLE_CALIB_STATUS" 28654 "GD_ID_4WS_ErrorManagement_Status" 28654 "GD_ID_4WS_ErrorManagement" 28671 "GD_ID_4WS_LifeMessage" 6638 "GD_ID_DIAGNOSE_ErrorManagement_Status" 6638 "GD_ID_DIAGNOSE_ErrorManagement" 6655 "GD_ID_DIAGNOSE_LifeMessage" 16384 "GD_ID_CEAG_FIELD_HEADLAND_WIDTH_RW" 16385 "GD_ID_CEAG_FIELD_HEADLAND_DISTANCE_RW" 16400 "GD_ID_CEAG_IMPLEMENT_PATHTOPATHDISTANCE_RW" 16402 "GD_ID_CEAG_IMPLEMENT_LINKAGETYPE_RW" 16403 "GD_ID_CEAG_IMPLEMENT_LINKAGEFRONT_RW" 16404 "GD_ID_CEAG_IMPLEMENT_LINKAGEREAR_RW" 16405 "GD_ID_CEAG_IMPLEMENT_MINIMUMRADIUS_RW" 16406 "GD_ID_CEAG_IMPLEMENT_OFFSET_SETOFFSET_RW" 16407 "GD_ID_CEAG_IMPLEMENT_OFFSET_SETWORKINGWIDTH_RW" 16408 "GD_ID_CEAG_IMPLEMENT_OFFSET_STATUS_RW" 16416 "GD_ID_CEAG_COMMUNICATION_COMMAND_W" 16417 "GD_ID_CEAG_COMMUNICATION_COMMAND_STATUS_R" 16432 "GD_ID_CEAG_PATH_DATA_BLKRW" 16435 "GD_ID_CEAG_PATH_AB_ANGLE_RW" 16436 "GD_ID_CEAG_PATH_AB_DISTANCE_R" 16439 "GD_ID_CEAG_PATH_PIVOT_CENTERPOINT_ACCURACY_R" 16441 "GD_ID_CEAG_PATH_SEGMENT_ACTUAL_R" 16442 "GD_ID_CEAG_PATH_NUMBER_ACTUAL_R" 16443 "GD_ID_CEAG_PATH_LP_SLOPE_RW_Status" 16443 "GD_ID_CEAG_PATH_LP_SLOPE_RW" 16444 "GD_ID_CEAG_PATH_DATA_ACKNOWLEDGE_R_Status" 16444 "GD_ID_CEAG_PATH_DATA_ACKNOWLEDGE_R" 16448 "GD_ID_CEAG_NUDGEOFFSET_MANUAL_RW" 16449 "GD_ID_CEAG_NUDGEOFFSET_TOTAL_R_Status" 16449 "GD_ID_CEAG_NUDGEOFFSET_TOTAL_R" 16450 "GD_ID_CEAG_OFFSET_NORTH" 16451 "GD_ID_CEAG_OFFSET_EAST" 16464 "GD_ID_CEAG_AUTOTURN_SETTINGS_RW" 16465 "GD_ID_CEAG_AUTOTURN_DIMENSIONS_R" 16466 "GD_ID_CEAG_AUTOTURN_STATUS_R" 16471 "GD_ID_CEAG_STATUSPAGE_POSITION_GNSS_R_Status" 16471 "GD_ID_CEAG_STATUSPAGE_POSITION_GNSS_R" 16472 "GD_ID_CEAG_STATUSPAGE_CORRECTION_R_Status" 16472 "GD_ID_CEAG_STATUSPAGE_CORRECTION_R" 16473 "GD_ID_CEAG_STATUSPAGE_INERTIAL_R_Status" 16473 "GD_ID_CEAG_STATUSPAGE_INERTIAL_R" 16474 "GD_ID_CEAG_STATUSPAGE_STEERING_SUBSYSTEM_R_Status" 16474 "GD_ID_CEAG_STATUSPAGE_STEERING_SUBSYSTEM_R" 16475 "GD_ID_CEAG_STATUSPAGE_XTRK_R_Status" 16475 "GD_ID_CEAG_STATUSPAGE_XTRK_R" 16476 "GD_ID_CEAG_STATUSPAGE_HEADINGTOWAYLINE_R_Status" 16476 "GD_ID_CEAG_STATUSPAGE_HEADINGTOWAYLINE_R" 16477 "GD_ID_CEAG_STATUSPAGE_VELOCITY_R_Status" 16477 "GD_ID_CEAG_STATUSPAGE_VELOCITY_R" 16478 "GD_ID_CEAG_STATUSPAGE_CALIBRATION_R_Status" 16478 "GD_ID_CEAG_STATUSPAGE_CALIBRATION_R" 16479 "GD_ID_CEAG_STATUSPAGE_SYSTEM_R_Status" 16479 "GD_ID_CEAG_STATUSPAGE_SYSTEM_R" 16480 "GD_ID_CEAG_STATUS_XTRK_R_Status" 16480 "GD_ID_CEAG_STATUS_XTRK_R" 16481 "GD_ID_CEAG_STATUS_HEADING_R" 16482 "GD_ID_CEAG_STATUS_STEERING_R" 16483 "GD_ID_CEAG_STEERING_SENSITIVITY_LINEACQUISITION_RW" 16484 "GD_ID_CEAG_STEERING_SENSITIVITY_ONLINE_RW" 16485 "GD_ID_CEAG_SYSTEM_STANDBYTIME_RW" 16486 "GD_ID_CEAG_SYSTEM_POWERSUPPLY_INPUT_R" 16487 "GD_ID_CEAG_SYSTEM_POWERSUPPLY_OUTPUT_R" 16488 "GD_ID_CEAG_SYSTEM_ALTITUDE_GEOIDAL_SEPARATION_R" 16489 "GD_ID_CEAG_STEERING_DISENGAGE_REASON_R" 16496 "GD_ID_CEAG_GNSS_GPS_SATVISIBLE_R" 16497 "GD_ID_CEAG_GNSS_GPS_SATUSED_R" 16498 "GD_ID_CEAG_GNSS_GLONASS_SATVISIBLE_R" 16499 "GD_ID_CEAG_GNSS_GLONASS_SATUSED_R" 16500 "GD_ID_CEAG_GNSS_GALILEO_SATVISIBLE_R" 16501 "GD_ID_CEAG_GNSS_GALILEO_SATUSED_R" 16503 "GD_ID_CEAG_GNSS_VALIDPOSITION_R_Status" 16503 "GD_ID_CEAG_GNSS_VALIDPOSITION_R" 16504 "GD_ID_CEAG_GNSS_POSITION_ACTUAL_BLKR" 16505 "GD_ID_CEAG_GNSS_DOP_R" 16506 "GD_ID_CEAG_GNSS_TIME_HOURMINUTE_R" 16507 "GD_ID_CEAG_GNSS_TIME_SECOND_R" 16508 "GD_ID_CEAG_GNSS_ANTENNA_INSTALLATION_RW_Status" 16508 "GD_ID_CEAG_GNSS_ANTENNA_INSTALLATION_RW" 16509 "GD_ID_CEAG_GNSS_VELOCITY_R" 16510 "GD_ID_CEAG_GNSS_DISTANCE_R" 16519 "GD_ID_CEAG_CORRECTIONSIGNAL_RTKNETWORK_ROAMING_RW_Status" 16519 "GD_ID_CEAG_CORRECTIONSIGNAL_RTKNETWORK_ROAMING_RW" 16520 "GD_ID_CEAG_CORRECTIONSIGNAL_RTK_DUHF2_CHANNELSPACING_RW" 16521 "GD_ID_CEAG_CORRECTIONSIGNAL_RTK_DUHF2_PROTOCOL_RW" 16522 "GD_ID_CEAG_CORRECTIONSIGNAL_RTK_DUHF2_ERRORCORRECTION_RW" 16523 "GD_ID_CEAG_CORRECTIONSIGNAL_RTK_FH915_CHANNEL_RW" 16524 "GD_ID_CEAG_CORRECTIONSIGNAL_RTK_FH915_LOCATION_RW" 16525 "GD_ID_CEAG_CORRECTIONSIGNAL_RTK_FH915_NETWORKID_RW" 16526 "GD_ID_CEAG_CORRECTIONSIGNAL_OMNISTAR_FREQUENCY_HIGH_RW" 16527 "GD_ID_CEAG_CORRECTIONSIGNAL_OMNISTAR_FREQUENCY_LOW_RW" 16528 "GD_ID_CEAG_CORRECTIONSIGNAL_TYPE_SELECTED_RW" 16529 "GD_ID_CEAG_CORRECTIONSIGNAL_OMNISTAR_BAUDRATE_RW" 16530 "GD_ID_CEAG_CORRECTIONSIGNAL_VBS_EXPIRYDATE_DAYMONTH_R" 16531 "GD_ID_CEAG_CORRECTIONSIGNAL_BARGRAPH_R" 16532 "GD_ID_CEAG_CORRECTIONSIGNAL_VBS_EXPIRYDATE_YEAR_R" 16533 "GD_ID_CEAG_CORRECTIONSIGNAL_HP_XP_EXPIRYDATE_DAYMONTH_R" 16535 "GD_ID_CEAG_CORRECTIONSIGNAL_HP_XP_EXPIRYDATE_YEAR_R" 16536 "GD_ID_CEAG_CORRECTIONSIGNAL_STATUS_R_Status" 16536 "GD_ID_CEAG_CORRECTIONSIGNAL_STATUS_R" 16537 "GD_ID_CEAG_CORRECTIONSIGNAL_OMNISTAR_SERIALNUMBER_HIGH_R" 16538 "GD_ID_CEAG_CORRECTIONSIGNAL_OMNISTAR_SERIALNUMBER_LOW_R" 16539 "GD_ID_CEAG_CORRECTIONSIGNAL_RTK_AGCO_CHANNEL_RW" 16540 "GD_ID_CEAG_CORRECTIONSIGNAL_RTK_AGCO_FREQUENCY_HIGH_R" 16541 "GD_ID_CEAG_CORRECTIONSIGNAL_RTK_AGCO_FREQUENCY_LOW_R" 16542 "GD_ID_CEAG_CORRECTIONSIGNAL_RTK_AGCO_RADIOTYPE_R" 16543 "GD_ID_CEAG_CORRECTIONSIGNAL_RTK_EXTERNAL_SERIALINTERFACE_RW" 16544 "GD_ID_CEAG_CORRECTIONSIGNAL_RTK_RADIOINSTALLATION_RW_Status" 16544 "GD_ID_CEAG_CORRECTIONSIGNAL_RTK_RADIOINSTALLATION_RW" 16545 "GD_ID_CEAG_CORRECTIONSIGNAL_RTK_AGCO_CORRECTIONFORMAT_RW" 16546 "GD_ID_CEAG_CORRECTIONSIGNAL_RTK_EXTERNAL_CORRECTIONFORMAT_RW" 16547 "GD_ID_CEAG_CORRECTIONSIGNAL_RTK_GPS_SATVISIBLE_R" 16548 "GD_ID_CEAG_CORRECTIONSIGNAL_RTK_GPS_SATUSED_R" 16549 "GD_ID_CEAG_CORRECTIONSIGNAL_RTK_GLONASS_SATVISIBLE_R" 16550 "GD_ID_CEAG_CORRECTIONSIGNAL_RTK_GLONASS_SATUSED_R" 16551 "GD_ID_CEAG_CORRECTIONSIGNAL_RTK_GALILEO_SATVISIBLE_R" 16552 "GD_ID_CEAG_CORRECTIONSIGNAL_RTK_GALILEO_SATUSED_R" 16553 "GD_ID_CEAG_CORRECTIONSIGNAL_RTK_RADIO_CONFIGURABLE_R" 16554 "GD_ID_CEAG_CORRECTIONSIGNAL_RTK_BASELINE_R" 16555 "GD_ID_CEAG_CORRECTIONSIGNAL_SIGNALLAG_R" 16556 "GD_ID_CEAG_CORRECTIONSIGNAL_FALLBACK_RW_Status" 16556 "GD_ID_CEAG_CORRECTIONSIGNAL_FALLBACK_RW" 16557 "GD_ID_CEAG_CORRECTIONSIGNAL_ACCURACY_GNSSANTENNA_R" 16558 "GD_ID_CEAG_CORRECTIONSIGNAL_ACCURACY_VEHICLEREFERENCEPOINT_R" 16559 "GD_ID_CEAG_CORRECTIONSIGNAL_AUTHORISATIONLEVEL_R" 16560 "GD_ID_CEAG_CORRECTIONSIGNAL_RTKNETWORK_GSM_NUMBER_BLKRW" 16561 "GD_ID_CEAG_CORRECTIONSIGNAL_RTKNETWORK_GSM_PIN_BLKRW" 16562 "GD_ID_CEAG_CORRECTIONSIGNAL_RTKNETWORK_CORRECTIONFORMAT_RW_Status" 16562 "GD_ID_CEAG_CORRECTIONSIGNAL_RTKNETWORK_CORRECTIONFORMAT_RW" 16563 "GD_ID_CEAG_CORRECTIONSIGNAL_RTKNETWORK_GPRS_ACCESSPOINT_BLKRW" 16564 "GD_ID_CEAG_CORRECTIONSIGNAL_RTKNETWORK_GPRS_IPADDRESS_BLKRW" 16565 "GD_ID_CEAG_CORRECTIONSIGNAL_RTKNETWORK_GPRS_PORT_BLKRW" 16566 "GD_ID_CEAG_CORRECTIONSIGNAL_RTKNETWORK_GPRS_MOUNTPOINT_BLKRW" 16567 "GD_ID_CEAG_CORRECTIONSIGNAL_RTKNETWORK_GPRS_USERNAME_CONNECTIONPOVIDER_BLKRW" 16568 "GD_ID_CEAG_CORRECTIONSIGNAL_RTKNETWORK_GPRS_PASSWORD_CONNECTIONPROVIDER_BLKRW" 16569 "GD_ID_CEAG_CORRECTIONSIGNAL_RTKNETWORK_NMEA_DATA_RW" 16570 "GD_ID_CEAG_CORRECTIONSIGNAL_TYPE_ACTUAL_R" 16571 "GD_ID_CEAG_CORRECTIONSIGNAL_RTKNETWORK_GPRS_USERNAME_SIGNALPROVIDER_BLKRW" 16572 "GD_ID_CEAG_CORRECTIONSIGNAL_RTKNETWORK_GPRS_PASSWORD_SIGNALPROVIDER_BLKRW" 16573 "GD_ID_CEAG_CORRECTIONSIGNAL_RTKNETWORK_GSM_GPRS_CONNECTION_RW_Status" 16573 "GD_ID_CEAG_CORRECTIONSIGNAL_RTKNETWORK_GSM_GPRS_CONNECTION_RW" 16574 "GD_ID_CEAG_CORRECTIONSIGNAL_RTKNETWORK_GPRS_PIN_BLKRW" 16575 "GD_ID_CEAG_CORRECTIONSIGNAL_RTKNETWORK_MODE_RW_Status" 16575 "GD_ID_CEAG_CORRECTIONSIGNAL_RTKNETWORK_MODE_RW" 16576 "GD_ID_CEAG_NMEA_SERIALINTERFACE_RW" 16579 "GD_ID_CEAG_NMEA_DATA_1_RW" 16580 "GD_ID_CEAG_NMEA_DATA_2_RW" 16581 "GD_ID_CEAG_NMEA_DATA_3_RW" 16582 "GD_ID_CEAG_NMEA_DATA_4_RW" 16583 "GD_ID_CEAG_NMEA_DATA_5_RW" 16584 "GD_ID_CEAG_NMEA_OUTPUT_RW" 16606 "GD_ID_CEAG_SENSOR_IMU_ROLL_R_Status" 16606 "GD_ID_CEAG_SENSOR_IMU_ROLL_R" 16607 "GD_ID_CEAG_SENSOR_IMU_PITCH_R_Status" 16607 "GD_ID_CEAG_SENSOR_IMU_PITCH_R" 16608 "GD_ID_CEAG_SENSOR_IMU_YAW_R_Status" 16608 "GD_ID_CEAG_SENSOR_IMU_YAW_R" 16609 "GD_ID_CEAG_SENSOR_IMU_MOUNTINGBIAS_R_Status" 16609 "GD_ID_CEAG_SENSOR_IMU_MOUNTINGBIAS_R" 16610 "GD_ID_CEAG_SENSOR_IMU_DHEADING_R" 16611 "GD_ID_CEAG_SENSOR_IMU_WARMING_TIME_R_Status" 16611 "GD_ID_CEAG_SENSOR_IMU_WARMING_TIME_R" 16612 "GD_ID_CEAG_SENSOR_IMU_CALIBRATION_TIME_R_Status" 16612 "GD_ID_CEAG_SENSOR_IMU_CALIBRATION_TIME_R" 16613 "GD_ID_CEAG_ID_FA_KALIB_IMU_SET_R" 16614 "GD_ID_CEAG_ID_FA_KALIB_IMU_GET_W" 16639 "GD_ID_CEAG_ID_GNSS_ANTENNA_TYPE_R" 16640 "GD_ID_CEAG_ID_GNSS_ANTENNA_MODEL_BLKR" 16641 "GD_ID_CEAG_ID_GNSS_ANTENNA_PSN_BLKR" 16642 "GD_ID_CEAG_ID_GNSS_ANTENNA_HWVERSION_BLKR" 16643 "GD_ID_CEAG_ID_GNSS_ANTENNA_SWVERSION_BLKR" 16644 "GD_ID_CEAG_ID_GNSS_ANTENNA_BOOTVERSION_BLKR" 16645 "GD_ID_CEAG_ID_GNSS_ANTENNA_COMPILE_DATE_BLKR" 16646 "GD_ID_CEAG_ID_GNSS_ANTENNA_AUTHCODE_BLKW" 16650 "GD_ID_CEAG_ID_CORRECTIONSIGNAL_NTRIP_DELAY_R" 16878 "GD_ID_CEAG_ErrorManagement_Status" 16878 "GD_ID_CEAG_ErrorManagement" 16895 "GD_ID_CEAG_LifeMessage" 27648 "GD_ID_HC_TARGET_STATE_Status" 27648 "GD_ID_HC_TARGET_STATE" 27649 "GD_ID_HC_MACHINE_STATE_Status" 27649 "GD_ID_HC_MACHINE_STATE" 27650 "GD_ID_HC_LEG_STATE_FRONTLEFT" 27651 "GD_ID_HC_LEG_STATE_FRONTRIGHT" 27652 "GD_ID_HC_LEG_STATE_REARLEFT" 27653 "GD_ID_HC_LEG_STATE_REARRIGHT" 27654 "GD_ID_HC_TARGET_CLEARANCE_FL" 27655 "GD_ID_HC_TARGET_CLEARANCE_FR" 27656 "GD_ID_HC_TARGET_CLEARANCE_RL" 27657 "GD_ID_HC_TARGET_CLEARANCE_RR" 27658 "GD_ID_HC_ACTUAL_CLEARANCE_FL_Status" 27658 "GD_ID_HC_ACTUAL_CLEARANCE_FL" 27659 "GD_ID_HC_ACTUAL_CLEARANCE_FR_Status" 27659 "GD_ID_HC_ACTUAL_CLEARANCE_FR" 27660 "GD_ID_HC_ACTUAL_CLEARANCE_RL_Status" 27660 "GD_ID_HC_ACTUAL_CLEARANCE_RL" 27661 "GD_ID_HC_ACTUAL_CLEARANCE_RR_Status" 27661 "GD_ID_HC_ACTUAL_CLEARANCE_RR" 27662 "GD_ID_HC_STROKE_LEGNTH_RAW_FL" 27663 "GD_ID_HC_STROKE_LEGNTH_RAW_FR" 27664 "GD_ID_HC_STROKE_LEGNTH_RAW_RL" 27665 "GD_ID_HC_STROKE_LEGNTH_RAW_RR" 27666 "GD_ID_HC_OKAY_TO_TRANSITION" 27667 "GD_ID_HC_CYLINDER_PWM_EXTEND_FL" 27668 "GD_ID_HC_CYLINDER_PWM_EXTEND_FR" 27669 "GD_ID_HC_CYLINDER_PWM_EXTEND_RL" 27670 "GD_ID_HC_CYLINDER_PWM_EXTEND_RR" 27671 "GD_ID_HC_CYLINDER_PWM_RETRCT_FL" 27672 "GD_ID_HC_CYLINDER_PWM_RETRCT_FR" 27673 "GD_ID_HC_CYLINDER_PWM_RETRCT_RL" 27674 "GD_ID_HC_CYLINDER_PWM_RETRCT_RR" 27675 "GD_ID_HC_LADDER_EXTEND_Status" 27675 "GD_ID_HC_LADDER_EXTEND" 27676 "GD_ID_HC_REQUEST_CCO_OFF_Status" 27676 "GD_ID_HC_REQUEST_CCO_OFF" 27677 "GD_ID_HC_USER_WARNINGS" 27682 "GD_ID_HC_MOVEMENT_ERROR_FL" 27679 "GD_ID_HC_MOVEMENT_ERROR_FR" 27680 "GD_ID_HC_MOVEMENT_ERROR_RL" 27681 "GD_ID_HC_MOVEMENT_ERROR_RR" 27678 "GD_ID_HC_MANUAL_OVERRIDE_Status" 27678 "GD_ID_HC_MANUAL_OVERRIDE" 27683 "GD_ID_HC_CAL_STATE_Status" 27683 "GD_ID_HC_CAL_STATE" 27684 "GD_ID_HC_CAL_CMD" 27685 "GD_ID_HC_SENSOR_RAW_FL" 27686 "GD_ID_HC_SENSOR_RAW_FR" 27687 "GD_ID_HC_SENSOR_RAW_RL" 27688 "GD_ID_HC_SENSOR_RAW_RR" 27689 "GD_ID_HC_COIL_RAW_EXTEND_FL" 27690 "GD_ID_HC_COIL_RAW_RETRCT_FL" 27691 "GD_ID_HC_COIL_RAW_EXTEND_FR" 27692 "GD_ID_HC_COIL_RAW_RETRCT_FR" 27693 "GD_ID_HC_COIL_RAW_EXTEND_RL" 27694 "GD_ID_HC_COIL_RAW_RETRCT_RL" 27695 "GD_ID_HC_COIL_RAW_EXTEND_RR" 27696 "GD_ID_HC_COIL_RAW_RETRCT_RR" 27697 "GD_ID_HC_STROKE_LEGNTH_FILTER_FL_Status" 27697 "GD_ID_HC_STROKE_LEGNTH_FILTER_FL" 27698 "GD_ID_HC_STROKE_LEGNTH_FILTER_FR_Status" 27698 "GD_ID_HC_STROKE_LEGNTH_FILTER_FR" 27699 "GD_ID_HC_STROKE_LEGNTH_FILTER_RL_Status" 27699 "GD_ID_HC_STROKE_LEGNTH_FILTER_RL" 27700 "GD_ID_HC_STROKE_LEGNTH_FILTER_RR_Status" 27700 "GD_ID_HC_STROKE_LEGNTH_FILTER_RR" 28142 "GD_ID_HC_ErrorManagement_Status" 28142 "GD_ID_HC_ErrorManagement" 28159 "GD_ID_HC_LifeMessage" 32480 "GD_ID_ACM_BT_SERVER_ADDR_ROUTER_Status" 32480 "GD_ID_ACM_BT_SERVER_ADDR_ROUTER" 32750 "GD_ID_ACM_ErrorManagement_Status" 32750 "GD_ID_ACM_ErrorManagement" 32767 "GD_ID_ACM_LifeMessage"  ;
VAL_ 1552 DataIndex 1024 "GD_ID_NT01_Date_Year" 1025 "GD_ID_NT01_Date_Month" 1026 "GD_ID_NT01_Date_Day" 1027 "GD_ID_NT01_Date_WeekDay" 1028 "GD_ID_NT01_Time_Hours" 1029 "GD_ID_NT01_Time_Minutes" 1030 "GD_ID_NT01_Time_Seconds" 1045 "GD_ID_NT01_MainBoardTemp" 1056 "GD_ID_NT01_LightSensor_Status" 1056 "GD_ID_NT01_LightSensor" 1281 "GD_ID_NT01_Software_Version" 1282 "GD_ID_NT01_Software_Revision" 1283 "GD_ID_NT01_Build_Date_Day_Month" 1284 "GD_ID_NT01_Build_Date_Year" 1285 "GD_ID_NT01_Build_Time_Hrs_Min" 1286 "GD_ID_NT01_Build_Time_Seconds" 1036 "GD_ID_Time_Seconds" 1037 "GD_ID_Time_Hours_Minutes" 1038 "GD_ID_Date_Month_Day" 1039 "GD_ID_Date_Year" 1518 "GD_ID_NT01_ErrorManagement_Status" 1518 "GD_ID_NT01_ErrorManagement" 1535 "GD_ID_NT01_LifeMessage" 1536 "GD_ID_MFA_A19_Status" 1536 "GD_ID_MFA_A19" 1544 "GD_ID_MFA_A11_Status" 1544 "GD_ID_MFA_A11" 1545 "GD_ID_MFA_A11_LED" 1546 "GD_ID_MFA_A12_Status" 1546 "GD_ID_MFA_A12" 1547 "GD_ID_MFA_A12_LED" 1548 "GD_ID_MFA_A13_Status" 1548 "GD_ID_MFA_A13" 1549 "GD_ID_MFA_A13_LED" 1550 "GD_ID_MFA_A14_Status" 1550 "GD_ID_MFA_A14" 1551 "GD_ID_MFA_A14_LED" 1562 "GD_ID_MFA_A1_Status" 1562 "GD_ID_MFA_A1" 1563 "GD_ID_MFA_A2_Status" 1563 "GD_ID_MFA_A2" 1568 "GD_ID_MFA_A10_Status" 1568 "GD_ID_MFA_A10" 1569 "GD_ID_MFA_A8_Status" 1569 "GD_ID_MFA_A8" 1570 "GD_ID_MFA_A7_Status" 1570 "GD_ID_MFA_A7" 1571 "GD_ID_MFA_A24_Status" 1571 "GD_ID_MFA_A24" 1572 "GD_ID_MFA_A9_Status" 1572 "GD_ID_MFA_A9" 1573 "GD_ID_MFA_A26_Status" 1573 "GD_ID_MFA_A26" 1574 "GD_ID_MFA_A17_Status" 1574 "GD_ID_MFA_A17" 1575 "GD_ID_MFA_A18_Status" 1575 "GD_ID_MFA_A18" 1576 "GD_ID_MFA_A15_Status" 1576 "GD_ID_MFA_A15" 1577 "GD_ID_MFA_A16_Status" 1577 "GD_ID_MFA_A16" 1578 "GD_ID_MFA_A3_Status" 1578 "GD_ID_MFA_A3" 1579 "GD_ID_MFA_A20_Status" 1579 "GD_ID_MFA_A20" 1580 "GD_ID_MFA_A5_Status" 1580 "GD_ID_MFA_A5" 1581 "GD_ID_MFA_A22_Status" 1581 "GD_ID_MFA_A22" 1582 "GD_ID_MFA_A4_Status" 1582 "GD_ID_MFA_A4" 1583 "GD_ID_MFA_A6_Status" 1583 "GD_ID_MFA_A6" 1584 "GD_ID_MFA_E1_Status" 1584 "GD_ID_MFA_E1" 1585 "GD_ID_MFA_E2_Status" 1585 "GD_ID_MFA_E2" 1586 "GD_ID_MFA_E3_Status" 1586 "GD_ID_MFA_E3" 1587 "GD_ID_MFA_E4_Status" 1587 "GD_ID_MFA_E4" 1590 "GD_ID_MFA_ZONE_D_ROCKER_1" 1591 "GD_ID_MFA_ZONE_D_LED_ROCKER_1" 1592 "GD_ID_MFA_ZONE_D_ROCKER_2" 1593 "GD_ID_MFA_ZONE_D_LED_ROCKER_2" 1594 "GD_ID_MFA_ZONE_D_ROCKER_3" 1595 "GD_ID_MFA_ZONE_D_LED_ROCKER_3" 1596 "GD_ID_MFA_ZONE_D_ROCKER_4" 1597 "GD_ID_MFA_ZONE_D_LED_ROCKER_4" 1598 "GD_ID_MFA_ZONE_D_ROCKER_5" 1599 "GD_ID_MFA_ZONE_D_LED_ROCKER_5" 1600 "GD_ID_MFA_B1_Status" 1600 "GD_ID_MFA_B1" 1601 "GD_ID_MFA_F1_Status" 1601 "GD_ID_MFA_F1" 1632 "GD_ID_MFA_C17_Status" 1632 "GD_ID_MFA_C17" 1633 "GD_ID_MFA_C17_LED" 1634 "GD_ID_MFA_C18_Status" 1634 "GD_ID_MFA_C18" 1635 "GD_ID_MFA_C18_LED" 1636 "GD_ID_MFA_C9_Status" 1636 "GD_ID_MFA_C9" 1637 "GD_ID_MFA_C9_LED" 1638 "GD_ID_MFA_C10_Status" 1638 "GD_ID_MFA_C10" 1639 "GD_ID_MFA_C10_LED" 1640 "GD_ID_MFA_C1_Status" 1640 "GD_ID_MFA_C1" 1641 "GD_ID_MFA_C1_LED" 1642 "GD_ID_MFA_C2_Status" 1642 "GD_ID_MFA_C2" 1643 "GD_ID_MFA_C2_LED" 1644 "GD_ID_MFA_ZONE_D_BUTTON_LEFT_INSIDE_Status" 1644 "GD_ID_MFA_ZONE_D_BUTTON_LEFT_INSIDE" 1645 "GD_ID_MFA_ZONE_D_LED_LEFT_INSIDE" 1646 "GD_ID_MFA_ZONE_D_BUTTON_LEFT_OUTSIDE_Status" 1646 "GD_ID_MFA_ZONE_D_BUTTON_LEFT_OUTSIDE" 1647 "GD_ID_MFA_ZONE_D_LED_LEFT_OUTSIDE" 1648 "GD_ID_MFA_C19_Status" 1648 "GD_ID_MFA_C19" 1649 "GD_ID_MFA_C19_LED" 1650 "GD_ID_MFA_C20_Status" 1650 "GD_ID_MFA_C20" 1651 "GD_ID_MFA_C20_LED" 1652 "GD_ID_MFA_C11_Status" 1652 "GD_ID_MFA_C11" 1653 "GD_ID_MFA_C11_LED" 1654 "GD_ID_MFA_C12_Status" 1654 "GD_ID_MFA_C12" 1655 "GD_ID_MFA_C12_LED" 1656 "GD_ID_MFA_C3_Status" 1656 "GD_ID_MFA_C3" 1657 "GD_ID_MFA_C3_LED" 1658 "GD_ID_MFA_C4_Status" 1658 "GD_ID_MFA_C4" 1659 "GD_ID_MFA_C4_LED" 1660 "GD_ID_MFA_ZONE_D_BUTTON_RIGHT_INSIDE_Status" 1660 "GD_ID_MFA_ZONE_D_BUTTON_RIGHT_INSIDE" 1661 "GD_ID_MFA_ZONE_D_LED_RIGHT_INSIDE" 1662 "GD_ID_MFA_ZONE_D_BUTTON_RIGHT_OUTSIDE_Status" 1662 "GD_ID_MFA_ZONE_D_BUTTON_RIGHT_OUTSIDE" 1663 "GD_ID_MFA_ZONE_D_LED_RIGHT_OUTSIDE" 1664 "GD_ID_MFA_C21_Status" 1664 "GD_ID_MFA_C21" 1665 "GD_ID_MFA_C21_LED" 1666 "GD_ID_MFA_C22_Status" 1666 "GD_ID_MFA_C22" 1667 "GD_ID_MFA_C22_LED" 1668 "GD_ID_MFA_C13_Status" 1668 "GD_ID_MFA_C13" 1669 "GD_ID_MFA_C13_LED" 1670 "GD_ID_MFA_C14_Status" 1670 "GD_ID_MFA_C14" 1671 "GD_ID_MFA_C14_LED" 1672 "GD_ID_MFA_C5_Status" 1672 "GD_ID_MFA_C5" 1673 "GD_ID_MFA_C5_LED" 1674 "GD_ID_MFA_C6_Status" 1674 "GD_ID_MFA_C6" 1675 "GD_ID_MFA_C6_LED" 1680 "GD_ID_MFA_C23_Status" 1680 "GD_ID_MFA_C23" 1681 "GD_ID_MFA_C23_LED" 1682 "GD_ID_MFA_C24_Status" 1682 "GD_ID_MFA_C24" 1683 "GD_ID_MFA_C24_LED" 1684 "GD_ID_MFA_C15_Status" 1684 "GD_ID_MFA_C15" 1685 "GD_ID_MFA_C15_LED" 1686 "GD_ID_MFA_C16_Status" 1686 "GD_ID_MFA_C16" 1687 "GD_ID_MFA_C16_LED" 1688 "GD_ID_MFA_C7_Status" 1688 "GD_ID_MFA_C7" 1689 "GD_ID_MFA_C7_LED" 1690 "GD_ID_MFA_C8_Status" 1690 "GD_ID_MFA_C8" 1691 "GD_ID_MFA_C8_LED" 1696 "GD_ID_MFA_FunctionLighting" 1697 "GD_ID_MFA_NightDesign" 1736 "GD_ID_MFA_Throttle_CalibCmd" 1737 "GD_ID_MFA_Throttle_CalibState" 1738 "GD_ID_MFA_UNKNOWN_Calibration_Cmd" 1739 "GD_ID_MFA_UNKNOWN_Calibration_Status" 1740 "GD_ID_LM1_CalibrationCommand" 1741 "GD_ID_LM1_CalibrationStatus" 1742 "GD_ID_MFA_Lever_CalibCmd" 1743 "GD_ID_MFA_Lever_CalibState" 1744 "GD_ID_LM3_CalibrationCommand" 1745 "GD_ID_LM3_CalibrationStatus" 1746 "GD_ID_LM4_CalibrationCommand" 1747 "GD_ID_LM4_CalibrationStatus" 2030 "GD_ID_MFA_ErrorManagement_Status" 2030 "GD_ID_MFA_ErrorManagement" 2032 "GD_ID_HwConfigMFA" 2033 "GD_ID_IdentificationModule" 2036 "GD_ID_MFA_SoftwareVersion" 2037 "GD_ID_SwVersionAJS" 2040 "GD_ID_SerialNumber1st" 2041 "GD_ID_SerialNumber2nd" 2047 "GD_ID_MFA_LifeMessage" 2049 "GD_ID_DRIVE_AIR_PRESSURE" 2050 "GD_ID_DRIVE_HYDRAULICS_ENABLE_Status" 2050 "GD_ID_DRIVE_HYDRAULICS_ENABLE" 2051 "GD_ID_DRIVE_REQUEST_HYD_ENABLE_OFF_Status" 2051 "GD_ID_DRIVE_REQUEST_HYD_ENABLE_OFF" 2052 "GD_ID_DRIVE_BRAKE_PEDAL_POSITION_A" 2053 "GD_ID_DRIVE_BRAKE_PEDAL_POSITION_B" 2054 "GD_ID_DRIVE_BRAKE_PEDAL_POSITION" 2055 "GD_ID_DRIVE_HYD_MOT_RPM_FR" 2056 "GD_ID_DRIVE_HYD_MOT_RPM_RR" 2057 "GD_ID_DRIVE_HYD_MOT_RPM_RL" 2058 "GD_ID_DRIVE_HYD_MOT_RPM_FL" 2061 "GD_ID_DRIVE_FORWARD_SS_DEFAULT_SPEED" 2062 "GD_ID_DRIVE_REVERSE_SS_DEFAULT_SPEED" 2063 "GD_ID_DRIVE_WHEEL_BASED_MACHINE_SPEED" 2064 "GD_ID_DRIVE_DANFOSS_IN_SV_STATE_COMMANDED_Status" 2064 "GD_ID_DRIVE_DANFOSS_IN_SV_STATE_COMMANDED" 2065 "GD_ID_DRIVE_DANFOSS_OUT_SV_STATE_ACTUAL_Status" 2065 "GD_ID_DRIVE_DANFOSS_OUT_SV_STATE_ACTUAL" 2066 "GD_ID_DRIVE_DANFOSS_IN_SV_SPEED" 2067 "GD_ID_DRIVE_DANFOSS_OUT_DRIVE_MODE_ACTUAL_Status" 2067 "GD_ID_DRIVE_DANFOSS_OUT_DRIVE_MODE_ACTUAL" 2068 "GD_ID_DRIVE_DANFOSS_IN_DRIVE_MODE_COMMANDED_Status" 2068 "GD_ID_DRIVE_DANFOSS_IN_DRIVE_MODE_COMMANDED" 2069 "GD_ID_DRIVE_SV_1_Status" 2069 "GD_ID_DRIVE_SV_1" 2070 "GD_ID_DRIVE_SV_2_Status" 2070 "GD_ID_DRIVE_SV_2" 2071 "GD_ID_DRIVE_SV_STATE" 2072 "GD_ID_DRIVE_MAX_ENGINE_DROP" 2076 "GD_ID_DRIVE_CALIB_STATE_BRAKE_PEDAL_Status" 2076 "GD_ID_DRIVE_CALIB_STATE_BRAKE_PEDAL" 2077 "GD_ID_DRIVE_MAX_SV_SPEED" 2078 "GD_ID_DRIVE_PRESSURE_A" 2079 "GD_ID_DRIVE_PRESSURE_B" 2080 "GD_ID_DRIVE_CHARGE_PRESSURE" 2084 "GD_ID_DRIVE_DASH_DISPLAYED_ENGINE_SPEED" 2085 "GD_ID_DRIVE_FRONT_STEER_ANGLE" 2086 "GD_ID_DRIVE_DANFOSS_OUT_PARKBRK_REQUEST_Status" 2086 "GD_ID_DRIVE_DANFOSS_OUT_PARKBRK_REQUEST" 2087 "GD_ID_DRIVE_DANFOSS_OUT_CCO_VALVE_REQUEST_Status" 2087 "GD_ID_DRIVE_DANFOSS_OUT_CCO_VALVE_REQUEST" 2088 "GD_ID_DRIVE_CCO_VALVE_COMMAND_Status" 2088 "GD_ID_DRIVE_CCO_VALVE_COMMAND" 2092 "GD_ID_DRIVE_TIRE_RCI" 2094 "GD_ID_DRIVE_DASH_DISPLAYED_MACHINE_SPEED2" 2095 "GD_ID_DRIVE_CARGO_OVER_WEIGHT_Status" 2095 "GD_ID_DRIVE_CARGO_OVER_WEIGHT" 2096 "GD_ID_DRIVE_ROGATOR_MACHINE_CONFIGURATION" 2097 "GD_ID_DRIVE_TIRE_ROLLING_CIRCUMFERENCE" 2098 "GD_ID_DRIVE_BRAKE_LIGHT_COMMAND_Status" 2098 "GD_ID_DRIVE_BRAKE_LIGHT_COMMAND" 2099 "GD_ID_DRIVE_TARGET_MACHINE_SPEED" 2100 "GD_ID_DRIVE_MAX_MACHINE_SPEED" 2101 "GD_ID_DRIVE_EXPECTED_MACHINE_SPEED" 2111 "GD_ID_DRIVE_CALIB_BRAKE_PEDAL_START_Status" 2111 "GD_ID_DRIVE_CALIB_BRAKE_PEDAL_START" 2112 "GD_ID_DRIVE_CALIB_BRAKE_PEDAL_ACTIVE_Status" 2112 "GD_ID_DRIVE_CALIB_BRAKE_PEDAL_ACTIVE" 2113 "GD_ID_DRIVE_CALIB_BRAKE_PEDAL_DOWN_Status" 2113 "GD_ID_DRIVE_CALIB_BRAKE_PEDAL_DOWN" 2114 "GD_ID_DRIVE_CALIB_BRAKE_PEDAL_DOWN_RET_Status" 2114 "GD_ID_DRIVE_CALIB_BRAKE_PEDAL_DOWN_RET" 2115 "GD_ID_DRIVE_CALIB_BRAKE_PEDAL_UP_Status" 2115 "GD_ID_DRIVE_CALIB_BRAKE_PEDAL_UP" 2116 "GD_ID_DRIVE_CALIB_BRAKE_PEDAL_UP_RET_Status" 2116 "GD_ID_DRIVE_CALIB_BRAKE_PEDAL_UP_RET" 2117 "GD_ID_DRIVE_CALIB_BRAKE_PEDAL_ACCEPT_Status" 2117 "GD_ID_DRIVE_CALIB_BRAKE_PEDAL_ACCEPT" 2118 "GD_ID_DRIVE_CALIB_BRAKE_PEDAL_DECLINE_Status" 2118 "GD_ID_DRIVE_CALIB_BRAKE_PEDAL_DECLINE" 2119 "GD_ID_DRIVE_CALIB_BRAKE_PEDAL_PROCESSED_Status" 2119 "GD_ID_DRIVE_CALIB_BRAKE_PEDAL_PROCESSED" 2120 "GD_ID_DRIVE_CALIB_BRAKE_PEDAL_ERROR_Status" 2120 "GD_ID_DRIVE_CALIB_BRAKE_PEDAL_ERROR" 2121 "GD_ID_DRIVE_FIELD_STREET_STATE" 2122 "GD_ID_DRIVE_DTM_ENALBED_IN_MANUAL_Status" 2122 "GD_ID_DRIVE_DTM_ENALBED_IN_MANUAL" 2123 "GD_ID_DRIVE_STATE" 2124 "GD_ID_DRIVE_DTM_MIN_RPM" 2125 "GD_ID_DRIVE_DTM_MAX_RPM" 2126 "GD_ID_DRIVE_DRIVEPUMP_A_COMCURRENT" 2127 "GD_ID_DRIVE_DRIVEPUMP_B_COMCURRENT" 2128 "GD_ID_DRIVE_HYD_MOT_FR_COMCURRENT" 2129 "GD_ID_DRIVE_HYD_MOT_RR_COMCURRENT" 2130 "GD_ID_DRIVE_HYD_MOT_RL_COMCURRENT" 2131 "GD_ID_DRIVE_HYD_MOT_FL_COMCURRENT" 2133 "GD_ID_DRIVE_HYDRAULIC_OIl_TEMP" 2135 "GD_ID_DRIVE_FUEL_LEVEL" 2137 "GD_ID_DRIVE_PARKBRAKE_COMMAND_Status" 2137 "GD_ID_DRIVE_PARKBRAKE_COMMAND" 2138 "GD_ID_DRIVE_OPERATION_MODE" 2139 "GD_ID_DRIVE_DRIVEPUMP_A_FEEDBACK_CURRENT" 2140 "GD_ID_DRIVE_DRIVEPUMP_B_FEEDBACK_CURRENT" 2141 "GD_ID_DRIVE_HYD_MOT_FR_FEEDBACK_CURRENT" 2142 "GD_ID_DRIVE_HYD_MOT_RR_FEEDBACK_CURRENT" 2143 "GD_ID_DRIVE_HYD_MOT_RL_FEEDBACK_CURRENT" 2144 "GD_ID_DRIVE_HYD_MOT_FL_FEEDBACK_CURRENT" 2150 "GD_ID_DRIVE_RADAR_SPEED" 2175 "GD_ID_DRIVE_DASH_DISPLAYED_PARK_BRAKE_LED_Status" 2175 "GD_ID_DRIVE_DASH_DISPLAYED_PARK_BRAKE_LED" 2192 "GD_ID_DRIVE_CURRENT_GEAR" 2193 "GD_ID_DRIVE_SELECTED_GEAR" 2194 "GD_ID_DRIVE_DRIVE_PEDAL_POSITION" 2207 "GD_ID_DRIVE_DASH_DISPLAYED_MACHINE_SPEED1" 2258 "GD_ID_DRIVE_DTM_COMMANDED_RPM" 2300 "GD_ID_DRIVE_DISPLAY_UNITS_Status" 2300 "GD_ID_DRIVE_DISPLAY_UNITS" 2348 "GD_ID_DRIVE_RESET_DEFAULT_PROFILES_Status" 2348 "GD_ID_DRIVE_RESET_DEFAULT_PROFILES" 2349 "GD_ID_DRIVE_LEVER_ACCEL_PROFILE" 2350 "GD_ID_DRIVE_LEVER_DECEL_PROFILE" 2351 "GD_ID_DRIVE_PEDAL_ACCEL_PROFILE" 2352 "GD_ID_DRIVE_PEDAL_DECEL_PROFILE" 2353 "GD_ID_DRIVE_SV_ACCELDECEL_PROFILE" 2355 "GD_ID_DRIVE_SHUTTLE_ACCELDECEL_PROFILE" 2373 "GD_ID_DRIVE_DANFOSS_IN_OUTFAULTS" 2374 "GD_ID_ASC_RAMP_RL_DECTM" 2375 "GD_ID_ASC_PID_FL_KIUP_ASC" 2376 "GD_ID_ASC_PID_FL_KIDOWN_ASC" 2377 "GD_ID_ASC_PID_FL_KPUP_ASC" 2378 "GD_ID_ASC_PID_FL_KPDOWN_ASC" 2379 "GD_ID_ASC_PID_FL_KDUP_ASC" 2380 "GD_ID_ASC_PID_FL_IRED" 2381 "GD_ID_ASC_INCHING_INCHMODE" 2382 "GD_ID_ASC_INCHING_TVOLINCH" 2383 "GD_ID_ASC_REFSPDDISABLE_ABS_MINREFSPD_MMSEC" 2384 "GD_ID_ASC_REFSPDDISABLE_ASC_MINREFSPD_MMSEC" 2385 "GD_ID_ASC_REFSPDDISABLE_ABS_DECRAMP60K" 2386 "GD_ID_ASC_FFPROFILES_REVBRAKINGFRONT_Y4_PTC2" 2387 "GD_ID_ASC_FFPROFILES_REVBRAKINGFRONT_Y5_PTC2" 2388 "GD_ID_ASC_FFPROFILES_REVBRAKINGFRONT_Y6_PTC2" 2389 "GD_ID_ASC_FFPROFILES_FWDBRAKINGREAR_Y5_PTC2_LD" 2390 "GD_ID_ASC_FFPROFILES_FWDBRAKINGREAR_Y5_PTC2" 2391 "GD_ID_ASC_FFPROFILES_FWDBRAKINGREAR_Y6_PTC2_LD" 2392 "GD_ID_ASC_FFPROFILES_FWDBRAKINGREAR_Y6_PTC2" 2393 "GD_ID_ASC_CORE_ASC_MINTOLERANCE_PCT2" 2394 "GD_ID_ASC_PID_RL_KDUP_ASC" 2395 "GD_ID_ASC_PID_RL_KPUP_ASC" 2396 "GD_ID_ASC_PID_RL_KPDN_ASC" 2397 "GD_ID_ASC_PID_RL_KIUP_ASC" 2398 "GD_ID_ASC_PID_RL_KIDN_ASC" 2399 "GD_ID_ASC_PID_RL_IRED" 2400 "GD_ID_BRK_Y5" 2401 "GD_ID_ENGADJLD_FILTERTM_MS" 2402 "GD_ID_ENGADJLD_Y4" 2403 "GD_ID_MV_I_INT_I_GAIN" 2404 "GD_ID_MISC_PR_PERACT_Y3" 2405 "GD_ID_MISC_PR_PERACT_Y4" 2406 "GD_ID_MISC_PR_PERACT_Y5" 2407 "GD_ID_ASC_Core_ABS_Ang_Y1_ptc2" 2408 "GD_ID_ASC_Core_ABS_Ang_Y2_ptc2" 2409 "GD_ID_ASC_Core_ABS_Ang_Y3_ptc2" 2410 "GD_ID_ASC_Core_ABS_Ang_Y4_ptc2" 2411 "GD_ID_ASC_Core_ABS_Ang_Y5_ptc2" 2412 "GD_ID_ASC_Core_ABS_MinTolerance_pct2" 2413 "GD_ID_ASC_Core_ASC_Ang_Y1_ptc2" 2414 "GD_ID_ASC_Core_ASC_Ang_Y2_ptc2" 2415 "GD_ID_ASC_Core_ASC_Ang_Y3_ptc2" 2416 "GD_ID_ASC_Core_ASC_Ang_Y4_ptc2" 2417 "GD_ID_ASC_Core_ASC_Ang_Y5_ptc2" 2458 "GD_ID_DRIVE_PEDAL_CAL_COMMAND_Status" 2458 "GD_ID_DRIVE_PEDAL_CAL_COMMAND" 2459 "GD_ID_DRIVE_PEDAL_CAL_STATE_Status" 2459 "GD_ID_DRIVE_PEDAL_CAL_STATE" 2460 "GD_ID_DRIVE_BRAKE_PEDAL_CAL_COMMAND_Status" 2460 "GD_ID_DRIVE_BRAKE_PEDAL_CAL_COMMAND" 2461 "GD_ID_DRIVE_BRAKE_PEDAL_CAL_STATE_Status" 2461 "GD_ID_DRIVE_BRAKE_PEDAL_CAL_STATE" 2462 "GD_ID_DRIVE_WAS_CAL_COMMAND_Status" 2462 "GD_ID_DRIVE_WAS_CAL_COMMAND" 2463 "GD_ID_DRIVE_WAS_CAL_STATE_Status" 2463 "GD_ID_DRIVE_WAS_CAL_STATE" 2464 "GD_ID_DRIVE_HYDRO_CAL_COMMAND_Status" 2464 "GD_ID_DRIVE_HYDRO_CAL_COMMAND" 2465 "GD_ID_DRIVE_HYDRO_CAL_STATE_Status" 2465 "GD_ID_DRIVE_HYDRO_CAL_STATE" 2468 "GD_ID_DRIVE_WHEEL_SPEED_CALIBRATION_COMMAND_Status" 2468 "GD_ID_DRIVE_WHEEL_SPEED_CALIBRATION_COMMAND" 2469 "GD_ID_DRIVE_WHEEL_SPEED_CALIBRATION_STATE_Status" 2469 "GD_ID_DRIVE_WHEEL_SPEED_CALIBRATION_STATE" 2470 "GD_ID_DRIVE_WHEEL_SPEED_CALIBRATION_USER_DISTANCE_Status" 2470 "GD_ID_DRIVE_WHEEL_SPEED_CALIBRATION_USER_DISTANCE" 2471 "GD_ID_DRIVE_RADAR_CALIBRATION_COMMAND_Status" 2471 "GD_ID_DRIVE_RADAR_CALIBRATION_COMMAND" 2472 "GD_ID_DRIVE_RADAR_CALIBRATION_STATE_Status" 2472 "GD_ID_DRIVE_RADAR_CALIBRATION_STATE" 2473 "GD_ID_DRIVE_RADAR_CALIBRATION_USER_DISTANCE_Status" 2473 "GD_ID_DRIVE_RADAR_CALIBRATION_USER_DISTANCE" 2474 "GD_ID_DRIVE_COMBO_CALIBRATION_COMMAND_Status" 2474 "GD_ID_DRIVE_COMBO_CALIBRATION_COMMAND" 2475 "GD_ID_DRIVE_COMBO_CALIBRATION_STATE_Status" 2475 "GD_ID_DRIVE_COMBO_CALIBRATION_STATE" 2476 "GD_ID_DRIVE_COMBO_CALIBRATION_USER_DISTANCE_Status" 2476 "GD_ID_DRIVE_COMBO_CALIBRATION_USER_DISTANCE" 2498 "GD_ID_DRIVE_DRIVEPUMP_A_START_CAL_CURRENT_STORED" 2499 "GD_ID_DRIVE_DRIVEPUMP_A_END_CAL_CURRENT_STORED" 2500 "GD_ID_DRIVE_DRIVEPUMP_B_START_CAL_CURRENT_STORED" 2501 "GD_ID_DRIVE_DRIVEPUMP_B_END_CAL_CURRENT_STORED" 2502 "GD_ID_DRIVE_MOTOR_FL_START_CAL_CURRENT_STORED" 2503 "GD_ID_DRIVE_MOTOR_FL_END_CAL_CURRENT_STORED" 2504 "GD_ID_DRIVE_MOTOR_FR_START_CAL_CURRENT_STORED" 2505 "GD_ID_DRIVE_MOTOR_FR_END_CAL_CURRENT_STORED" 2506 "GD_ID_DRIVE_MOTOR_RL_START_CAL_CURRENT_STORED" 2507 "GD_ID_DRIVE_MOTOR_RL_END_CAL_CURRENT_STORED" 2508 "GD_ID_DRIVE_MOTOR_RR_START_CAL_CURRENT_STORED" 2509 "GD_ID_DRIVE_MOTOR_RR_END_CAL_CURRENT_STORED" 2510 "GD_ID_DRIVE_DRIVEPUMP_A_START_CAL_CURRENT_NEW" 2511 "GD_ID_DRIVE_DRIVEPUMP_A_END_CAL_CURRENT_NEW" 2512 "GD_ID_DRIVE_DRIVEPUMP_B_START_CAL_CURRENT_NEW" 2513 "GD_ID_DRIVE_DRIVEPUMP_B_END_CAL_CURRENT_NEW" 2514 "GD_ID_DRIVE_MOTOR_FL_START_CAL_CURRENT_NEW" 2515 "GD_ID_DRIVE_MOTOR_FL_END_CAL_CURRENT_NEW" 2516 "GD_ID_DRIVE_MOTOR_FR_START_CAL_CURRENT_NEW" 2517 "GD_ID_DRIVE_MOTOR_FR_END_CAL_CURRENT_NEW" 2518 "GD_ID_DRIVE_MOTOR_RL_START_CAL_CURRENT_NEW" 2519 "GD_ID_DRIVE_MOTOR_RL_END_CAL_CURRENT_NEW" 2520 "GD_ID_DRIVE_MOTOR_RR_START_CAL_CURRENT_NEW" 2521 "GD_ID_DRIVE_MOTOR_RR_END_CAL_CURRENT_NEW" 2523 "GD_ID_DRIVE_DANFOSS_CAL_REQUEST" 2525 "GD_ID_DRIVE_WHEEL_BASED_MACHINE_SPEED_KPH" 2526 "GD_ID_DRIVE_NORMALIZED_WHEEL_SPEED_FL" 2527 "GD_ID_DRIVE_NORMALIZED_WHEEL_SPEED_FR" 2528 "GD_ID_DRIVE_NORMALIZED_WHEEL_SPEED_RL" 2529 "GD_ID_DRIVE_NORMALIZED_WHEEL_SPEED_RR" 2530 "GD_ID_DRIVE_AIRBAG_DEFLATE_Status" 2530 "GD_ID_DRIVE_AIRBAG_DEFLATE" 2542 "GD_ID_DRIVE_ERRORMANAGEMENT_Status" 2542 "GD_ID_DRIVE_ERRORMANAGEMENT" 2559 "GD_ID_DRIVE_LIFEMESSAGE" 12288 "GD_ID_SCT_ENABLE" 12289 "GD_ID_SCT_MODUL_OUT_STATUS" 12290 "GD_ID_SCT_MODUL_IN_STATUS" 12298 "GD_ID_SCT_STATUSDISPLAY_TERMINAL" 12303 "GD_ID_SCT_TURNING_OFF_REASON" 12304 "GD_ID_SCT_STATE" 12305 "GD_ID_SCT_VOTED_ACTIVE_CLASS_1" 12306 "GD_ID_SCT_VOTED_ACTIVE_CLASS_2" 12312 "GD_ID_SCT_SETPOINT_Status" 12312 "GD_ID_SCT_SETPOINT" 12313 "GD_ID_SCT_SETPOINT_FEELER_GUIDANCE_Status" 12313 "GD_ID_SCT_SETPOINT_FEELER_GUIDANCE" 12314 "GD_ID_SCT_SETPOINT_CURVATURE_Status" 12314 "GD_ID_SCT_SETPOINT_CURVATURE" 12315 "GD_ID_SCT_SETPOINT_CURVATURE_TIM_Status" 12315 "GD_ID_SCT_SETPOINT_CURVATURE_TIM" 12316 "GD_ID_SCT_SETPOINT_CURVATURE_FEELER_GUIDANCE_Status" 12316 "GD_ID_SCT_SETPOINT_CURVATURE_FEELER_GUIDANCE" 12320 "GD_ID_SCT_WAS_RAW_VALUE" 12321 "GD_ID_SCT_WAS_SCALED_VALUE" 12322 "GD_ID_SCT_WAS_SENSOR_ANGLE" 12323 "GD_ID_SCT_WAS_MEDIAN_ANGLE" 12324 "GD_ID_SCT_WAS_MEDIAN_ANGLE_MAX" 12325 "GD_ID_SCT_WAS_VIRTUAL_ANGLE" 12328 "GD_ID_SCT_WAS_MEDIAN_CURVATURE" 12329 "GD_ID_SCT_WAS_MEDIAN_CURVATURE_MAX" 12334 "GD_ID_SCT_WAS_CALIB_COMMAND" 12335 "GD_ID_SCT_WAS_CALIB_STATUS" 12336 "GD_ID_SCT_SWS_RAW_VALUE_Status" 12336 "GD_ID_SCT_SWS_RAW_VALUE" 12338 "GD_ID_SCT_SWS_LIMITED_ANGLE_Status" 12338 "GD_ID_SCT_SWS_LIMITED_ANGLE" 12339 "GD_ID_SCT_SWS_CONTINUED_ANGLE_Status" 12339 "GD_ID_SCT_SWS_CONTINUED_ANGLE" 12340 "GD_ID_SCT_SWS_ROTATIONAL_SPEED" 12352 "GD_ID_SCT_VALVE_SETPOINT" 12353 "GD_ID_SCT_VALVE_POSITION" 12366 "GD_ID_SCT_VALVE_CALIB_COMMAND" 12367 "GD_ID_SCT_VALVE_CALIB_STATUS" 12368 "GD_ID_SCT_PILOTVALVE_STATUS_Status" 12368 "GD_ID_SCT_PILOTVALVE_STATUS" 12388 "GD_ID_SCT_OLAY_STEER_FACTOR" 12416 "GD_ID_SCT_HEADLAND_CMD_Status" 12416 "GD_ID_SCT_HEADLAND_CMD" 12417 "GD_ID_SCT_3RDPARTY_READY_STATUS_Status" 12417 "GD_ID_SCT_3RDPARTY_READY_STATUS" 12418 "GD_ID_SCT_3RDPARTY_POSITION_STATUS_Status" 12418 "GD_ID_SCT_3RDPARTY_POSITION_STATUS" 12419 "GD_ID_SCT_3RDPARTY_CANCEL_REQUEST_Status" 12419 "GD_ID_SCT_3RDPARTY_CANCEL_REQUEST" 12420 "GD_ID_SCT_3RDPARTY_COMMAND_GUIDANCE_Status" 12420 "GD_ID_SCT_3RDPARTY_COMMAND_GUIDANCE" 12544 "GD_ID_SCT_TSD_MIN_SPEED_FORWARD" 12545 "GD_ID_SCT_TSD_MAX_SPEED_FORWARD" 12546 "GD_ID_SCT_TSD_MIN_MACHINE_RADIUS" 12547 "GD_ID_SCT_TSD_MAX_ACQUISITION_ANGLE" 12560 "GD_ID_SCT_GUIDANCE_CONFIGURATION_DATA_Status" 12560 "GD_ID_SCT_GUIDANCE_CONFIGURATION_DATA" 12568 "GD_ID_SCT_STEERING_MODE_Status" 12568 "GD_ID_SCT_STEERING_MODE" 12569 "GD_ID_SCT_SECONDARY_WAS_RAW_VALUE_Status" 12569 "GD_ID_SCT_SECONDARY_WAS_RAW_VALUE" 12570 "GD_ID_SCT_SECONDARY_WAS_SENSOR_ANGLE_Status" 12570 "GD_ID_SCT_SECONDARY_WAS_SENSOR_ANGLE" 12571 "GD_ID_SCT_SECONDARY_WAS_MEDIAN_ANGLE_Status" 12571 "GD_ID_SCT_SECONDARY_WAS_MEDIAN_ANGLE" 12572 "GD_ID_SCT_SECONDARY_WAS_MEDIAN_ANGLE_MAX_Status" 12572 "GD_ID_SCT_SECONDARY_WAS_MEDIAN_ANGLE_MAX" 12573 "GD_ID_SCT_ALS_X_OFFSET_Status" 12573 "GD_ID_SCT_ALS_X_OFFSET" 12574 "GD_ID_SCT_ALS_Y_OFFSET_Status" 12574 "GD_ID_SCT_ALS_Y_OFFSET" 12575 "GD_ID_SCT_ADDITIONAL_WORKING_HEIGHT" 12576 "GD_ID_SCT_VEHICLE_CURRENT_PAYLOAD_Status" 12576 "GD_ID_SCT_VEHICLE_CURRENT_PAYLOAD" 12598 "GD_ID_SCT_ISO_STATE" 12599 "GD_ID_SCT_VEHICLE_SPEED_Status" 12599 "GD_ID_SCT_VEHICLE_SPEED" 12600 "GD_ID_SCT_VEHICLE_MOVEMENT_Status" 12600 "GD_ID_SCT_VEHICLE_MOVEMENT" 12601 "GD_ID_SCT_PARKING_BRAKE_Status" 12601 "GD_ID_SCT_PARKING_BRAKE" 12608 "GD_ID_SCT_CONTROL_MSG_TERMINAL" 12609 "GD_ID_SCT_CONTROL_MSG_GUIDEANCE" 12610 "GD_ID_SCT_MODIFIED_REFERENCE_POINT_HEIGHT" 12611 "GD_ID_SCT_MODIFIED_GNSS_ANTENNA_X_OFFSET" 12612 "GD_ID_SCT_MODIFIED_GNSS_ANTENNA_Y_OFFSET" 12613 "GD_ID_SCT_MODIFIED_GNSS_ANTENNA_Z_OFFSET" 12614 "GD_ID_SCT_MODIFIED_TRACK_WIDTH" 12615 "GD_ID_SCT_MODIFIED_MOUNTING_ERROR_Y_OFFSET" 12736 "GD_ID_SCT_TRACTOR_SN_TYPE" 12737 "GD_ID_SCT_TRACTOR_SN_GROUP" 12738 "GD_ID_SCT_TRACTOR_SN_NUMBER" 12782 "GD_ID_SCT_ERROR_ACKNOWLEDGE_Status" 12782 "GD_ID_SCT_ERROR_ACKNOWLEDGE" 12784 "GD_ID_SCT_ACTIVATE_DIAGNOSTICS" 12788 "GD_ID_SCT_SAFETY_VERSION_Status" 12788 "GD_ID_SCT_SAFETY_VERSION" 12789 "GD_ID_SCT_LIB_SAFETY_VERSION" 12792 "GD_ID_SCT_RECIPE_ACCESS_SETPOINT" 12793 "GD_ID_SCT_TI_ACCESS_SETPOINT" 12794 "GD_ID_SCT_TI_ACCESS_STATE" 12795 "GD_ID_SCT_TI_ACCESS_STATE_KL15" 12797 "GD_ID_SCT_TI_SUB_STATE" 12782 "GD_ID_SCT_ErrorManagement_Status" 12782 "GD_ID_SCT_ErrorManagement" 12799 "GD_ID_SCT_LifeMessage" 12800 "GD_ID_Engine_Rpm" 12801 "GD_ID_Engine_Load" 12802 "GD_ID_Engine_Coolant_Temp_Status" 12802 "GD_ID_Engine_Coolant_Temp" 12803 "GD_ID_Engine_Air_Intake_Temp" 12804 "GD_ID_Engine_Battery_Power_Status" 12804 "GD_ID_Engine_Battery_Power" 12805 "GD_ID_Engine_Air_Intake_Pressure" 12806 "GD_ID_Engine_Oil_Pressure" 12807 "GD_ID_Engine_Rpm_Setpoint_Status" 12807 "GD_ID_Engine_Rpm_Setpoint" 12808 "GD_ID_Engine_Standing_Still_Status" 12808 "GD_ID_Engine_Standing_Still" 12809 "GD_ID_Engine_Oil_Pressure_Low_Status" 12809 "GD_ID_Engine_Oil_Pressure_Low" 12810 "GD_ID_Engine_Oil_Service_Interval_Status" 12810 "GD_ID_Engine_Oil_Service_Interval" 12811 "GD_ID_Engine_Hours" 12812 "GD_ID_Engine_Amber_Warning_Lamp_Status" 12812 "GD_ID_Engine_Amber_Warning_Lamp" 12813 "GD_ID_Engine_Red_Stop_Lamp_Status" 12813 "GD_ID_Engine_Red_Stop_Lamp" 12814 "GD_ID_Alt_Low_Idle" 12815 "GD_ID_Engine_Audible_Warning_Status" 12815 "GD_ID_Engine_Audible_Warning" 12816 "GD_ID_Ambient_Temp" 12817 "GD_ID_Ecu_Temp" 12820 "GD_ID_Fuel_Rate" 12821 "GD_ID_Trip_Fuel" 12822 "GD_ID_Trip_DEF" 12823 "GD_ID_DEF_Level" 12824 "GD_ID_Water_In_Fuel_Status" 12824 "GD_ID_Water_In_Fuel" 12825 "GD_ID_Engine_Malfunction_Lamp_Status" 12825 "GD_ID_Engine_Malfunction_Lamp" 12826 "GD_ID_DEF_Level_Warning_Status" 12826 "GD_ID_DEF_Level_Warning" 12827 "GD_ID_Engine_WaitToStart_Status" 12827 "GD_ID_Engine_WaitToStart" 12828 "GD_ID_Engine_Operating_State" 12829 "GD_ID_Engine_Start_Enable_Status" 12829 "GD_ID_Engine_Start_Enable" 12830 "GD_ID_Implement_Transport_State_Status" 12830 "GD_ID_Implement_Transport_State" 12831 "GD_ID_Implement_Work_State_Status" 12831 "GD_ID_Implement_Work_State" 12832 "GD_ID_Implement_Actual_Working_Width" 12833 "GD_ID_Implement_Actual_Flow" 12834 "GD_ID_Implement_ReadyForFieldWork_Status" 12834 "GD_ID_Implement_ReadyForFieldWork" 12840 "GD_ID_WheelBasedDistance_km" 12841 "GD_ID_WheelBasedDistance_m" 12842 "GD_ID_GroundBasedDistance_km" 12843 "GD_ID_GroundBasedDistance_m" 12844 "GD_ID_SelectedSpeedDistance_km" 12845 "GD_ID_SelectedSpeedDistance_m" 12846 "GD_ID_MachineSelectedSpeed" 12847 "GD_ID_WBZ_MACHINE_SELECTED_SOURCE" 12848 "GD_ID_WBZ_MAX_ENG_RPM" 12850 "GD_ID_Working_Time_SecMin_VD" 12851 "GD_ID_Working_Time_Hours_VD" 12852 "GD_ID_Worked_Area_Ha_VD" 12853 "GD_ID_Worked_Area_0001Ha_VD" 12854 "GD_ID_Used_Fuel_VD" 12855 "GD_ID_Remaining_Time_SecMin_VD" 12856 "GD_ID_Remaining_Time_Hours_VD" 12857 "GD_ID_Remaining_Area_Ha_VD" 12858 "GD_ID_Remaining_Area_0001Ha_VD" 12859 "GD_ID_Required_Fuel_VD" 12860 "GD_ID_Field_Size_Ha_VD" 12861 "GD_ID_Field_Size_0001Ha_VD" 12862 "GD_ID_Reset_VD_Status" 12862 "GD_ID_Reset_VD" 12870 "GD_Iso_IsoState_state_RW" 12871 "GD_ID_WBZ_TERMINAL_PAGE_SIZE" 12878 "GD_ID_WBZ_ENG_DEF_LVL_LAMP_Status" 12878 "GD_ID_WBZ_ENG_DEF_LVL_LAMP" 12879 "GD_ID_WBZ_ENG_DEF_MIL_LAMP_Status" 12879 "GD_ID_WBZ_ENG_DEF_MIL_LAMP" 12880 "GD_ID_IgnitionState_Status" 12880 "GD_ID_IgnitionState" 12881 "GD_ID_WBZ_ENG_FAN_RPM" 12882 "GD_ID_WBZ_ENG_FUEL_TEMP" 12883 "GD_ID_WBZ_ENG_AUXIO1_01" 12884 "GD_ID_WBZ_ENG_FAN_DUTY_CYCLE" 12885 "GD_ID_WBZ_DEF_TEMP" 12886 "GD_ID_WBZ_EXHAUST_TEMP" 12887 "GD_ID_WBZ_FUEL_PRESSURE" 12888 "GD_ID_WBZ_CURVATURE_SETPOINT" 12889 "GD_ID_WBZ_CURVATURE_ENABLE_Status" 12889 "GD_ID_WBZ_CURVATURE_ENABLE" 12890 "GD_ID_WBZ_ENG_START_CMD_Status" 12890 "GD_ID_WBZ_ENG_START_CMD" 12891 "GD_ID_WBZ_THIRD_PARTY_MANUS_Status" 12891 "GD_ID_WBZ_THIRD_PARTY_MANUS" 12892 "GD_ID_WBZ_NEW_LEADER_ACL_Status" 12892 "GD_ID_WBZ_NEW_LEADER_ACL" 12901 "GD_ID_WBZ_AUXIO1_01_FI02" 12902 "GD_ID_WBZ_AUXIO1_02_FI02" 12903 "GD_ID_WBZ_AUXIO1_03_FI02" 12904 "GD_ID_WBZ_AUXIO1_04_FI02" 12905 "GD_ID_WBZ_AUXIO1_05_FI02" 12906 "GD_ID_WBZ_AUXIO1_06_FI02" 12907 "GD_ID_WBZ_AUXIO1_07_FI02" 12908 "GD_ID_WBZ_AUXIO1_08_FI02" 12909 "GD_ID_WBZ_AUXIO1_09_FI02" 12910 "GD_ID_WBZ_AUXIO1_10_FI02" 12911 "GD_ID_WBZ_AUXIO1_11_FI02" 12912 "GD_ID_WBZ_AUXIO1_12_FI02" 12917 "GD_ID_WBZ_AUXIO2_17_FI02" 12918 "GD_ID_WBZ_AUXIO2_18_FI02" 12919 "GD_ID_WBZ_AUXIO1_01_FI00" 12920 "GD_ID_WBZ_AUXIO1_02_FI00" 12921 "GD_ID_WBZ_AUXIO1_03_FI00" 12922 "GD_ID_WBZ_AUXIO1_04_FI00" 12923 "GD_ID_WBZ_AUXIO1_05_FI00" 12924 "GD_ID_WBZ_AUXIO1_06_FI00" 12925 "GD_ID_WBZ_AUXIO1_07_FI00" 12926 "GD_ID_WBZ_AUXIO1_08_FI00" 12927 "GD_ID_WBZ_AUXIO1_09_FI00" 12928 "GD_ID_WBZ_AUXIO1_10_FI00" 12929 "GD_ID_WBZ_AUXIO1_11_FI00" 12930 "GD_ID_WBZ_AUXIO1_12_FI00" 12931 "GD_ID_WBZ_AUXIO1_13_FI00" 12932 "GD_ID_WBZ_AUXIO1_14_FI00" 12933 "GD_ID_WBZ_AUXIO1_15_FI00" 12934 "GD_ID_WBZ_AUXIO1_16_FI00" 12935 "GD_ID_WBZ_AUXIO1_CH2" 12936 "GD_ID_WBZ_AUXIO2_17_FI00" 12937 "GD_ID_WBZ_AUXIO2_18_FI00" 12940 "GD_ID_WBZ_AUXIO2_21_FI00" 12941 "GD_ID_WBZ_AUXIO2_22_FI00" 12945 "GD_ID_WBZ_AUXIO2_26_FI00" 12946 "GD_ID_WBZ_AUXIO2_27_FI00" 12947 "GD_ID_WBZ_AUXIO2_28_FI00" 12948 "GD_ID_WBZ_AUXIO2_29_FI00" 12949 "GD_ID_WBZ_AUXIO2_30_FI00" 12950 "GD_ID_WBZ_AUXIO2_31_FI00" 12951 "GD_ID_WBZ_AUXIO2_32_FI00" 12952 "GD_ID_WBZ_AUXIO1_01_FI01" 12953 "GD_ID_WBZ_AUXIO1_02_FI01" 12954 "GD_ID_WBZ_AUXIO1_03_FI01" 12955 "GD_ID_WBZ_AUXIO1_04_FI01" 12956 "GD_ID_WBZ_AUXIO1_05_FI01" 12957 "GD_ID_WBZ_AUXIO1_06_FI01" 12958 "GD_ID_WBZ_AUXIO1_07_FI01" 12959 "GD_ID_WBZ_AUXIO1_08_FI01" 12960 "GD_ID_WBZ_AUXIO1_09_FI01" 12961 "GD_ID_WBZ_AUXIO1_10_FI01" 12962 "GD_ID_WBZ_AUXIO1_11_FI01" 12963 "GD_ID_WBZ_AUXIO1_12_FI01" 12964 "GD_ID_WBZ_AUXIO1_13_FI01" 12965 "GD_ID_WBZ_AUXIO1_14_FI01" 12966 "GD_ID_WBZ_AUXIO1_15_FI01" 12967 "GD_ID_WBZ_AUXIO1_16_FI01" 12969 "GD_ID_WBZ_AUXIO2_17_FI01" 12970 "GD_ID_WBZ_AUXIO2_18_FI01" 12973 "GD_ID_WBZ_AUXIO2_21_FI01" 12974 "GD_ID_WBZ_AUXIO2_22_FI01" 12978 "GD_ID_WBZ_AUXIO2_26_FI01" 12979 "GD_ID_WBZ_AUXIO2_27_FI01" 12980 "GD_ID_WBZ_AUXIO2_28_FI01" 12981 "GD_ID_WBZ_AUXIO2_29_FI01" 12982 "GD_ID_WBZ_AUXIO2_30_FI01" 12983 "GD_ID_WBZ_AUXIO2_31_FI01" 12984 "GD_ID_WBZ_AUXIO2_32_FI01" 12985 "GD_ID_WBZ_AUXIO2_21_FI02" 12986 "GD_ID_WBZ_AUXIO2_22_FI02" 13000 "GD_ID_WBZ_TI_ACCESS" 13052 "GD_ID_Unknown_Engine_Error_Part1" 13053 "GD_ID_Unknown_Engine_Error_Part2" 13120 "GD_ID_WBZ_DPF_WARNING_LAMP_Status" 13120 "GD_ID_WBZ_DPF_WARNING_LAMP" 13121 "GD_ID_WBZ_DPF_HEST_LAMP_Status" 13121 "GD_ID_WBZ_DPF_HEST_LAMP" 13123 "GD_ID_WBZ_DPF_SOOT_ASH" 13124 "GD_ID_WBZ_DPF_HOURS_SINCE_REGEN" 13125 "GD_ID_WBZ_DPF_MINUTES_SINCE_REGEN" 13126 "GD_ID_WBZ_DPF_STATI" 13128 "GD_ID_WBZ_DPF_INHIBITED_STATI" 13129 "GD_ID_WBZ_DPF_CONTROL_REGEN" 13130 "GD_ID_WBZ_DPF_ENABLE_REGEN_Status" 13130 "GD_ID_WBZ_DPF_ENABLE_REGEN" 13294 "GD_ID_WBZ_ErrorManagement_Status" 13294 "GD_ID_WBZ_ErrorManagement" 13311 "GD_ID_WBZ_LifeMessage" 13824 "GD_ID_Current_Track_Width" 13825 "GD_ID_TA_Min_Track_Width" 13826 "GD_ID_Max_Track_Width" 13827 "GD_ID_Calib_State_Track_Width_Status" 13827 "GD_ID_Calib_State_Track_Width" 13828 "GD_ID_TA_Front_Axle_Width" 13829 "GD_ID_TA_Front_Track_Width" 13830 "GD_ID_TA_Rear_Axle_Width" 13831 "GD_ID_TA_Rear_Track_Width" 13832 "GD_ID_Track_Adjust_Errors_Status" 13832 "GD_ID_Track_Adjust_Errors" 13833 "GD_ID_TA_Calibration_Command" 13834 "GD_ID_TA_Calibration_State" 13835 "GD_ID_TA_MANUAL_IN_Status" 13835 "GD_ID_TA_MANUAL_IN" 13836 "GD_ID_TA_MANUAL_OUT_Status" 13836 "GD_ID_TA_MANUAL_OUT" 13839 "GD_ID_TA_Actual_Front_In_R_Status" 13839 "GD_ID_TA_Actual_Front_In_R" 13840 "GD_ID_TA_Actual_Front_Out_R_Status" 13840 "GD_ID_TA_Actual_Front_Out_R" 13841 "GD_ID_TA_Actual_Rear_In_R_Status" 13841 "GD_ID_TA_Actual_Rear_In_R" 13842 "GD_ID_TA_Actual_Rear_Out_R_Status" 13842 "GD_ID_TA_Actual_Rear_Out_R" 13843 "GD_ID_TA_Actual_Front_In_Status" 13843 "GD_ID_TA_Actual_Front_In" 13844 "GD_ID_TA_Actual_Front_Out_Status" 13844 "GD_ID_TA_Actual_Front_Out" 13845 "GD_ID_TA_Actual_Rear_In_Status" 13845 "GD_ID_TA_Actual_Rear_In" 13846 "GD_ID_TA_Actual_Rear_Out_Status" 13846 "GD_ID_TA_Actual_Rear_Out" 13847 "GD_ID_Track_Adjust_Equipped_Status" 13847 "GD_ID_Track_Adjust_Equipped" 13848 "GD_ID_TA_Min_Tire_Track_Width" 13849 "GD_ID_Current_Axle_Width" 13850 "GD_ID_TA_Operation_State_Status" 13850 "GD_ID_TA_Operation_State" 13851 "GD_ID_TA_In_Tolerance_Status" 13851 "GD_ID_TA_In_Tolerance" 13852 "GD_ID_TA_Auto_Enable_A_Status" 13852 "GD_ID_TA_Auto_Enable_A" 13853 "GD_ID_TA_Auto_Enable_B_Status" 13853 "GD_ID_TA_Auto_Enable_B" 13854 "GD_ID_TA_Auto_Enable_Dual_Status" 13854 "GD_ID_TA_Auto_Enable_Dual" 13855 "GD_ID_TA_Setpoint_A" 13856 "GD_ID_TA_Setpoint_B" 13857 "GD_ID_TA_Setpoint_Dual_Front" 13858 "GD_ID_TA_Setpoint_Dual_Rear" 13864 "GD_ID_TA_Equipped_Status" 13864 "GD_ID_TA_Equipped" 13874 "GD_ID_TA_FL_POSITION" 13875 "GD_ID_TA_FR_POSITION" 13876 "GD_ID_TA_RL_POSITION" 13877 "GD_ID_TA_RR_POSITION" 13878 "GD_ID_TA_Setpoint_A_Rear_Status" 13878 "GD_ID_TA_Setpoint_A_Rear" 13879 "GD_ID_TA_Setpoint_B_Rear_Status" 13879 "GD_ID_TA_Setpoint_B_Rear" 13880 "GD_ID_TA_TARGET_TRACKWIDTH_FL" 13881 "GD_ID_TA_TARGET_TRACKWIDTH_FR" 13882 "GD_ID_TA_TARGET_TRACKWIDTH_RL" 13883 "GD_ID_TA_TARGET_TRACKWIDTH_RR" 13884 "GD_ID_TA_ADDITIONAL_WIDTH_FL" 13885 "GD_ID_TA_ADDITIONAL_WIDTH_FR" 13886 "GD_ID_TA_ADDITIONAL_WIDTH_RL" 13887 "GD_ID_TA_ADDITIONAL_WIDTH_RR" 14318 "GD_ID_TA_ErrorManagement_Status" 14318 "GD_ID_TA_ErrorManagement" 14335 "GD_ID_TA_LifeMessage" 15872 "GD_ID_EMM_SIGNAL_LN00_ERROR_W_Status" 15872 "GD_ID_EMM_SIGNAL_LN00_ERROR_W" 15873 "GD_ID_EMM_SIGNAL_LN01_ERROR_W_Status" 15873 "GD_ID_EMM_SIGNAL_LN01_ERROR_W" 15874 "GD_ID_EMM_SIGNAL_LN02_ERROR_W_Status" 15874 "GD_ID_EMM_SIGNAL_LN02_ERROR_W" 15875 "GD_ID_EMM_SIGNAL_LN03_ERROR_W_Status" 15875 "GD_ID_EMM_SIGNAL_LN03_ERROR_W" 15876 "GD_ID_EMM_SIGNAL_LN04_ERROR_W_Status" 15876 "GD_ID_EMM_SIGNAL_LN04_ERROR_W" 15877 "GD_ID_EMM_SIGNAL_LN05_ERROR_W_Status" 15877 "GD_ID_EMM_SIGNAL_LN05_ERROR_W" 15878 "GD_ID_EMM_SIGNAL_LN06_ERROR_W_Status" 15878 "GD_ID_EMM_SIGNAL_LN06_ERROR_W" 15879 "GD_ID_EMM_SIGNAL_LN07_ERROR_W_Status" 15879 "GD_ID_EMM_SIGNAL_LN07_ERROR_W" 15880 "GD_ID_EMM_SIGNAL_LN08_ERROR_W_Status" 15880 "GD_ID_EMM_SIGNAL_LN08_ERROR_W" 15881 "GD_ID_EMM_SIGNAL_LN09_ERROR_W_Status" 15881 "GD_ID_EMM_SIGNAL_LN09_ERROR_W" 15882 "GD_ID_EMM_SIGNAL_LN10_ERROR_W_Status" 15882 "GD_ID_EMM_SIGNAL_LN10_ERROR_W" 15883 "GD_ID_EMM_SIGNAL_LN11_ERROR_W_Status" 15883 "GD_ID_EMM_SIGNAL_LN11_ERROR_W" 15884 "GD_ID_EMM_SIGNAL_LN12_ERROR_W_Status" 15884 "GD_ID_EMM_SIGNAL_LN12_ERROR_W" 15885 "GD_ID_EMM_SIGNAL_LN13_ERROR_W_Status" 15885 "GD_ID_EMM_SIGNAL_LN13_ERROR_W" 15886 "GD_ID_EMM_SIGNAL_LN14_ERROR_W_Status" 15886 "GD_ID_EMM_SIGNAL_LN14_ERROR_W" 15887 "GD_ID_EMM_SIGNAL_LN15_ERROR_W_Status" 15887 "GD_ID_EMM_SIGNAL_LN15_ERROR_W" 15888 "GD_ID_EMM_SIGNAL_LN16_ERROR_W_Status" 15888 "GD_ID_EMM_SIGNAL_LN16_ERROR_W" 15889 "GD_ID_EMM_SIGNAL_LN17_ERROR_W_Status" 15889 "GD_ID_EMM_SIGNAL_LN17_ERROR_W" 15890 "GD_ID_EMM_SIGNAL_LN18_ERROR_W_Status" 15890 "GD_ID_EMM_SIGNAL_LN18_ERROR_W" 15891 "GD_ID_EMM_SIGNAL_LN19_ERROR_W_Status" 15891 "GD_ID_EMM_SIGNAL_LN19_ERROR_W" 15892 "GD_ID_EMM_SIGNAL_LN20_ERROR_W_Status" 15892 "GD_ID_EMM_SIGNAL_LN20_ERROR_W" 15893 "GD_ID_EMM_SIGNAL_LN21_ERROR_W_Status" 15893 "GD_ID_EMM_SIGNAL_LN21_ERROR_W" 15894 "GD_ID_EMM_SIGNAL_LN22_ERROR_W_Status" 15894 "GD_ID_EMM_SIGNAL_LN22_ERROR_W" 15895 "GD_ID_EMM_SIGNAL_LN23_ERROR_W_Status" 15895 "GD_ID_EMM_SIGNAL_LN23_ERROR_W" 15896 "GD_ID_EMM_SIGNAL_LN24_ERROR_W_Status" 15896 "GD_ID_EMM_SIGNAL_LN24_ERROR_W" 15897 "GD_ID_EMM_SIGNAL_LN25_ERROR_W_Status" 15897 "GD_ID_EMM_SIGNAL_LN25_ERROR_W" 15898 "GD_ID_EMM_SIGNAL_LN26_ERROR_W_Status" 15898 "GD_ID_EMM_SIGNAL_LN26_ERROR_W" 15899 "GD_ID_EMM_SIGNAL_LN27_ERROR_W_Status" 15899 "GD_ID_EMM_SIGNAL_LN27_ERROR_W" 15900 "GD_ID_EMM_SIGNAL_LN28_ERROR_W_Status" 15900 "GD_ID_EMM_SIGNAL_LN28_ERROR_W" 15901 "GD_ID_EMM_SIGNAL_LN29_ERROR_W_Status" 15901 "GD_ID_EMM_SIGNAL_LN29_ERROR_W" 15902 "GD_ID_EMM_SIGNAL_LN30_ERROR_W_Status" 15902 "GD_ID_EMM_SIGNAL_LN30_ERROR_W" 15903 "GD_ID_EMM_SIGNAL_LN31_ERROR_W_Status" 15903 "GD_ID_EMM_SIGNAL_LN31_ERROR_W" 15904 "GD_ID_EMM_SIGNAL_LN32_ERROR_W_Status" 15904 "GD_ID_EMM_SIGNAL_LN32_ERROR_W" 15905 "GD_ID_EMM_SIGNAL_LN33_ERROR_W_Status" 15905 "GD_ID_EMM_SIGNAL_LN33_ERROR_W" 15906 "GD_ID_EMM_SIGNAL_LN34_ERROR_W_Status" 15906 "GD_ID_EMM_SIGNAL_LN34_ERROR_W" 15907 "GD_ID_EMM_SIGNAL_LN35_ERROR_W_Status" 15907 "GD_ID_EMM_SIGNAL_LN35_ERROR_W" 15908 "GD_ID_EMM_SIGNAL_LN36_ERROR_W_Status" 15908 "GD_ID_EMM_SIGNAL_LN36_ERROR_W" 15909 "GD_ID_EMM_SIGNAL_LN37_ERROR_W_Status" 15909 "GD_ID_EMM_SIGNAL_LN37_ERROR_W" 15910 "GD_ID_EMM_SIGNAL_LN38_ERROR_W_Status" 15910 "GD_ID_EMM_SIGNAL_LN38_ERROR_W" 15911 "GD_ID_EMM_SIGNAL_LN39_ERROR_W_Status" 15911 "GD_ID_EMM_SIGNAL_LN39_ERROR_W" 15912 "GD_ID_EMM_SIGNAL_LN40_ERROR_W_Status" 15912 "GD_ID_EMM_SIGNAL_LN40_ERROR_W" 15913 "GD_ID_EMM_SIGNAL_LN41_ERROR_W_Status" 15913 "GD_ID_EMM_SIGNAL_LN41_ERROR_W" 15914 "GD_ID_EMM_SIGNAL_LN42_ERROR_W_Status" 15914 "GD_ID_EMM_SIGNAL_LN42_ERROR_W" 15915 "GD_ID_EMM_SIGNAL_LN43_ERROR_W_Status" 15915 "GD_ID_EMM_SIGNAL_LN43_ERROR_W" 15916 "GD_ID_EMM_SIGNAL_LN44_ERROR_W_Status" 15916 "GD_ID_EMM_SIGNAL_LN44_ERROR_W" 15917 "GD_ID_EMM_SIGNAL_LN45_ERROR_W_Status" 15917 "GD_ID_EMM_SIGNAL_LN45_ERROR_W" 15918 "GD_ID_EMM_SIGNAL_LN46_ERROR_W_Status" 15918 "GD_ID_EMM_SIGNAL_LN46_ERROR_W" 15919 "GD_ID_EMM_SIGNAL_LN47_ERROR_W_Status" 15919 "GD_ID_EMM_SIGNAL_LN47_ERROR_W" 15920 "GD_ID_EMM_SIGNAL_LN48_ERROR_W_Status" 15920 "GD_ID_EMM_SIGNAL_LN48_ERROR_W" 15921 "GD_ID_EMM_SIGNAL_LN49_ERROR_W_Status" 15921 "GD_ID_EMM_SIGNAL_LN49_ERROR_W" 15922 "GD_ID_EMM_SIGNAL_LN50_ERROR_W_Status" 15922 "GD_ID_EMM_SIGNAL_LN50_ERROR_W" 15923 "GD_ID_EMM_SIGNAL_LN51_ERROR_W_Status" 15923 "GD_ID_EMM_SIGNAL_LN51_ERROR_W" 15924 "GD_ID_EMM_SIGNAL_LN52_ERROR_W_Status" 15924 "GD_ID_EMM_SIGNAL_LN52_ERROR_W" 15925 "GD_ID_EMM_SIGNAL_LN53_ERROR_W_Status" 15925 "GD_ID_EMM_SIGNAL_LN53_ERROR_W" 15926 "GD_ID_EMM_SIGNAL_LN54_ERROR_W_Status" 15926 "GD_ID_EMM_SIGNAL_LN54_ERROR_W" 15927 "GD_ID_EMM_SIGNAL_LN55_ERROR_W_Status" 15927 "GD_ID_EMM_SIGNAL_LN55_ERROR_W" 15928 "GD_ID_EMM_SIGNAL_LN56_ERROR_W_Status" 15928 "GD_ID_EMM_SIGNAL_LN56_ERROR_W" 15929 "GD_ID_EMM_SIGNAL_LN57_ERROR_W_Status" 15929 "GD_ID_EMM_SIGNAL_LN57_ERROR_W" 15930 "GD_ID_EMM_SIGNAL_LN58_ERROR_W_Status" 15930 "GD_ID_EMM_SIGNAL_LN58_ERROR_W" 15931 "GD_ID_EMM_SIGNAL_LN59_ERROR_W_Status" 15931 "GD_ID_EMM_SIGNAL_LN59_ERROR_W" 15932 "GD_ID_EMM_SIGNAL_LN60_ERROR_W_Status" 15932 "GD_ID_EMM_SIGNAL_LN60_ERROR_W" 15933 "GD_ID_EMM_SIGNAL_LN61_ERROR_W_Status" 15933 "GD_ID_EMM_SIGNAL_LN61_ERROR_W" 15934 "GD_ID_EMM_SIGNAL_LN62_ERROR_W_Status" 15934 "GD_ID_EMM_SIGNAL_LN62_ERROR_W" 15935 "GD_ID_EMM_SIGNAL_LN63_ERROR_W_Status" 15935 "GD_ID_EMM_SIGNAL_LN63_ERROR_W" 15938 "GD_ID_EMM_TERMINAL_TRANSFER_R_Status" 15938 "GD_ID_EMM_TERMINAL_TRANSFER_R" 15939 "GD_ID_EMM_ACM_TRANSFER_R_Status" 15939 "GD_ID_EMM_ACM_TRANSFER_R" 15970 "GD_ID_EMM_TERMINAL_ACKNOWLEDGE_W_Status" 15970 "GD_ID_EMM_TERMINAL_ACKNOWLEDGE_W" 16000 "GD_ID_EMM_REQUEST_ENVVAR_W" 16001 "GD_ID_EMM_ENV_VAR_VALUE1" 16002 "GD_ID_EMM_ENV_VAR_VALUE2" 16003 "GD_ID_EMM_ENV_VAR_VALUE3" 16004 "GD_ID_EMM_ENV_VAR_VALUE4" 16005 "GD_ID_EMM_ENV_VAR_VALUE5" 16006 "GD_ID_EMM_ENV_VAR_OPERATING_HOUR" 16007 "GD_ID_EMM_ENV_VAR_ERROR_COUNTER" 16008 "GD_ID_EMM_ENV_VAR_DATE1" 16009 "GD_ID_EMM_ENV_VAR_DATE2" 16010 "GD_ID_EMM_ENV_VAR_TIME1" 16011 "GD_ID_EMM_ENV_VAR_TIME2" 16012 "GD_ID_EMM_ENV_VAR_STATUS" 16127 "GD_ID_EMM_DEBUG_SET_RESET_ERROR" 16128 "GD_ID_EMM_STATUS_R" 16172 "GD_ID_EMM_ERR_LOG_DELETED_Status" 16172 "GD_ID_EMM_ERR_LOG_DELETED" 16222 "GD_ID_EMM_ERR_ACTIVE_Status" 16222 "GD_ID_EMM_ERR_ACTIVE" 16366 "GD_ID_EMM_ErrorManagement_Status" 16366 "GD_ID_EMM_ErrorManagement" 16383 "GD_ID_EMM_LifeMessage" 28161 "GD_ID_4WS_REQUESTED_MODE" 28162 "GD_ID_4WS_CURRENT_MODE" 28166 "GD_ID_4WS_JOG_LEFT_Status" 28166 "GD_ID_4WS_JOG_LEFT" 28167 "GD_ID_4WS_JOG_RIGHT_Status" 28167 "GD_ID_4WS_JOG_RIGHT" 28168 "GD_ID_4WS_JOG_CLEAR_Status" 28168 "GD_ID_4WS_JOG_CLEAR" 28169 "GD_ID_4WS_JOG_ANGLE_Status" 28169 "GD_ID_4WS_JOG_ANGLE" 28175 "GD_ID_4WS_UI_FRONT_ANGLE_Status" 28175 "GD_ID_4WS_UI_FRONT_ANGLE" 28176 "GD_ID_4WS_UI_REAR_ANGLE_Status" 28176 "GD_ID_4WS_UI_REAR_ANGLE" 28178 "GD_ID_4WS_MACHINE_REAR_ANGLE" 28179 "GD_ID_4WS_REAR_ANGLE_SETPOINT" 28180 "GD_ID_4WS_REAR_ANGLE_SENSOR_VALUE" 28183 "GD_ID_4WS_CURRENT_CONTROL_KP_Status" 28183 "GD_ID_4WS_CURRENT_CONTROL_KP" 28184 "GD_ID_4WS_CURRENT_CONTROL_KI_Status" 28184 "GD_ID_4WS_CURRENT_CONTROL_KI" 28185 "GD_ID_4WS_REAR_ANGLE_TARGET_Status" 28185 "GD_ID_4WS_REAR_ANGLE_TARGET" 28186 "GD_ID_4WS_LEFT_PWM_Status" 28186 "GD_ID_4WS_LEFT_PWM" 28187 "GD_ID_4WS_RIGHT_PWM_Status" 28187 "GD_ID_4WS_RIGHT_PWM" 28191 "GD_ID_4WS_RIGHT_VALVE_COIL_CURRENT" 28192 "GD_ID_4WS_LEFT_VALVE_COIL_CURRENT" 28193 "GD_ID_4WS_ANGLE_CONTROL_KP_Status" 28193 "GD_ID_4WS_ANGLE_CONTROL_KP" 28194 "GD_ID_4WS_ANGLE_CONTROL_KI_Status" 28194 "GD_ID_4WS_ANGLE_CONTROL_KI" 28195 "GD_ID_4WS_TARGET_CURRENT_Status" 28195 "GD_ID_4WS_TARGET_CURRENT" 28196 "GD_ID_4WS_CURRENT_CONTROL_KC_Status" 28196 "GD_ID_4WS_CURRENT_CONTROL_KC" 28201 "GD_ID_4WS_COMMAND_CURRENT_Status" 28201 "GD_ID_4WS_COMMAND_CURRENT" 28202 "GD_ID_4WS_ACTIVE_CURRENT_LOOP" 28203 "GD_ID_4WS_UNFILTERED_REAR_ANGLE_Status" 28203 "GD_ID_4WS_UNFILTERED_REAR_ANGLE" 28210 "GD_ID_4WS_START_CURRENT_CALIB_COMMAND" 28211 "GD_ID_4WS_START_CURRENT_CALIB_STATUS" 28260 "GD_ID_4WS_REAR_ANGLE_CALIB_COMMAND" 28261 "GD_ID_4WS_REAR_ANGLE_CALIB_STATUS" 28654 "GD_ID_4WS_ErrorManagement_Status" 28654 "GD_ID_4WS_ErrorManagement" 28671 "GD_ID_4WS_LifeMessage" 6638 "GD_ID_DIAGNOSE_ErrorManagement_Status" 6638 "GD_ID_DIAGNOSE_ErrorManagement" 6655 "GD_ID_DIAGNOSE_LifeMessage" 16384 "GD_ID_CEAG_FIELD_HEADLAND_WIDTH_RW" 16385 "GD_ID_CEAG_FIELD_HEADLAND_DISTANCE_RW" 16400 "GD_ID_CEAG_IMPLEMENT_PATHTOPATHDISTANCE_RW" 16402 "GD_ID_CEAG_IMPLEMENT_LINKAGETYPE_RW" 16403 "GD_ID_CEAG_IMPLEMENT_LINKAGEFRONT_RW" 16404 "GD_ID_CEAG_IMPLEMENT_LINKAGEREAR_RW" 16405 "GD_ID_CEAG_IMPLEMENT_MINIMUMRADIUS_RW" 16406 "GD_ID_CEAG_IMPLEMENT_OFFSET_SETOFFSET_RW" 16407 "GD_ID_CEAG_IMPLEMENT_OFFSET_SETWORKINGWIDTH_RW" 16408 "GD_ID_CEAG_IMPLEMENT_OFFSET_STATUS_RW" 16416 "GD_ID_CEAG_COMMUNICATION_COMMAND_W" 16417 "GD_ID_CEAG_COMMUNICATION_COMMAND_STATUS_R" 16432 "GD_ID_CEAG_PATH_DATA_BLKRW" 16435 "GD_ID_CEAG_PATH_AB_ANGLE_RW" 16436 "GD_ID_CEAG_PATH_AB_DISTANCE_R" 16439 "GD_ID_CEAG_PATH_PIVOT_CENTERPOINT_ACCURACY_R" 16441 "GD_ID_CEAG_PATH_SEGMENT_ACTUAL_R" 16442 "GD_ID_CEAG_PATH_NUMBER_ACTUAL_R" 16443 "GD_ID_CEAG_PATH_LP_SLOPE_RW_Status" 16443 "GD_ID_CEAG_PATH_LP_SLOPE_RW" 16444 "GD_ID_CEAG_PATH_DATA_ACKNOWLEDGE_R_Status" 16444 "GD_ID_CEAG_PATH_DATA_ACKNOWLEDGE_R" 16448 "GD_ID_CEAG_NUDGEOFFSET_MANUAL_RW" 16449 "GD_ID_CEAG_NUDGEOFFSET_TOTAL_R_Status" 16449 "GD_ID_CEAG_NUDGEOFFSET_TOTAL_R" 16450 "GD_ID_CEAG_OFFSET_NORTH" 16451 "GD_ID_CEAG_OFFSET_EAST" 16464 "GD_ID_CEAG_AUTOTURN_SETTINGS_RW" 16465 "GD_ID_CEAG_AUTOTURN_DIMENSIONS_R" 16466 "GD_ID_CEAG_AUTOTURN_STATUS_R" 16471 "GD_ID_CEAG_STATUSPAGE_POSITION_GNSS_R_Status" 16471 "GD_ID_CEAG_STATUSPAGE_POSITION_GNSS_R" 16472 "GD_ID_CEAG_STATUSPAGE_CORRECTION_R_Status" 16472 "GD_ID_CEAG_STATUSPAGE_CORRECTION_R" 16473 "GD_ID_CEAG_STATUSPAGE_INERTIAL_R_Status" 16473 "GD_ID_CEAG_STATUSPAGE_INERTIAL_R" 16474 "GD_ID_CEAG_STATUSPAGE_STEERING_SUBSYSTEM_R_Status" 16474 "GD_ID_CEAG_STATUSPAGE_STEERING_SUBSYSTEM_R" 16475 "GD_ID_CEAG_STATUSPAGE_XTRK_R_Status" 16475 "GD_ID_CEAG_STATUSPAGE_XTRK_R" 16476 "GD_ID_CEAG_STATUSPAGE_HEADINGTOWAYLINE_R_Status" 16476 "GD_ID_CEAG_STATUSPAGE_HEADINGTOWAYLINE_R" 16477 "GD_ID_CEAG_STATUSPAGE_VELOCITY_R_Status" 16477 "GD_ID_CEAG_STATUSPAGE_VELOCITY_R" 16478 "GD_ID_CEAG_STATUSPAGE_CALIBRATION_R_Status" 16478 "GD_ID_CEAG_STATUSPAGE_CALIBRATION_R" 16479 "GD_ID_CEAG_STATUSPAGE_SYSTEM_R_Status" 16479 "GD_ID_CEAG_STATUSPAGE_SYSTEM_R" 16480 "GD_ID_CEAG_STATUS_XTRK_R_Status" 16480 "GD_ID_CEAG_STATUS_XTRK_R" 16481 "GD_ID_CEAG_STATUS_HEADING_R" 16482 "GD_ID_CEAG_STATUS_STEERING_R" 16483 "GD_ID_CEAG_STEERING_SENSITIVITY_LINEACQUISITION_RW" 16484 "GD_ID_CEAG_STEERING_SENSITIVITY_ONLINE_RW" 16485 "GD_ID_CEAG_SYSTEM_STANDBYTIME_RW" 16486 "GD_ID_CEAG_SYSTEM_POWERSUPPLY_INPUT_R" 16487 "GD_ID_CEAG_SYSTEM_POWERSUPPLY_OUTPUT_R" 16488 "GD_ID_CEAG_SYSTEM_ALTITUDE_GEOIDAL_SEPARATION_R" 16489 "GD_ID_CEAG_STEERING_DISENGAGE_REASON_R" 16496 "GD_ID_CEAG_GNSS_GPS_SATVISIBLE_R" 16497 "GD_ID_CEAG_GNSS_GPS_SATUSED_R" 16498 "GD_ID_CEAG_GNSS_GLONASS_SATVISIBLE_R" 16499 "GD_ID_CEAG_GNSS_GLONASS_SATUSED_R" 16500 "GD_ID_CEAG_GNSS_GALILEO_SATVISIBLE_R" 16501 "GD_ID_CEAG_GNSS_GALILEO_SATUSED_R" 16503 "GD_ID_CEAG_GNSS_VALIDPOSITION_R_Status" 16503 "GD_ID_CEAG_GNSS_VALIDPOSITION_R" 16504 "GD_ID_CEAG_GNSS_POSITION_ACTUAL_BLKR" 16505 "GD_ID_CEAG_GNSS_DOP_R" 16506 "GD_ID_CEAG_GNSS_TIME_HOURMINUTE_R" 16507 "GD_ID_CEAG_GNSS_TIME_SECOND_R" 16508 "GD_ID_CEAG_GNSS_ANTENNA_INSTALLATION_RW_Status" 16508 "GD_ID_CEAG_GNSS_ANTENNA_INSTALLATION_RW" 16509 "GD_ID_CEAG_GNSS_VELOCITY_R" 16510 "GD_ID_CEAG_GNSS_DISTANCE_R" 16519 "GD_ID_CEAG_CORRECTIONSIGNAL_RTKNETWORK_ROAMING_RW_Status" 16519 "GD_ID_CEAG_CORRECTIONSIGNAL_RTKNETWORK_ROAMING_RW" 16520 "GD_ID_CEAG_CORRECTIONSIGNAL_RTK_DUHF2_CHANNELSPACING_RW" 16521 "GD_ID_CEAG_CORRECTIONSIGNAL_RTK_DUHF2_PROTOCOL_RW" 16522 "GD_ID_CEAG_CORRECTIONSIGNAL_RTK_DUHF2_ERRORCORRECTION_RW" 16523 "GD_ID_CEAG_CORRECTIONSIGNAL_RTK_FH915_CHANNEL_RW" 16524 "GD_ID_CEAG_CORRECTIONSIGNAL_RTK_FH915_LOCATION_RW" 16525 "GD_ID_CEAG_CORRECTIONSIGNAL_RTK_FH915_NETWORKID_RW" 16526 "GD_ID_CEAG_CORRECTIONSIGNAL_OMNISTAR_FREQUENCY_HIGH_RW" 16527 "GD_ID_CEAG_CORRECTIONSIGNAL_OMNISTAR_FREQUENCY_LOW_RW" 16528 "GD_ID_CEAG_CORRECTIONSIGNAL_TYPE_SELECTED_RW" 16529 "GD_ID_CEAG_CORRECTIONSIGNAL_OMNISTAR_BAUDRATE_RW" 16530 "GD_ID_CEAG_CORRECTIONSIGNAL_VBS_EXPIRYDATE_DAYMONTH_R" 16531 "GD_ID_CEAG_CORRECTIONSIGNAL_BARGRAPH_R" 16532 "GD_ID_CEAG_CORRECTIONSIGNAL_VBS_EXPIRYDATE_YEAR_R" 16533 "GD_ID_CEAG_CORRECTIONSIGNAL_HP_XP_EXPIRYDATE_DAYMONTH_R" 16535 "GD_ID_CEAG_CORRECTIONSIGNAL_HP_XP_EXPIRYDATE_YEAR_R" 16536 "GD_ID_CEAG_CORRECTIONSIGNAL_STATUS_R_Status" 16536 "GD_ID_CEAG_CORRECTIONSIGNAL_STATUS_R" 16537 "GD_ID_CEAG_CORRECTIONSIGNAL_OMNISTAR_SERIALNUMBER_HIGH_R" 16538 "GD_ID_CEAG_CORRECTIONSIGNAL_OMNISTAR_SERIALNUMBER_LOW_R" 16539 "GD_ID_CEAG_CORRECTIONSIGNAL_RTK_AGCO_CHANNEL_RW" 16540 "GD_ID_CEAG_CORRECTIONSIGNAL_RTK_AGCO_FREQUENCY_HIGH_R" 16541 "GD_ID_CEAG_CORRECTIONSIGNAL_RTK_AGCO_FREQUENCY_LOW_R" 16542 "GD_ID_CEAG_CORRECTIONSIGNAL_RTK_AGCO_RADIOTYPE_R" 16543 "GD_ID_CEAG_CORRECTIONSIGNAL_RTK_EXTERNAL_SERIALINTERFACE_RW" 16544 "GD_ID_CEAG_CORRECTIONSIGNAL_RTK_RADIOINSTALLATION_RW_Status" 16544 "GD_ID_CEAG_CORRECTIONSIGNAL_RTK_RADIOINSTALLATION_RW" 16545 "GD_ID_CEAG_CORRECTIONSIGNAL_RTK_AGCO_CORRECTIONFORMAT_RW" 16546 "GD_ID_CEAG_CORRECTIONSIGNAL_RTK_EXTERNAL_CORRECTIONFORMAT_RW" 16547 "GD_ID_CEAG_CORRECTIONSIGNAL_RTK_GPS_SATVISIBLE_R" 16548 "GD_ID_CEAG_CORRECTIONSIGNAL_RTK_GPS_SATUSED_R" 16549 "GD_ID_CEAG_CORRECTIONSIGNAL_RTK_GLONASS_SATVISIBLE_R" 16550 "GD_ID_CEAG_CORRECTIONSIGNAL_RTK_GLONASS_SATUSED_R" 16551 "GD_ID_CEAG_CORRECTIONSIGNAL_RTK_GALILEO_SATVISIBLE_R" 16552 "GD_ID_CEAG_CORRECTIONSIGNAL_RTK_GALILEO_SATUSED_R" 16553 "GD_ID_CEAG_CORRECTIONSIGNAL_RTK_RADIO_CONFIGURABLE_R" 16554 "GD_ID_CEAG_CORRECTIONSIGNAL_RTK_BASELINE_R" 16555 "GD_ID_CEAG_CORRECTIONSIGNAL_SIGNALLAG_R" 16556 "GD_ID_CEAG_CORRECTIONSIGNAL_FALLBACK_RW_Status" 16556 "GD_ID_CEAG_CORRECTIONSIGNAL_FALLBACK_RW" 16557 "GD_ID_CEAG_CORRECTIONSIGNAL_ACCURACY_GNSSANTENNA_R" 16558 "GD_ID_CEAG_CORRECTIONSIGNAL_ACCURACY_VEHICLEREFERENCEPOINT_R" 16559 "GD_ID_CEAG_CORRECTIONSIGNAL_AUTHORISATIONLEVEL_R" 16560 "GD_ID_CEAG_CORRECTIONSIGNAL_RTKNETWORK_GSM_NUMBER_BLKRW" 16561 "GD_ID_CEAG_CORRECTIONSIGNAL_RTKNETWORK_GSM_PIN_BLKRW" 16562 "GD_ID_CEAG_CORRECTIONSIGNAL_RTKNETWORK_CORRECTIONFORMAT_RW_Status" 16562 "GD_ID_CEAG_CORRECTIONSIGNAL_RTKNETWORK_CORRECTIONFORMAT_RW" 16563 "GD_ID_CEAG_CORRECTIONSIGNAL_RTKNETWORK_GPRS_ACCESSPOINT_BLKRW" 16564 "GD_ID_CEAG_CORRECTIONSIGNAL_RTKNETWORK_GPRS_IPADDRESS_BLKRW" 16565 "GD_ID_CEAG_CORRECTIONSIGNAL_RTKNETWORK_GPRS_PORT_BLKRW" 16566 "GD_ID_CEAG_CORRECTIONSIGNAL_RTKNETWORK_GPRS_MOUNTPOINT_BLKRW" 16567 "GD_ID_CEAG_CORRECTIONSIGNAL_RTKNETWORK_GPRS_USERNAME_CONNECTIONPOVIDER_BLKRW" 16568 "GD_ID_CEAG_CORRECTIONSIGNAL_RTKNETWORK_GPRS_PASSWORD_CONNECTIONPROVIDER_BLKRW" 16569 "GD_ID_CEAG_CORRECTIONSIGNAL_RTKNETWORK_NMEA_DATA_RW" 16570 "GD_ID_CEAG_CORRECTIONSIGNAL_TYPE_ACTUAL_R" 16571 "GD_ID_CEAG_CORRECTIONSIGNAL_RTKNETWORK_GPRS_USERNAME_SIGNALPROVIDER_BLKRW" 16572 "GD_ID_CEAG_CORRECTIONSIGNAL_RTKNETWORK_GPRS_PASSWORD_SIGNALPROVIDER_BLKRW" 16573 "GD_ID_CEAG_CORRECTIONSIGNAL_RTKNETWORK_GSM_GPRS_CONNECTION_RW_Status" 16573 "GD_ID_CEAG_CORRECTIONSIGNAL_RTKNETWORK_GSM_GPRS_CONNECTION_RW" 16574 "GD_ID_CEAG_CORRECTIONSIGNAL_RTKNETWORK_GPRS_PIN_BLKRW" 16575 "GD_ID_CEAG_CORRECTIONSIGNAL_RTKNETWORK_MODE_RW_Status" 16575 "GD_ID_CEAG_CORRECTIONSIGNAL_RTKNETWORK_MODE_RW" 16576 "GD_ID_CEAG_NMEA_SERIALINTERFACE_RW" 16579 "GD_ID_CEAG_NMEA_DATA_1_RW" 16580 "GD_ID_CEAG_NMEA_DATA_2_RW" 16581 "GD_ID_CEAG_NMEA_DATA_3_RW" 16582 "GD_ID_CEAG_NMEA_DATA_4_RW" 16583 "GD_ID_CEAG_NMEA_DATA_5_RW" 16584 "GD_ID_CEAG_NMEA_OUTPUT_RW" 16606 "GD_ID_CEAG_SENSOR_IMU_ROLL_R_Status" 16606 "GD_ID_CEAG_SENSOR_IMU_ROLL_R" 16607 "GD_ID_CEAG_SENSOR_IMU_PITCH_R_Status" 16607 "GD_ID_CEAG_SENSOR_IMU_PITCH_R" 16608 "GD_ID_CEAG_SENSOR_IMU_YAW_R_Status" 16608 "GD_ID_CEAG_SENSOR_IMU_YAW_R" 16609 "GD_ID_CEAG_SENSOR_IMU_MOUNTINGBIAS_R_Status" 16609 "GD_ID_CEAG_SENSOR_IMU_MOUNTINGBIAS_R" 16610 "GD_ID_CEAG_SENSOR_IMU_DHEADING_R" 16611 "GD_ID_CEAG_SENSOR_IMU_WARMING_TIME_R_Status" 16611 "GD_ID_CEAG_SENSOR_IMU_WARMING_TIME_R" 16612 "GD_ID_CEAG_SENSOR_IMU_CALIBRATION_TIME_R_Status" 16612 "GD_ID_CEAG_SENSOR_IMU_CALIBRATION_TIME_R" 16613 "GD_ID_CEAG_ID_FA_KALIB_IMU_SET_R" 16614 "GD_ID_CEAG_ID_FA_KALIB_IMU_GET_W" 16639 "GD_ID_CEAG_ID_GNSS_ANTENNA_TYPE_R" 16640 "GD_ID_CEAG_ID_GNSS_ANTENNA_MODEL_BLKR" 16641 "GD_ID_CEAG_ID_GNSS_ANTENNA_PSN_BLKR" 16642 "GD_ID_CEAG_ID_GNSS_ANTENNA_HWVERSION_BLKR" 16643 "GD_ID_CEAG_ID_GNSS_ANTENNA_SWVERSION_BLKR" 16644 "GD_ID_CEAG_ID_GNSS_ANTENNA_BOOTVERSION_BLKR" 16645 "GD_ID_CEAG_ID_GNSS_ANTENNA_COMPILE_DATE_BLKR" 16646 "GD_ID_CEAG_ID_GNSS_ANTENNA_AUTHCODE_BLKW" 16650 "GD_ID_CEAG_ID_CORRECTIONSIGNAL_NTRIP_DELAY_R" 16878 "GD_ID_CEAG_ErrorManagement_Status" 16878 "GD_ID_CEAG_ErrorManagement" 16895 "GD_ID_CEAG_LifeMessage" 27648 "GD_ID_HC_TARGET_STATE_Status" 27648 "GD_ID_HC_TARGET_STATE" 27649 "GD_ID_HC_MACHINE_STATE_Status" 27649 "GD_ID_HC_MACHINE_STATE" 27650 "GD_ID_HC_LEG_STATE_FRONTLEFT" 27651 "GD_ID_HC_LEG_STATE_FRONTRIGHT" 27652 "GD_ID_HC_LEG_STATE_REARLEFT" 27653 "GD_ID_HC_LEG_STATE_REARRIGHT" 27654 "GD_ID_HC_TARGET_CLEARANCE_FL" 27655 "GD_ID_HC_TARGET_CLEARANCE_FR" 27656 "GD_ID_HC_TARGET_CLEARANCE_RL" 27657 "GD_ID_HC_TARGET_CLEARANCE_RR" 27658 "GD_ID_HC_ACTUAL_CLEARANCE_FL_Status" 27658 "GD_ID_HC_ACTUAL_CLEARANCE_FL" 27659 "GD_ID_HC_ACTUAL_CLEARANCE_FR_Status" 27659 "GD_ID_HC_ACTUAL_CLEARANCE_FR" 27660 "GD_ID_HC_ACTUAL_CLEARANCE_RL_Status" 27660 "GD_ID_HC_ACTUAL_CLEARANCE_RL" 27661 "GD_ID_HC_ACTUAL_CLEARANCE_RR_Status" 27661 "GD_ID_HC_ACTUAL_CLEARANCE_RR" 27662 "GD_ID_HC_STROKE_LEGNTH_RAW_FL" 27663 "GD_ID_HC_STROKE_LEGNTH_RAW_FR" 27664 "GD_ID_HC_STROKE_LEGNTH_RAW_RL" 27665 "GD_ID_HC_STROKE_LEGNTH_RAW_RR" 27666 "GD_ID_HC_OKAY_TO_TRANSITION" 27667 "GD_ID_HC_CYLINDER_PWM_EXTEND_FL" 27668 "GD_ID_HC_CYLINDER_PWM_EXTEND_FR" 27669 "GD_ID_HC_CYLINDER_PWM_EXTEND_RL" 27670 "GD_ID_HC_CYLINDER_PWM_EXTEND_RR" 27671 "GD_ID_HC_CYLINDER_PWM_RETRCT_FL" 27672 "GD_ID_HC_CYLINDER_PWM_RETRCT_FR" 27673 "GD_ID_HC_CYLINDER_PWM_RETRCT_RL" 27674 "GD_ID_HC_CYLINDER_PWM_RETRCT_RR" 27675 "GD_ID_HC_LADDER_EXTEND_Status" 27675 "GD_ID_HC_LADDER_EXTEND" 27676 "GD_ID_HC_REQUEST_CCO_OFF_Status" 27676 "GD_ID_HC_REQUEST_CCO_OFF" 27677 "GD_ID_HC_USER_WARNINGS" 27682 "GD_ID_HC_MOVEMENT_ERROR_FL" 27679 "GD_ID_HC_MOVEMENT_ERROR_FR" 27680 "GD_ID_HC_MOVEMENT_ERROR_RL" 27681 "GD_ID_HC_MOVEMENT_ERROR_RR" 27678 "GD_ID_HC_MANUAL_OVERRIDE_Status" 27678 "GD_ID_HC_MANUAL_OVERRIDE" 27683 "GD_ID_HC_CAL_STATE_Status" 27683 "GD_ID_HC_CAL_STATE" 27684 "GD_ID_HC_CAL_CMD" 27685 "GD_ID_HC_SENSOR_RAW_FL" 27686 "GD_ID_HC_SENSOR_RAW_FR" 27687 "GD_ID_HC_SENSOR_RAW_RL" 27688 "GD_ID_HC_SENSOR_RAW_RR" 27689 "GD_ID_HC_COIL_RAW_EXTEND_FL" 27690 "GD_ID_HC_COIL_RAW_RETRCT_FL" 27691 "GD_ID_HC_COIL_RAW_EXTEND_FR" 27692 "GD_ID_HC_COIL_RAW_RETRCT_FR" 27693 "GD_ID_HC_COIL_RAW_EXTEND_RL" 27694 "GD_ID_HC_COIL_RAW_RETRCT_RL" 27695 "GD_ID_HC_COIL_RAW_EXTEND_RR" 27696 "GD_ID_HC_COIL_RAW_RETRCT_RR" 27697 "GD_ID_HC_STROKE_LEGNTH_FILTER_FL_Status" 27697 "GD_ID_HC_STROKE_LEGNTH_FILTER_FL" 27698 "GD_ID_HC_STROKE_LEGNTH_FILTER_FR_Status" 27698 "GD_ID_HC_STROKE_LEGNTH_FILTER_FR" 27699 "GD_ID_HC_STROKE_LEGNTH_FILTER_RL_Status" 27699 "GD_ID_HC_STROKE_LEGNTH_FILTER_RL" 27700 "GD_ID_HC_STROKE_LEGNTH_FILTER_RR_Status" 27700 "GD_ID_HC_STROKE_LEGNTH_FILTER_RR" 28142 "GD_ID_HC_ErrorManagement_Status" 28142 "GD_ID_HC_ErrorManagement" 28159 "GD_ID_HC_LifeMessage" 32480 "GD_ID_ACM_BT_SERVER_ADDR_ROUTER_Status" 32480 "GD_ID_ACM_BT_SERVER_ADDR_ROUTER" 32750 "GD_ID_ACM_ErrorManagement_Status" 32750 "GD_ID_ACM_ErrorManagement" 32767 "GD_ID_ACM_LifeMessage"  ;
VAL_ 1559 Index 1024 "GD_ID_NT01_Date_Year" 1025 "GD_ID_NT01_Date_Month" 1026 "GD_ID_NT01_Date_Day" 1027 "GD_ID_NT01_Date_WeekDay" 1028 "GD_ID_NT01_Time_Hours" 1029 "GD_ID_NT01_Time_Minutes" 1030 "GD_ID_NT01_Time_Seconds" 1045 "GD_ID_NT01_MainBoardTemp" 1056 "GD_ID_NT01_LightSensor_Status" 1056 "GD_ID_NT01_LightSensor" 1281 "GD_ID_NT01_Software_Version" 1282 "GD_ID_NT01_Software_Revision" 1283 "GD_ID_NT01_Build_Date_Day_Month" 1284 "GD_ID_NT01_Build_Date_Year" 1285 "GD_ID_NT01_Build_Time_Hrs_Min" 1286 "GD_ID_NT01_Build_Time_Seconds" 1036 "GD_ID_Time_Seconds" 1037 "GD_ID_Time_Hours_Minutes" 1038 "GD_ID_Date_Month_Day" 1039 "GD_ID_Date_Year" 1518 "GD_ID_NT01_ErrorManagement_Status" 1518 "GD_ID_NT01_ErrorManagement" 1535 "GD_ID_NT01_LifeMessage" 1536 "GD_ID_MFA_A19_Status" 1536 "GD_ID_MFA_A19" 1544 "GD_ID_MFA_A11_Status" 1544 "GD_ID_MFA_A11" 1545 "GD_ID_MFA_A11_LED" 1546 "GD_ID_MFA_A12_Status" 1546 "GD_ID_MFA_A12" 1547 "GD_ID_MFA_A12_LED" 1548 "GD_ID_MFA_A13_Status" 1548 "GD_ID_MFA_A13" 1549 "GD_ID_MFA_A13_LED" 1550 "GD_ID_MFA_A14_Status" 1550 "GD_ID_MFA_A14" 1551 "GD_ID_MFA_A14_LED" 1562 "GD_ID_MFA_A1_Status" 1562 "GD_ID_MFA_A1" 1563 "GD_ID_MFA_A2_Status" 1563 "GD_ID_MFA_A2" 1568 "GD_ID_MFA_A10_Status" 1568 "GD_ID_MFA_A10" 1569 "GD_ID_MFA_A8_Status" 1569 "GD_ID_MFA_A8" 1570 "GD_ID_MFA_A7_Status" 1570 "GD_ID_MFA_A7" 1571 "GD_ID_MFA_A24_Status" 1571 "GD_ID_MFA_A24" 1572 "GD_ID_MFA_A9_Status" 1572 "GD_ID_MFA_A9" 1573 "GD_ID_MFA_A26_Status" 1573 "GD_ID_MFA_A26" 1574 "GD_ID_MFA_A17_Status" 1574 "GD_ID_MFA_A17" 1575 "GD_ID_MFA_A18_Status" 1575 "GD_ID_MFA_A18" 1576 "GD_ID_MFA_A15_Status" 1576 "GD_ID_MFA_A15" 1577 "GD_ID_MFA_A16_Status" 1577 "GD_ID_MFA_A16" 1578 "GD_ID_MFA_A3_Status" 1578 "GD_ID_MFA_A3" 1579 "GD_ID_MFA_A20_Status" 1579 "GD_ID_MFA_A20" 1580 "GD_ID_MFA_A5_Status" 1580 "GD_ID_MFA_A5" 1581 "GD_ID_MFA_A22_Status" 1581 "GD_ID_MFA_A22" 1582 "GD_ID_MFA_A4_Status" 1582 "GD_ID_MFA_A4" 1583 "GD_ID_MFA_A6_Status" 1583 "GD_ID_MFA_A6" 1584 "GD_ID_MFA_E1_Status" 1584 "GD_ID_MFA_E1" 1585 "GD_ID_MFA_E2_Status" 1585 "GD_ID_MFA_E2" 1586 "GD_ID_MFA_E3_Status" 1586 "GD_ID_MFA_E3" 1587 "GD_ID_MFA_E4_Status" 1587 "GD_ID_MFA_E4" 1590 "GD_ID_MFA_ZONE_D_ROCKER_1" 1591 "GD_ID_MFA_ZONE_D_LED_ROCKER_1" 1592 "GD_ID_MFA_ZONE_D_ROCKER_2" 1593 "GD_ID_MFA_ZONE_D_LED_ROCKER_2" 1594 "GD_ID_MFA_ZONE_D_ROCKER_3" 1595 "GD_ID_MFA_ZONE_D_LED_ROCKER_3" 1596 "GD_ID_MFA_ZONE_D_ROCKER_4" 1597 "GD_ID_MFA_ZONE_D_LED_ROCKER_4" 1598 "GD_ID_MFA_ZONE_D_ROCKER_5" 1599 "GD_ID_MFA_ZONE_D_LED_ROCKER_5" 1600 "GD_ID_MFA_B1_Status" 1600 "GD_ID_MFA_B1" 1601 "GD_ID_MFA_F1_Status" 1601 "GD_ID_MFA_F1" 1632 "GD_ID_MFA_C17_Status" 1632 "GD_ID_MFA_C17" 1633 "GD_ID_MFA_C17_LED" 1634 "GD_ID_MFA_C18_Status" 1634 "GD_ID_MFA_C18" 1635 "GD_ID_MFA_C18_LED" 1636 "GD_ID_MFA_C9_Status" 1636 "GD_ID_MFA_C9" 1637 "GD_ID_MFA_C9_LED" 1638 "GD_ID_MFA_C10_Status" 1638 "GD_ID_MFA_C10" 1639 "GD_ID_MFA_C10_LED" 1640 "GD_ID_MFA_C1_Status" 1640 "GD_ID_MFA_C1" 1641 "GD_ID_MFA_C1_LED" 1642 "GD_ID_MFA_C2_Status" 1642 "GD_ID_MFA_C2" 1643 "GD_ID_MFA_C2_LED" 1644 "GD_ID_MFA_ZONE_D_BUTTON_LEFT_INSIDE_Status" 1644 "GD_ID_MFA_ZONE_D_BUTTON_LEFT_INSIDE" 1645 "GD_ID_MFA_ZONE_D_LED_LEFT_INSIDE" 1646 "GD_ID_MFA_ZONE_D_BUTTON_LEFT_OUTSIDE_Status" 1646 "GD_ID_MFA_ZONE_D_BUTTON_LEFT_OUTSIDE" 1647 "GD_ID_MFA_ZONE_D_LED_LEFT_OUTSIDE" 1648 "GD_ID_MFA_C19_Status" 1648 "GD_ID_MFA_C19" 1649 "GD_ID_MFA_C19_LED" 1650 "GD_ID_MFA_C20_Status" 1650 "GD_ID_MFA_C20" 1651 "GD_ID_MFA_C20_LED" 1652 "GD_ID_MFA_C11_Status" 1652 "GD_ID_MFA_C11" 1653 "GD_ID_MFA_C11_LED" 1654 "GD_ID_MFA_C12_Status" 1654 "GD_ID_MFA_C12" 1655 "GD_ID_MFA_C12_LED" 1656 "GD_ID_MFA_C3_Status" 1656 "GD_ID_MFA_C3" 1657 "GD_ID_MFA_C3_LED" 1658 "GD_ID_MFA_C4_Status" 1658 "GD_ID_MFA_C4" 1659 "GD_ID_MFA_C4_LED" 1660 "GD_ID_MFA_ZONE_D_BUTTON_RIGHT_INSIDE_Status" 1660 "GD_ID_MFA_ZONE_D_BUTTON_RIGHT_INSIDE" 1661 "GD_ID_MFA_ZONE_D_LED_RIGHT_INSIDE" 1662 "GD_ID_MFA_ZONE_D_BUTTON_RIGHT_OUTSIDE_Status" 1662 "GD_ID_MFA_ZONE_D_BUTTON_RIGHT_OUTSIDE" 1663 "GD_ID_MFA_ZONE_D_LED_RIGHT_OUTSIDE" 1664 "GD_ID_MFA_C21_Status" 1664 "GD_ID_MFA_C21" 1665 "GD_ID_MFA_C21_LED" 1666 "GD_ID_MFA_C22_Status" 1666 "GD_ID_MFA_C22" 1667 "GD_ID_MFA_C22_LED" 1668 "GD_ID_MFA_C13_Status" 1668 "GD_ID_MFA_C13" 1669 "GD_ID_MFA_C13_LED" 1670 "GD_ID_MFA_C14_Status" 1670 "GD_ID_MFA_C14" 1671 "GD_ID_MFA_C14_LED" 1672 "GD_ID_MFA_C5_Status" 1672 "GD_ID_MFA_C5" 1673 "GD_ID_MFA_C5_LED" 1674 "GD_ID_MFA_C6_Status" 1674 "GD_ID_MFA_C6" 1675 "GD_ID_MFA_C6_LED" 1680 "GD_ID_MFA_C23_Status" 1680 "GD_ID_MFA_C23" 1681 "GD_ID_MFA_C23_LED" 1682 "GD_ID_MFA_C24_Status" 1682 "GD_ID_MFA_C24" 1683 "GD_ID_MFA_C24_LED" 1684 "GD_ID_MFA_C15_Status" 1684 "GD_ID_MFA_C15" 1685 "GD_ID_MFA_C15_LED" 1686 "GD_ID_MFA_C16_Status" 1686 "GD_ID_MFA_C16" 1687 "GD_ID_MFA_C16_LED" 1688 "GD_ID_MFA_C7_Status" 1688 "GD_ID_MFA_C7" 1689 "GD_ID_MFA_C7_LED" 1690 "GD_ID_MFA_C8_Status" 1690 "GD_ID_MFA_C8" 1691 "GD_ID_MFA_C8_LED" 1696 "GD_ID_MFA_FunctionLighting" 1697 "GD_ID_MFA_NightDesign" 1736 "GD_ID_MFA_Throttle_CalibCmd" 1737 "GD_ID_MFA_Throttle_CalibState" 1738 "GD_ID_MFA_UNKNOWN_Calibration_Cmd" 1739 "GD_ID_MFA_UNKNOWN_Calibration_Status" 1740 "GD_ID_LM1_CalibrationCommand" 1741 "GD_ID_LM1_CalibrationStatus" 1742 "GD_ID_MFA_Lever_CalibCmd" 1743 "GD_ID_MFA_Lever_CalibState" 1744 "GD_ID_LM3_CalibrationCommand" 1745 "GD_ID_LM3_CalibrationStatus" 1746 "GD_ID_LM4_CalibrationCommand" 1747 "GD_ID_LM4_CalibrationStatus" 2030 "GD_ID_MFA_ErrorManagement_Status" 2030 "GD_ID_MFA_ErrorManagement" 2032 "GD_ID_HwConfigMFA" 2033 "GD_ID_IdentificationModule" 2036 "GD_ID_MFA_SoftwareVersion" 2037 "GD_ID_SwVersionAJS" 2040 "GD_ID_SerialNumber1st" 2041 "GD_ID_SerialNumber2nd" 2047 "GD_ID_MFA_LifeMessage" 2049 "GD_ID_DRIVE_AIR_PRESSURE" 2050 "GD_ID_DRIVE_HYDRAULICS_ENABLE_Status" 2050 "GD_ID_DRIVE_HYDRAULICS_ENABLE" 2051 "GD_ID_DRIVE_REQUEST_HYD_ENABLE_OFF_Status" 2051 "GD_ID_DRIVE_REQUEST_HYD_ENABLE_OFF" 2052 "GD_ID_DRIVE_BRAKE_PEDAL_POSITION_A" 2053 "GD_ID_DRIVE_BRAKE_PEDAL_POSITION_B" 2054 "GD_ID_DRIVE_BRAKE_PEDAL_POSITION" 2055 "GD_ID_DRIVE_HYD_MOT_RPM_FR" 2056 "GD_ID_DRIVE_HYD_MOT_RPM_RR" 2057 "GD_ID_DRIVE_HYD_MOT_RPM_RL" 2058 "GD_ID_DRIVE_HYD_MOT_RPM_FL" 2061 "GD_ID_DRIVE_FORWARD_SS_DEFAULT_SPEED" 2062 "GD_ID_DRIVE_REVERSE_SS_DEFAULT_SPEED" 2063 "GD_ID_DRIVE_WHEEL_BASED_MACHINE_SPEED" 2064 "GD_ID_DRIVE_DANFOSS_IN_SV_STATE_COMMANDED_Status" 2064 "GD_ID_DRIVE_DANFOSS_IN_SV_STATE_COMMANDED" 2065 "GD_ID_DRIVE_DANFOSS_OUT_SV_STATE_ACTUAL_Status" 2065 "GD_ID_DRIVE_DANFOSS_OUT_SV_STATE_ACTUAL" 2066 "GD_ID_DRIVE_DANFOSS_IN_SV_SPEED" 2067 "GD_ID_DRIVE_DANFOSS_OUT_DRIVE_MODE_ACTUAL_Status" 2067 "GD_ID_DRIVE_DANFOSS_OUT_DRIVE_MODE_ACTUAL" 2068 "GD_ID_DRIVE_DANFOSS_IN_DRIVE_MODE_COMMANDED_Status" 2068 "GD_ID_DRIVE_DANFOSS_IN_DRIVE_MODE_COMMANDED" 2069 "GD_ID_DRIVE_SV_1_Status" 2069 "GD_ID_DRIVE_SV_1" 2070 "GD_ID_DRIVE_SV_2_Status" 2070 "GD_ID_DRIVE_SV_2" 2071 "GD_ID_DRIVE_SV_STATE" 2072 "GD_ID_DRIVE_MAX_ENGINE_DROP" 2076 "GD_ID_DRIVE_CALIB_STATE_BRAKE_PEDAL_Status" 2076 "GD_ID_DRIVE_CALIB_STATE_BRAKE_PEDAL" 2077 "GD_ID_DRIVE_MAX_SV_SPEED" 2078 "GD_ID_DRIVE_PRESSURE_A" 2079 "GD_ID_DRIVE_PRESSURE_B" 2080 "GD_ID_DRIVE_CHARGE_PRESSURE" 2084 "GD_ID_DRIVE_DASH_DISPLAYED_ENGINE_SPEED" 2085 "GD_ID_DRIVE_FRONT_STEER_ANGLE" 2086 "GD_ID_DRIVE_DANFOSS_OUT_PARKBRK_REQUEST_Status" 2086 "GD_ID_DRIVE_DANFOSS_OUT_PARKBRK_REQUEST" 2087 "GD_ID_DRIVE_DANFOSS_OUT_CCO_VALVE_REQUEST_Status" 2087 "GD_ID_DRIVE_DANFOSS_OUT_CCO_VALVE_REQUEST" 2088 "GD_ID_DRIVE_CCO_VALVE_COMMAND_Status" 2088 "GD_ID_DRIVE_CCO_VALVE_COMMAND" 2092 "GD_ID_DRIVE_TIRE_RCI" 2094 "GD_ID_DRIVE_DASH_DISPLAYED_MACHINE_SPEED2" 2095 "GD_ID_DRIVE_CARGO_OVER_WEIGHT_Status" 2095 "GD_ID_DRIVE_CARGO_OVER_WEIGHT" 2096 "GD_ID_DRIVE_ROGATOR_MACHINE_CONFIGURATION" 2097 "GD_ID_DRIVE_TIRE_ROLLING_CIRCUMFERENCE" 2098 "GD_ID_DRIVE_BRAKE_LIGHT_COMMAND_Status" 2098 "GD_ID_DRIVE_BRAKE_LIGHT_COMMAND" 2099 "GD_ID_DRIVE_TARGET_MACHINE_SPEED" 2100 "GD_ID_DRIVE_MAX_MACHINE_SPEED" 2101 "GD_ID_DRIVE_EXPECTED_MACHINE_SPEED" 2111 "GD_ID_DRIVE_CALIB_BRAKE_PEDAL_START_Status" 2111 "GD_ID_DRIVE_CALIB_BRAKE_PEDAL_START" 2112 "GD_ID_DRIVE_CALIB_BRAKE_PEDAL_ACTIVE_Status" 2112 "GD_ID_DRIVE_CALIB_BRAKE_PEDAL_ACTIVE" 2113 "GD_ID_DRIVE_CALIB_BRAKE_PEDAL_DOWN_Status" 2113 "GD_ID_DRIVE_CALIB_BRAKE_PEDAL_DOWN" 2114 "GD_ID_DRIVE_CALIB_BRAKE_PEDAL_DOWN_RET_Status" 2114 "GD_ID_DRIVE_CALIB_BRAKE_PEDAL_DOWN_RET" 2115 "GD_ID_DRIVE_CALIB_BRAKE_PEDAL_UP_Status" 2115 "GD_ID_DRIVE_CALIB_BRAKE_PEDAL_UP" 2116 "GD_ID_DRIVE_CALIB_BRAKE_PEDAL_UP_RET_Status" 2116 "GD_ID_DRIVE_CALIB_BRAKE_PEDAL_UP_RET" 2117 "GD_ID_DRIVE_CALIB_BRAKE_PEDAL_ACCEPT_Status" 2117 "GD_ID_DRIVE_CALIB_BRAKE_PEDAL_ACCEPT" 2118 "GD_ID_DRIVE_CALIB_BRAKE_PEDAL_DECLINE_Status" 2118 "GD_ID_DRIVE_CALIB_BRAKE_PEDAL_DECLINE" 2119 "GD_ID_DRIVE_CALIB_BRAKE_PEDAL_PROCESSED_Status" 2119 "GD_ID_DRIVE_CALIB_BRAKE_PEDAL_PROCESSED" 2120 "GD_ID_DRIVE_CALIB_BRAKE_PEDAL_ERROR_Status" 2120 "GD_ID_DRIVE_CALIB_BRAKE_PEDAL_ERROR" 2121 "GD_ID_DRIVE_FIELD_STREET_STATE" 2122 "GD_ID_DRIVE_DTM_ENALBED_IN_MANUAL_Status" 2122 "GD_ID_DRIVE_DTM_ENALBED_IN_MANUAL" 2123 "GD_ID_DRIVE_STATE" 2124 "GD_ID_DRIVE_DTM_MIN_RPM" 2125 "GD_ID_DRIVE_DTM_MAX_RPM" 2126 "GD_ID_DRIVE_DRIVEPUMP_A_COMCURRENT" 2127 "GD_ID_DRIVE_DRIVEPUMP_B_COMCURRENT" 2128 "GD_ID_DRIVE_HYD_MOT_FR_COMCURRENT" 2129 "GD_ID_DRIVE_HYD_MOT_RR_COMCURRENT" 2130 "GD_ID_DRIVE_HYD_MOT_RL_COMCURRENT" 2131 "GD_ID_DRIVE_HYD_MOT_FL_COMCURRENT" 2133 "GD_ID_DRIVE_HYDRAULIC_OIl_TEMP" 2135 "GD_ID_DRIVE_FUEL_LEVEL" 2137 "GD_ID_DRIVE_PARKBRAKE_COMMAND_Status" 2137 "GD_ID_DRIVE_PARKBRAKE_COMMAND" 2138 "GD_ID_DRIVE_OPERATION_MODE" 2139 "GD_ID_DRIVE_DRIVEPUMP_A_FEEDBACK_CURRENT" 2140 "GD_ID_DRIVE_DRIVEPUMP_B_FEEDBACK_CURRENT" 2141 "GD_ID_DRIVE_HYD_MOT_FR_FEEDBACK_CURRENT" 2142 "GD_ID_DRIVE_HYD_MOT_RR_FEEDBACK_CURRENT" 2143 "GD_ID_DRIVE_HYD_MOT_RL_FEEDBACK_CURRENT" 2144 "GD_ID_DRIVE_HYD_MOT_FL_FEEDBACK_CURRENT" 2150 "GD_ID_DRIVE_RADAR_SPEED" 2175 "GD_ID_DRIVE_DASH_DISPLAYED_PARK_BRAKE_LED_Status" 2175 "GD_ID_DRIVE_DASH_DISPLAYED_PARK_BRAKE_LED" 2192 "GD_ID_DRIVE_CURRENT_GEAR" 2193 "GD_ID_DRIVE_SELECTED_GEAR" 2194 "GD_ID_DRIVE_DRIVE_PEDAL_POSITION" 2207 "GD_ID_DRIVE_DASH_DISPLAYED_MACHINE_SPEED1" 2258 "GD_ID_DRIVE_DTM_COMMANDED_RPM" 2300 "GD_ID_DRIVE_DISPLAY_UNITS_Status" 2300 "GD_ID_DRIVE_DISPLAY_UNITS" 2348 "GD_ID_DRIVE_RESET_DEFAULT_PROFILES_Status" 2348 "GD_ID_DRIVE_RESET_DEFAULT_PROFILES" 2349 "GD_ID_DRIVE_LEVER_ACCEL_PROFILE" 2350 "GD_ID_DRIVE_LEVER_DECEL_PROFILE" 2351 "GD_ID_DRIVE_PEDAL_ACCEL_PROFILE" 2352 "GD_ID_DRIVE_PEDAL_DECEL_PROFILE" 2353 "GD_ID_DRIVE_SV_ACCELDECEL_PROFILE" 2355 "GD_ID_DRIVE_SHUTTLE_ACCELDECEL_PROFILE" 2373 "GD_ID_DRIVE_DANFOSS_IN_OUTFAULTS" 2374 "GD_ID_ASC_RAMP_RL_DECTM" 2375 "GD_ID_ASC_PID_FL_KIUP_ASC" 2376 "GD_ID_ASC_PID_FL_KIDOWN_ASC" 2377 "GD_ID_ASC_PID_FL_KPUP_ASC" 2378 "GD_ID_ASC_PID_FL_KPDOWN_ASC" 2379 "GD_ID_ASC_PID_FL_KDUP_ASC" 2380 "GD_ID_ASC_PID_FL_IRED" 2381 "GD_ID_ASC_INCHING_INCHMODE" 2382 "GD_ID_ASC_INCHING_TVOLINCH" 2383 "GD_ID_ASC_REFSPDDISABLE_ABS_MINREFSPD_MMSEC" 2384 "GD_ID_ASC_REFSPDDISABLE_ASC_MINREFSPD_MMSEC" 2385 "GD_ID_ASC_REFSPDDISABLE_ABS_DECRAMP60K" 2386 "GD_ID_ASC_FFPROFILES_REVBRAKINGFRONT_Y4_PTC2" 2387 "GD_ID_ASC_FFPROFILES_REVBRAKINGFRONT_Y5_PTC2" 2388 "GD_ID_ASC_FFPROFILES_REVBRAKINGFRONT_Y6_PTC2" 2389 "GD_ID_ASC_FFPROFILES_FWDBRAKINGREAR_Y5_PTC2_LD" 2390 "GD_ID_ASC_FFPROFILES_FWDBRAKINGREAR_Y5_PTC2" 2391 "GD_ID_ASC_FFPROFILES_FWDBRAKINGREAR_Y6_PTC2_LD" 2392 "GD_ID_ASC_FFPROFILES_FWDBRAKINGREAR_Y6_PTC2" 2393 "GD_ID_ASC_CORE_ASC_MINTOLERANCE_PCT2" 2394 "GD_ID_ASC_PID_RL_KDUP_ASC" 2395 "GD_ID_ASC_PID_RL_KPUP_ASC" 2396 "GD_ID_ASC_PID_RL_KPDN_ASC" 2397 "GD_ID_ASC_PID_RL_KIUP_ASC" 2398 "GD_ID_ASC_PID_RL_KIDN_ASC" 2399 "GD_ID_ASC_PID_RL_IRED" 2400 "GD_ID_BRK_Y5" 2401 "GD_ID_ENGADJLD_FILTERTM_MS" 2402 "GD_ID_ENGADJLD_Y4" 2403 "GD_ID_MV_I_INT_I_GAIN" 2404 "GD_ID_MISC_PR_PERACT_Y3" 2405 "GD_ID_MISC_PR_PERACT_Y4" 2406 "GD_ID_MISC_PR_PERACT_Y5" 2407 "GD_ID_ASC_Core_ABS_Ang_Y1_ptc2" 2408 "GD_ID_ASC_Core_ABS_Ang_Y2_ptc2" 2409 "GD_ID_ASC_Core_ABS_Ang_Y3_ptc2" 2410 "GD_ID_ASC_Core_ABS_Ang_Y4_ptc2" 2411 "GD_ID_ASC_Core_ABS_Ang_Y5_ptc2" 2412 "GD_ID_ASC_Core_ABS_MinTolerance_pct2" 2413 "GD_ID_ASC_Core_ASC_Ang_Y1_ptc2" 2414 "GD_ID_ASC_Core_ASC_Ang_Y2_ptc2" 2415 "GD_ID_ASC_Core_ASC_Ang_Y3_ptc2" 2416 "GD_ID_ASC_Core_ASC_Ang_Y4_ptc2" 2417 "GD_ID_ASC_Core_ASC_Ang_Y5_ptc2" 2458 "GD_ID_DRIVE_PEDAL_CAL_COMMAND_Status" 2458 "GD_ID_DRIVE_PEDAL_CAL_COMMAND" 2459 "GD_ID_DRIVE_PEDAL_CAL_STATE_Status" 2459 "GD_ID_DRIVE_PEDAL_CAL_STATE" 2460 "GD_ID_DRIVE_BRAKE_PEDAL_CAL_COMMAND_Status" 2460 "GD_ID_DRIVE_BRAKE_PEDAL_CAL_COMMAND" 2461 "GD_ID_DRIVE_BRAKE_PEDAL_CAL_STATE_Status" 2461 "GD_ID_DRIVE_BRAKE_PEDAL_CAL_STATE" 2462 "GD_ID_DRIVE_WAS_CAL_COMMAND_Status" 2462 "GD_ID_DRIVE_WAS_CAL_COMMAND" 2463 "GD_ID_DRIVE_WAS_CAL_STATE_Status" 2463 "GD_ID_DRIVE_WAS_CAL_STATE" 2464 "GD_ID_DRIVE_HYDRO_CAL_COMMAND_Status" 2464 "GD_ID_DRIVE_HYDRO_CAL_COMMAND" 2465 "GD_ID_DRIVE_HYDRO_CAL_STATE_Status" 2465 "GD_ID_DRIVE_HYDRO_CAL_STATE" 2468 "GD_ID_DRIVE_WHEEL_SPEED_CALIBRATION_COMMAND_Status" 2468 "GD_ID_DRIVE_WHEEL_SPEED_CALIBRATION_COMMAND" 2469 "GD_ID_DRIVE_WHEEL_SPEED_CALIBRATION_STATE_Status" 2469 "GD_ID_DRIVE_WHEEL_SPEED_CALIBRATION_STATE" 2470 "GD_ID_DRIVE_WHEEL_SPEED_CALIBRATION_USER_DISTANCE_Status" 2470 "GD_ID_DRIVE_WHEEL_SPEED_CALIBRATION_USER_DISTANCE" 2471 "GD_ID_DRIVE_RADAR_CALIBRATION_COMMAND_Status" 2471 "GD_ID_DRIVE_RADAR_CALIBRATION_COMMAND" 2472 "GD_ID_DRIVE_RADAR_CALIBRATION_STATE_Status" 2472 "GD_ID_DRIVE_RADAR_CALIBRATION_STATE" 2473 "GD_ID_DRIVE_RADAR_CALIBRATION_USER_DISTANCE_Status" 2473 "GD_ID_DRIVE_RADAR_CALIBRATION_USER_DISTANCE" 2474 "GD_ID_DRIVE_COMBO_CALIBRATION_COMMAND_Status" 2474 "GD_ID_DRIVE_COMBO_CALIBRATION_COMMAND" 2475 "GD_ID_DRIVE_COMBO_CALIBRATION_STATE_Status" 2475 "GD_ID_DRIVE_COMBO_CALIBRATION_STATE" 2476 "GD_ID_DRIVE_COMBO_CALIBRATION_USER_DISTANCE_Status" 2476 "GD_ID_DRIVE_COMBO_CALIBRATION_USER_DISTANCE" 2498 "GD_ID_DRIVE_DRIVEPUMP_A_START_CAL_CURRENT_STORED" 2499 "GD_ID_DRIVE_DRIVEPUMP_A_END_CAL_CURRENT_STORED" 2500 "GD_ID_DRIVE_DRIVEPUMP_B_START_CAL_CURRENT_STORED" 2501 "GD_ID_DRIVE_DRIVEPUMP_B_END_CAL_CURRENT_STORED" 2502 "GD_ID_DRIVE_MOTOR_FL_START_CAL_CURRENT_STORED" 2503 "GD_ID_DRIVE_MOTOR_FL_END_CAL_CURRENT_STORED" 2504 "GD_ID_DRIVE_MOTOR_FR_START_CAL_CURRENT_STORED" 2505 "GD_ID_DRIVE_MOTOR_FR_END_CAL_CURRENT_STORED" 2506 "GD_ID_DRIVE_MOTOR_RL_START_CAL_CURRENT_STORED" 2507 "GD_ID_DRIVE_MOTOR_RL_END_CAL_CURRENT_STORED" 2508 "GD_ID_DRIVE_MOTOR_RR_START_CAL_CURRENT_STORED" 2509 "GD_ID_DRIVE_MOTOR_RR_END_CAL_CURRENT_STORED" 2510 "GD_ID_DRIVE_DRIVEPUMP_A_START_CAL_CURRENT_NEW" 2511 "GD_ID_DRIVE_DRIVEPUMP_A_END_CAL_CURRENT_NEW" 2512 "GD_ID_DRIVE_DRIVEPUMP_B_START_CAL_CURRENT_NEW" 2513 "GD_ID_DRIVE_DRIVEPUMP_B_END_CAL_CURRENT_NEW" 2514 "GD_ID_DRIVE_MOTOR_FL_START_CAL_CURRENT_NEW" 2515 "GD_ID_DRIVE_MOTOR_FL_END_CAL_CURRENT_NEW" 2516 "GD_ID_DRIVE_MOTOR_FR_START_CAL_CURRENT_NEW" 2517 "GD_ID_DRIVE_MOTOR_FR_END_CAL_CURRENT_NEW" 2518 "GD_ID_DRIVE_MOTOR_RL_START_CAL_CURRENT_NEW" 2519 "GD_ID_DRIVE_MOTOR_RL_END_CAL_CURRENT_NEW" 2520 "GD_ID_DRIVE_MOTOR_RR_START_CAL_CURRENT_NEW" 2521 "GD_ID_DRIVE_MOTOR_RR_END_CAL_CURRENT_NEW" 2523 "GD_ID_DRIVE_DANFOSS_CAL_REQUEST" 2525 "GD_ID_DRIVE_WHEEL_BASED_MACHINE_SPEED_KPH" 2526 "GD_ID_DRIVE_NORMALIZED_WHEEL_SPEED_FL" 2527 "GD_ID_DRIVE_NORMALIZED_WHEEL_SPEED_FR" 2528 "GD_ID_DRIVE_NORMALIZED_WHEEL_SPEED_RL" 2529 "GD_ID_DRIVE_NORMALIZED_WHEEL_SPEED_RR" 2530 "GD_ID_DRIVE_AIRBAG_DEFLATE_Status" 2530 "GD_ID_DRIVE_AIRBAG_DEFLATE" 2542 "GD_ID_DRIVE_ERRORMANAGEMENT_Status" 2542 "GD_ID_DRIVE_ERRORMANAGEMENT" 2559 "GD_ID_DRIVE_LIFEMESSAGE" 12288 "GD_ID_SCT_ENABLE" 12289 "GD_ID_SCT_MODUL_OUT_STATUS" 12290 "GD_ID_SCT_MODUL_IN_STATUS" 12298 "GD_ID_SCT_STATUSDISPLAY_TERMINAL" 12303 "GD_ID_SCT_TURNING_OFF_REASON" 12304 "GD_ID_SCT_STATE" 12305 "GD_ID_SCT_VOTED_ACTIVE_CLASS_1" 12306 "GD_ID_SCT_VOTED_ACTIVE_CLASS_2" 12312 "GD_ID_SCT_SETPOINT_Status" 12312 "GD_ID_SCT_SETPOINT" 12313 "GD_ID_SCT_SETPOINT_FEELER_GUIDANCE_Status" 12313 "GD_ID_SCT_SETPOINT_FEELER_GUIDANCE" 12314 "GD_ID_SCT_SETPOINT_CURVATURE_Status" 12314 "GD_ID_SCT_SETPOINT_CURVATURE" 12315 "GD_ID_SCT_SETPOINT_CURVATURE_TIM_Status" 12315 "GD_ID_SCT_SETPOINT_CURVATURE_TIM" 12316 "GD_ID_SCT_SETPOINT_CURVATURE_FEELER_GUIDANCE_Status" 12316 "GD_ID_SCT_SETPOINT_CURVATURE_FEELER_GUIDANCE" 12320 "GD_ID_SCT_WAS_RAW_VALUE" 12321 "GD_ID_SCT_WAS_SCALED_VALUE" 12322 "GD_ID_SCT_WAS_SENSOR_ANGLE" 12323 "GD_ID_SCT_WAS_MEDIAN_ANGLE" 12324 "GD_ID_SCT_WAS_MEDIAN_ANGLE_MAX" 12325 "GD_ID_SCT_WAS_VIRTUAL_ANGLE" 12328 "GD_ID_SCT_WAS_MEDIAN_CURVATURE" 12329 "GD_ID_SCT_WAS_MEDIAN_CURVATURE_MAX" 12334 "GD_ID_SCT_WAS_CALIB_COMMAND" 12335 "GD_ID_SCT_WAS_CALIB_STATUS" 12336 "GD_ID_SCT_SWS_RAW_VALUE_Status" 12336 "GD_ID_SCT_SWS_RAW_VALUE" 12338 "GD_ID_SCT_SWS_LIMITED_ANGLE_Status" 12338 "GD_ID_SCT_SWS_LIMITED_ANGLE" 12339 "GD_ID_SCT_SWS_CONTINUED_ANGLE_Status" 12339 "GD_ID_SCT_SWS_CONTINUED_ANGLE" 12340 "GD_ID_SCT_SWS_ROTATIONAL_SPEED" 12352 "GD_ID_SCT_VALVE_SETPOINT" 12353 "GD_ID_SCT_VALVE_POSITION" 12366 "GD_ID_SCT_VALVE_CALIB_COMMAND" 12367 "GD_ID_SCT_VALVE_CALIB_STATUS" 12368 "GD_ID_SCT_PILOTVALVE_STATUS_Status" 12368 "GD_ID_SCT_PILOTVALVE_STATUS" 12388 "GD_ID_SCT_OLAY_STEER_FACTOR" 12416 "GD_ID_SCT_HEADLAND_CMD_Status" 12416 "GD_ID_SCT_HEADLAND_CMD" 12417 "GD_ID_SCT_3RDPARTY_READY_STATUS_Status" 12417 "GD_ID_SCT_3RDPARTY_READY_STATUS" 12418 "GD_ID_SCT_3RDPARTY_POSITION_STATUS_Status" 12418 "GD_ID_SCT_3RDPARTY_POSITION_STATUS" 12419 "GD_ID_SCT_3RDPARTY_CANCEL_REQUEST_Status" 12419 "GD_ID_SCT_3RDPARTY_CANCEL_REQUEST" 12420 "GD_ID_SCT_3RDPARTY_COMMAND_GUIDANCE_Status" 12420 "GD_ID_SCT_3RDPARTY_COMMAND_GUIDANCE" 12544 "GD_ID_SCT_TSD_MIN_SPEED_FORWARD" 12545 "GD_ID_SCT_TSD_MAX_SPEED_FORWARD" 12546 "GD_ID_SCT_TSD_MIN_MACHINE_RADIUS" 12547 "GD_ID_SCT_TSD_MAX_ACQUISITION_ANGLE" 12560 "GD_ID_SCT_GUIDANCE_CONFIGURATION_DATA_Status" 12560 "GD_ID_SCT_GUIDANCE_CONFIGURATION_DATA" 12568 "GD_ID_SCT_STEERING_MODE_Status" 12568 "GD_ID_SCT_STEERING_MODE" 12569 "GD_ID_SCT_SECONDARY_WAS_RAW_VALUE_Status" 12569 "GD_ID_SCT_SECONDARY_WAS_RAW_VALUE" 12570 "GD_ID_SCT_SECONDARY_WAS_SENSOR_ANGLE_Status" 12570 "GD_ID_SCT_SECONDARY_WAS_SENSOR_ANGLE" 12571 "GD_ID_SCT_SECONDARY_WAS_MEDIAN_ANGLE_Status" 12571 "GD_ID_SCT_SECONDARY_WAS_MEDIAN_ANGLE" 12572 "GD_ID_SCT_SECONDARY_WAS_MEDIAN_ANGLE_MAX_Status" 12572 "GD_ID_SCT_SECONDARY_WAS_MEDIAN_ANGLE_MAX" 12573 "GD_ID_SCT_ALS_X_OFFSET_Status" 12573 "GD_ID_SCT_ALS_X_OFFSET" 12574 "GD_ID_SCT_ALS_Y_OFFSET_Status" 12574 "GD_ID_SCT_ALS_Y_OFFSET" 12575 "GD_ID_SCT_ADDITIONAL_WORKING_HEIGHT" 12576 "GD_ID_SCT_VEHICLE_CURRENT_PAYLOAD_Status" 12576 "GD_ID_SCT_VEHICLE_CURRENT_PAYLOAD" 12598 "GD_ID_SCT_ISO_STATE" 12599 "GD_ID_SCT_VEHICLE_SPEED_Status" 12599 "GD_ID_SCT_VEHICLE_SPEED" 12600 "GD_ID_SCT_VEHICLE_MOVEMENT_Status" 12600 "GD_ID_SCT_VEHICLE_MOVEMENT" 12601 "GD_ID_SCT_PARKING_BRAKE_Status" 12601 "GD_ID_SCT_PARKING_BRAKE" 12608 "GD_ID_SCT_CONTROL_MSG_TERMINAL" 12609 "GD_ID_SCT_CONTROL_MSG_GUIDEANCE" 12610 "GD_ID_SCT_MODIFIED_REFERENCE_POINT_HEIGHT" 12611 "GD_ID_SCT_MODIFIED_GNSS_ANTENNA_X_OFFSET" 12612 "GD_ID_SCT_MODIFIED_GNSS_ANTENNA_Y_OFFSET" 12613 "GD_ID_SCT_MODIFIED_GNSS_ANTENNA_Z_OFFSET" 12614 "GD_ID_SCT_MODIFIED_TRACK_WIDTH" 12615 "GD_ID_SCT_MODIFIED_MOUNTING_ERROR_Y_OFFSET" 12736 "GD_ID_SCT_TRACTOR_SN_TYPE" 12737 "GD_ID_SCT_TRACTOR_SN_GROUP" 12738 "GD_ID_SCT_TRACTOR_SN_NUMBER" 12782 "GD_ID_SCT_ERROR_ACKNOWLEDGE_Status" 12782 "GD_ID_SCT_ERROR_ACKNOWLEDGE" 12784 "GD_ID_SCT_ACTIVATE_DIAGNOSTICS" 12788 "GD_ID_SCT_SAFETY_VERSION_Status" 12788 "GD_ID_SCT_SAFETY_VERSION" 12789 "GD_ID_SCT_LIB_SAFETY_VERSION" 12792 "GD_ID_SCT_RECIPE_ACCESS_SETPOINT" 12793 "GD_ID_SCT_TI_ACCESS_SETPOINT" 12794 "GD_ID_SCT_TI_ACCESS_STATE" 12795 "GD_ID_SCT_TI_ACCESS_STATE_KL15" 12797 "GD_ID_SCT_TI_SUB_STATE" 12782 "GD_ID_SCT_ErrorManagement_Status" 12782 "GD_ID_SCT_ErrorManagement" 12799 "GD_ID_SCT_LifeMessage" 12800 "GD_ID_Engine_Rpm" 12801 "GD_ID_Engine_Load" 12802 "GD_ID_Engine_Coolant_Temp_Status" 12802 "GD_ID_Engine_Coolant_Temp" 12803 "GD_ID_Engine_Air_Intake_Temp" 12804 "GD_ID_Engine_Battery_Power_Status" 12804 "GD_ID_Engine_Battery_Power" 12805 "GD_ID_Engine_Air_Intake_Pressure" 12806 "GD_ID_Engine_Oil_Pressure" 12807 "GD_ID_Engine_Rpm_Setpoint_Status" 12807 "GD_ID_Engine_Rpm_Setpoint" 12808 "GD_ID_Engine_Standing_Still_Status" 12808 "GD_ID_Engine_Standing_Still" 12809 "GD_ID_Engine_Oil_Pressure_Low_Status" 12809 "GD_ID_Engine_Oil_Pressure_Low" 12810 "GD_ID_Engine_Oil_Service_Interval_Status" 12810 "GD_ID_Engine_Oil_Service_Interval" 12811 "GD_ID_Engine_Hours" 12812 "GD_ID_Engine_Amber_Warning_Lamp_Status" 12812 "GD_ID_Engine_Amber_Warning_Lamp" 12813 "GD_ID_Engine_Red_Stop_Lamp_Status" 12813 "GD_ID_Engine_Red_Stop_Lamp" 12814 "GD_ID_Alt_Low_Idle" 12815 "GD_ID_Engine_Audible_Warning_Status" 12815 "GD_ID_Engine_Audible_Warning" 12816 "GD_ID_Ambient_Temp" 12817 "GD_ID_Ecu_Temp" 12820 "GD_ID_Fuel_Rate" 12821 "GD_ID_Trip_Fuel" 12822 "GD_ID_Trip_DEF" 12823 "GD_ID_DEF_Level" 12824 "GD_ID_Water_In_Fuel_Status" 12824 "GD_ID_Water_In_Fuel" 12825 "GD_ID_Engine_Malfunction_Lamp_Status" 12825 "GD_ID_Engine_Malfunction_Lamp" 12826 "GD_ID_DEF_Level_Warning_Status" 12826 "GD_ID_DEF_Level_Warning" 12827 "GD_ID_Engine_WaitToStart_Status" 12827 "GD_ID_Engine_WaitToStart" 12828 "GD_ID_Engine_Operating_State" 12829 "GD_ID_Engine_Start_Enable_Status" 12829 "GD_ID_Engine_Start_Enable" 12830 "GD_ID_Implement_Transport_State_Status" 12830 "GD_ID_Implement_Transport_State" 12831 "GD_ID_Implement_Work_State_Status" 12831 "GD_ID_Implement_Work_State" 12832 "GD_ID_Implement_Actual_Working_Width" 12833 "GD_ID_Implement_Actual_Flow" 12834 "GD_ID_Implement_ReadyForFieldWork_Status" 12834 "GD_ID_Implement_ReadyForFieldWork" 12840 "GD_ID_WheelBasedDistance_km" 12841 "GD_ID_WheelBasedDistance_m" 12842 "GD_ID_GroundBasedDistance_km" 12843 "GD_ID_GroundBasedDistance_m" 12844 "GD_ID_SelectedSpeedDistance_km" 12845 "GD_ID_SelectedSpeedDistance_m" 12846 "GD_ID_MachineSelectedSpeed" 12847 "GD_ID_WBZ_MACHINE_SELECTED_SOURCE" 12848 "GD_ID_WBZ_MAX_ENG_RPM" 12850 "GD_ID_Working_Time_SecMin_VD" 12851 "GD_ID_Working_Time_Hours_VD" 12852 "GD_ID_Worked_Area_Ha_VD" 12853 "GD_ID_Worked_Area_0001Ha_VD" 12854 "GD_ID_Used_Fuel_VD" 12855 "GD_ID_Remaining_Time_SecMin_VD" 12856 "GD_ID_Remaining_Time_Hours_VD" 12857 "GD_ID_Remaining_Area_Ha_VD" 12858 "GD_ID_Remaining_Area_0001Ha_VD" 12859 "GD_ID_Required_Fuel_VD" 12860 "GD_ID_Field_Size_Ha_VD" 12861 "GD_ID_Field_Size_0001Ha_VD" 12862 "GD_ID_Reset_VD_Status" 12862 "GD_ID_Reset_VD" 12870 "GD_Iso_IsoState_state_RW" 12871 "GD_ID_WBZ_TERMINAL_PAGE_SIZE" 12878 "GD_ID_WBZ_ENG_DEF_LVL_LAMP_Status" 12878 "GD_ID_WBZ_ENG_DEF_LVL_LAMP" 12879 "GD_ID_WBZ_ENG_DEF_MIL_LAMP_Status" 12879 "GD_ID_WBZ_ENG_DEF_MIL_LAMP" 12880 "GD_ID_IgnitionState_Status" 12880 "GD_ID_IgnitionState" 12881 "GD_ID_WBZ_ENG_FAN_RPM" 12882 "GD_ID_WBZ_ENG_FUEL_TEMP" 12883 "GD_ID_WBZ_ENG_AUXIO1_01" 12884 "GD_ID_WBZ_ENG_FAN_DUTY_CYCLE" 12885 "GD_ID_WBZ_DEF_TEMP" 12886 "GD_ID_WBZ_EXHAUST_TEMP" 12887 "GD_ID_WBZ_FUEL_PRESSURE" 12888 "GD_ID_WBZ_CURVATURE_SETPOINT" 12889 "GD_ID_WBZ_CURVATURE_ENABLE_Status" 12889 "GD_ID_WBZ_CURVATURE_ENABLE" 12890 "GD_ID_WBZ_ENG_START_CMD_Status" 12890 "GD_ID_WBZ_ENG_START_CMD" 12891 "GD_ID_WBZ_THIRD_PARTY_MANUS_Status" 12891 "GD_ID_WBZ_THIRD_PARTY_MANUS" 12892 "GD_ID_WBZ_NEW_LEADER_ACL_Status" 12892 "GD_ID_WBZ_NEW_LEADER_ACL" 12901 "GD_ID_WBZ_AUXIO1_01_FI02" 12902 "GD_ID_WBZ_AUXIO1_02_FI02" 12903 "GD_ID_WBZ_AUXIO1_03_FI02" 12904 "GD_ID_WBZ_AUXIO1_04_FI02" 12905 "GD_ID_WBZ_AUXIO1_05_FI02" 12906 "GD_ID_WBZ_AUXIO1_06_FI02" 12907 "GD_ID_WBZ_AUXIO1_07_FI02" 12908 "GD_ID_WBZ_AUXIO1_08_FI02" 12909 "GD_ID_WBZ_AUXIO1_09_FI02" 12910 "GD_ID_WBZ_AUXIO1_10_FI02" 12911 "GD_ID_WBZ_AUXIO1_11_FI02" 12912 "GD_ID_WBZ_AUXIO1_12_FI02" 12917 "GD_ID_WBZ_AUXIO2_17_FI02" 12918 "GD_ID_WBZ_AUXIO2_18_FI02" 12919 "GD_ID_WBZ_AUXIO1_01_FI00" 12920 "GD_ID_WBZ_AUXIO1_02_FI00" 12921 "GD_ID_WBZ_AUXIO1_03_FI00" 12922 "GD_ID_WBZ_AUXIO1_04_FI00" 12923 "GD_ID_WBZ_AUXIO1_05_FI00" 12924 "GD_ID_WBZ_AUXIO1_06_FI00" 12925 "GD_ID_WBZ_AUXIO1_07_FI00" 12926 "GD_ID_WBZ_AUXIO1_08_FI00" 12927 "GD_ID_WBZ_AUXIO1_09_FI00" 12928 "GD_ID_WBZ_AUXIO1_10_FI00" 12929 "GD_ID_WBZ_AUXIO1_11_FI00" 12930 "GD_ID_WBZ_AUXIO1_12_FI00" 12931 "GD_ID_WBZ_AUXIO1_13_FI00" 12932 "GD_ID_WBZ_AUXIO1_14_FI00" 12933 "GD_ID_WBZ_AUXIO1_15_FI00" 12934 "GD_ID_WBZ_AUXIO1_16_FI00" 12935 "GD_ID_WBZ_AUXIO1_CH2" 12936 "GD_ID_WBZ_AUXIO2_17_FI00" 12937 "GD_ID_WBZ_AUXIO2_18_FI00" 12940 "GD_ID_WBZ_AUXIO2_21_FI00" 12941 "GD_ID_WBZ_AUXIO2_22_FI00" 12945 "GD_ID_WBZ_AUXIO2_26_FI00" 12946 "GD_ID_WBZ_AUXIO2_27_FI00" 12947 "GD_ID_WBZ_AUXIO2_28_FI00" 12948 "GD_ID_WBZ_AUXIO2_29_FI00" 12949 "GD_ID_WBZ_AUXIO2_30_FI00" 12950 "GD_ID_WBZ_AUXIO2_31_FI00" 12951 "GD_ID_WBZ_AUXIO2_32_FI00" 12952 "GD_ID_WBZ_AUXIO1_01_FI01" 12953 "GD_ID_WBZ_AUXIO1_02_FI01" 12954 "GD_ID_WBZ_AUXIO1_03_FI01" 12955 "GD_ID_WBZ_AUXIO1_04_FI01" 12956 "GD_ID_WBZ_AUXIO1_05_FI01" 12957 "GD_ID_WBZ_AUXIO1_06_FI01" 12958 "GD_ID_WBZ_AUXIO1_07_FI01" 12959 "GD_ID_WBZ_AUXIO1_08_FI01" 12960 "GD_ID_WBZ_AUXIO1_09_FI01" 12961 "GD_ID_WBZ_AUXIO1_10_FI01" 12962 "GD_ID_WBZ_AUXIO1_11_FI01" 12963 "GD_ID_WBZ_AUXIO1_12_FI01" 12964 "GD_ID_WBZ_AUXIO1_13_FI01" 12965 "GD_ID_WBZ_AUXIO1_14_FI01" 12966 "GD_ID_WBZ_AUXIO1_15_FI01" 12967 "GD_ID_WBZ_AUXIO1_16_FI01" 12969 "GD_ID_WBZ_AUXIO2_17_FI01" 12970 "GD_ID_WBZ_AUXIO2_18_FI01" 12973 "GD_ID_WBZ_AUXIO2_21_FI01" 12974 "GD_ID_WBZ_AUXIO2_22_FI01" 12978 "GD_ID_WBZ_AUXIO2_26_FI01" 12979 "GD_ID_WBZ_AUXIO2_27_FI01" 12980 "GD_ID_WBZ_AUXIO2_28_FI01" 12981 "GD_ID_WBZ_AUXIO2_29_FI01" 12982 "GD_ID_WBZ_AUXIO2_30_FI01" 12983 "GD_ID_WBZ_AUXIO2_31_FI01" 12984 "GD_ID_WBZ_AUXIO2_32_FI01" 12985 "GD_ID_WBZ_AUXIO2_21_FI02" 12986 "GD_ID_WBZ_AUXIO2_22_FI02" 13000 "GD_ID_WBZ_TI_ACCESS" 13052 "GD_ID_Unknown_Engine_Error_Part1" 13053 "GD_ID_Unknown_Engine_Error_Part2" 13120 "GD_ID_WBZ_DPF_WARNING_LAMP_Status" 13120 "GD_ID_WBZ_DPF_WARNING_LAMP" 13121 "GD_ID_WBZ_DPF_HEST_LAMP_Status" 13121 "GD_ID_WBZ_DPF_HEST_LAMP" 13123 "GD_ID_WBZ_DPF_SOOT_ASH" 13124 "GD_ID_WBZ_DPF_HOURS_SINCE_REGEN" 13125 "GD_ID_WBZ_DPF_MINUTES_SINCE_REGEN" 13126 "GD_ID_WBZ_DPF_STATI" 13128 "GD_ID_WBZ_DPF_INHIBITED_STATI" 13129 "GD_ID_WBZ_DPF_CONTROL_REGEN" 13130 "GD_ID_WBZ_DPF_ENABLE_REGEN_Status" 13130 "GD_ID_WBZ_DPF_ENABLE_REGEN" 13294 "GD_ID_WBZ_ErrorManagement_Status" 13294 "GD_ID_WBZ_ErrorManagement" 13311 "GD_ID_WBZ_LifeMessage" 13824 "GD_ID_Current_Track_Width" 13825 "GD_ID_TA_Min_Track_Width" 13826 "GD_ID_Max_Track_Width" 13827 "GD_ID_Calib_State_Track_Width_Status" 13827 "GD_ID_Calib_State_Track_Width" 13828 "GD_ID_TA_Front_Axle_Width" 13829 "GD_ID_TA_Front_Track_Width" 13830 "GD_ID_TA_Rear_Axle_Width" 13831 "GD_ID_TA_Rear_Track_Width" 13832 "GD_ID_Track_Adjust_Errors_Status" 13832 "GD_ID_Track_Adjust_Errors" 13833 "GD_ID_TA_Calibration_Command" 13834 "GD_ID_TA_Calibration_State" 13835 "GD_ID_TA_MANUAL_IN_Status" 13835 "GD_ID_TA_MANUAL_IN" 13836 "GD_ID_TA_MANUAL_OUT_Status" 13836 "GD_ID_TA_MANUAL_OUT" 13839 "GD_ID_TA_Actual_Front_In_R_Status" 13839 "GD_ID_TA_Actual_Front_In_R" 13840 "GD_ID_TA_Actual_Front_Out_R_Status" 13840 "GD_ID_TA_Actual_Front_Out_R" 13841 "GD_ID_TA_Actual_Rear_In_R_Status" 13841 "GD_ID_TA_Actual_Rear_In_R" 13842 "GD_ID_TA_Actual_Rear_Out_R_Status" 13842 "GD_ID_TA_Actual_Rear_Out_R" 13843 "GD_ID_TA_Actual_Front_In_Status" 13843 "GD_ID_TA_Actual_Front_In" 13844 "GD_ID_TA_Actual_Front_Out_Status" 13844 "GD_ID_TA_Actual_Front_Out" 13845 "GD_ID_TA_Actual_Rear_In_Status" 13845 "GD_ID_TA_Actual_Rear_In" 13846 "GD_ID_TA_Actual_Rear_Out_Status" 13846 "GD_ID_TA_Actual_Rear_Out" 13847 "GD_ID_Track_Adjust_Equipped_Status" 13847 "GD_ID_Track_Adjust_Equipped" 13848 "GD_ID_TA_Min_Tire_Track_Width" 13849 "GD_ID_Current_Axle_Width" 13850 "GD_ID_TA_Operation_State_Status" 13850 "GD_ID_TA_Operation_State" 13851 "GD_ID_TA_In_Tolerance_Status" 13851 "GD_ID_TA_In_Tolerance" 13852 "GD_ID_TA_Auto_Enable_A_Status" 13852 "GD_ID_TA_Auto_Enable_A" 13853 "GD_ID_TA_Auto_Enable_B_Status" 13853 "GD_ID_TA_Auto_Enable_B" 13854 "GD_ID_TA_Auto_Enable_Dual_Status" 13854 "GD_ID_TA_Auto_Enable_Dual" 13855 "GD_ID_TA_Setpoint_A" 13856 "GD_ID_TA_Setpoint_B" 13857 "GD_ID_TA_Setpoint_Dual_Front" 13858 "GD_ID_TA_Setpoint_Dual_Rear" 13864 "GD_ID_TA_Equipped_Status" 13864 "GD_ID_TA_Equipped" 13874 "GD_ID_TA_FL_POSITION" 13875 "GD_ID_TA_FR_POSITION" 13876 "GD_ID_TA_RL_POSITION" 13877 "GD_ID_TA_RR_POSITION" 13878 "GD_ID_TA_Setpoint_A_Rear_Status" 13878 "GD_ID_TA_Setpoint_A_Rear" 13879 "GD_ID_TA_Setpoint_B_Rear_Status" 13879 "GD_ID_TA_Setpoint_B_Rear" 13880 "GD_ID_TA_TARGET_TRACKWIDTH_FL" 13881 "GD_ID_TA_TARGET_TRACKWIDTH_FR" 13882 "GD_ID_TA_TARGET_TRACKWIDTH_RL" 13883 "GD_ID_TA_TARGET_TRACKWIDTH_RR" 13884 "GD_ID_TA_ADDITIONAL_WIDTH_FL" 13885 "GD_ID_TA_ADDITIONAL_WIDTH_FR" 13886 "GD_ID_TA_ADDITIONAL_WIDTH_RL" 13887 "GD_ID_TA_ADDITIONAL_WIDTH_RR" 14318 "GD_ID_TA_ErrorManagement_Status" 14318 "GD_ID_TA_ErrorManagement" 14335 "GD_ID_TA_LifeMessage" 15872 "GD_ID_EMM_SIGNAL_LN00_ERROR_W_Status" 15872 "GD_ID_EMM_SIGNAL_LN00_ERROR_W" 15873 "GD_ID_EMM_SIGNAL_LN01_ERROR_W_Status" 15873 "GD_ID_EMM_SIGNAL_LN01_ERROR_W" 15874 "GD_ID_EMM_SIGNAL_LN02_ERROR_W_Status" 15874 "GD_ID_EMM_SIGNAL_LN02_ERROR_W" 15875 "GD_ID_EMM_SIGNAL_LN03_ERROR_W_Status" 15875 "GD_ID_EMM_SIGNAL_LN03_ERROR_W" 15876 "GD_ID_EMM_SIGNAL_LN04_ERROR_W_Status" 15876 "GD_ID_EMM_SIGNAL_LN04_ERROR_W" 15877 "GD_ID_EMM_SIGNAL_LN05_ERROR_W_Status" 15877 "GD_ID_EMM_SIGNAL_LN05_ERROR_W" 15878 "GD_ID_EMM_SIGNAL_LN06_ERROR_W_Status" 15878 "GD_ID_EMM_SIGNAL_LN06_ERROR_W" 15879 "GD_ID_EMM_SIGNAL_LN07_ERROR_W_Status" 15879 "GD_ID_EMM_SIGNAL_LN07_ERROR_W" 15880 "GD_ID_EMM_SIGNAL_LN08_ERROR_W_Status" 15880 "GD_ID_EMM_SIGNAL_LN08_ERROR_W" 15881 "GD_ID_EMM_SIGNAL_LN09_ERROR_W_Status" 15881 "GD_ID_EMM_SIGNAL_LN09_ERROR_W" 15882 "GD_ID_EMM_SIGNAL_LN10_ERROR_W_Status" 15882 "GD_ID_EMM_SIGNAL_LN10_ERROR_W" 15883 "GD_ID_EMM_SIGNAL_LN11_ERROR_W_Status" 15883 "GD_ID_EMM_SIGNAL_LN11_ERROR_W" 15884 "GD_ID_EMM_SIGNAL_LN12_ERROR_W_Status" 15884 "GD_ID_EMM_SIGNAL_LN12_ERROR_W" 15885 "GD_ID_EMM_SIGNAL_LN13_ERROR_W_Status" 15885 "GD_ID_EMM_SIGNAL_LN13_ERROR_W" 15886 "GD_ID_EMM_SIGNAL_LN14_ERROR_W_Status" 15886 "GD_ID_EMM_SIGNAL_LN14_ERROR_W" 15887 "GD_ID_EMM_SIGNAL_LN15_ERROR_W_Status" 15887 "GD_ID_EMM_SIGNAL_LN15_ERROR_W" 15888 "GD_ID_EMM_SIGNAL_LN16_ERROR_W_Status" 15888 "GD_ID_EMM_SIGNAL_LN16_ERROR_W" 15889 "GD_ID_EMM_SIGNAL_LN17_ERROR_W_Status" 15889 "GD_ID_EMM_SIGNAL_LN17_ERROR_W" 15890 "GD_ID_EMM_SIGNAL_LN18_ERROR_W_Status" 15890 "GD_ID_EMM_SIGNAL_LN18_ERROR_W" 15891 "GD_ID_EMM_SIGNAL_LN19_ERROR_W_Status" 15891 "GD_ID_EMM_SIGNAL_LN19_ERROR_W" 15892 "GD_ID_EMM_SIGNAL_LN20_ERROR_W_Status" 15892 "GD_ID_EMM_SIGNAL_LN20_ERROR_W" 15893 "GD_ID_EMM_SIGNAL_LN21_ERROR_W_Status" 15893 "GD_ID_EMM_SIGNAL_LN21_ERROR_W" 15894 "GD_ID_EMM_SIGNAL_LN22_ERROR_W_Status" 15894 "GD_ID_EMM_SIGNAL_LN22_ERROR_W" 15895 "GD_ID_EMM_SIGNAL_LN23_ERROR_W_Status" 15895 "GD_ID_EMM_SIGNAL_LN23_ERROR_W" 15896 "GD_ID_EMM_SIGNAL_LN24_ERROR_W_Status" 15896 "GD_ID_EMM_SIGNAL_LN24_ERROR_W" 15897 "GD_ID_EMM_SIGNAL_LN25_ERROR_W_Status" 15897 "GD_ID_EMM_SIGNAL_LN25_ERROR_W" 15898 "GD_ID_EMM_SIGNAL_LN26_ERROR_W_Status" 15898 "GD_ID_EMM_SIGNAL_LN26_ERROR_W" 15899 "GD_ID_EMM_SIGNAL_LN27_ERROR_W_Status" 15899 "GD_ID_EMM_SIGNAL_LN27_ERROR_W" 15900 "GD_ID_EMM_SIGNAL_LN28_ERROR_W_Status" 15900 "GD_ID_EMM_SIGNAL_LN28_ERROR_W" 15901 "GD_ID_EMM_SIGNAL_LN29_ERROR_W_Status" 15901 "GD_ID_EMM_SIGNAL_LN29_ERROR_W" 15902 "GD_ID_EMM_SIGNAL_LN30_ERROR_W_Status" 15902 "GD_ID_EMM_SIGNAL_LN30_ERROR_W" 15903 "GD_ID_EMM_SIGNAL_LN31_ERROR_W_Status" 15903 "GD_ID_EMM_SIGNAL_LN31_ERROR_W" 15904 "GD_ID_EMM_SIGNAL_LN32_ERROR_W_Status" 15904 "GD_ID_EMM_SIGNAL_LN32_ERROR_W" 15905 "GD_ID_EMM_SIGNAL_LN33_ERROR_W_Status" 15905 "GD_ID_EMM_SIGNAL_LN33_ERROR_W" 15906 "GD_ID_EMM_SIGNAL_LN34_ERROR_W_Status" 15906 "GD_ID_EMM_SIGNAL_LN34_ERROR_W" 15907 "GD_ID_EMM_SIGNAL_LN35_ERROR_W_Status" 15907 "GD_ID_EMM_SIGNAL_LN35_ERROR_W" 15908 "GD_ID_EMM_SIGNAL_LN36_ERROR_W_Status" 15908 "GD_ID_EMM_SIGNAL_LN36_ERROR_W" 15909 "GD_ID_EMM_SIGNAL_LN37_ERROR_W_Status" 15909 "GD_ID_EMM_SIGNAL_LN37_ERROR_W" 15910 "GD_ID_EMM_SIGNAL_LN38_ERROR_W_Status" 15910 "GD_ID_EMM_SIGNAL_LN38_ERROR_W" 15911 "GD_ID_EMM_SIGNAL_LN39_ERROR_W_Status" 15911 "GD_ID_EMM_SIGNAL_LN39_ERROR_W" 15912 "GD_ID_EMM_SIGNAL_LN40_ERROR_W_Status" 15912 "GD_ID_EMM_SIGNAL_LN40_ERROR_W" 15913 "GD_ID_EMM_SIGNAL_LN41_ERROR_W_Status" 15913 "GD_ID_EMM_SIGNAL_LN41_ERROR_W" 15914 "GD_ID_EMM_SIGNAL_LN42_ERROR_W_Status" 15914 "GD_ID_EMM_SIGNAL_LN42_ERROR_W" 15915 "GD_ID_EMM_SIGNAL_LN43_ERROR_W_Status" 15915 "GD_ID_EMM_SIGNAL_LN43_ERROR_W" 15916 "GD_ID_EMM_SIGNAL_LN44_ERROR_W_Status" 15916 "GD_ID_EMM_SIGNAL_LN44_ERROR_W" 15917 "GD_ID_EMM_SIGNAL_LN45_ERROR_W_Status" 15917 "GD_ID_EMM_SIGNAL_LN45_ERROR_W" 15918 "GD_ID_EMM_SIGNAL_LN46_ERROR_W_Status" 15918 "GD_ID_EMM_SIGNAL_LN46_ERROR_W" 15919 "GD_ID_EMM_SIGNAL_LN47_ERROR_W_Status" 15919 "GD_ID_EMM_SIGNAL_LN47_ERROR_W" 15920 "GD_ID_EMM_SIGNAL_LN48_ERROR_W_Status" 15920 "GD_ID_EMM_SIGNAL_LN48_ERROR_W" 15921 "GD_ID_EMM_SIGNAL_LN49_ERROR_W_Status" 15921 "GD_ID_EMM_SIGNAL_LN49_ERROR_W" 15922 "GD_ID_EMM_SIGNAL_LN50_ERROR_W_Status" 15922 "GD_ID_EMM_SIGNAL_LN50_ERROR_W" 15923 "GD_ID_EMM_SIGNAL_LN51_ERROR_W_Status" 15923 "GD_ID_EMM_SIGNAL_LN51_ERROR_W" 15924 "GD_ID_EMM_SIGNAL_LN52_ERROR_W_Status" 15924 "GD_ID_EMM_SIGNAL_LN52_ERROR_W" 15925 "GD_ID_EMM_SIGNAL_LN53_ERROR_W_Status" 15925 "GD_ID_EMM_SIGNAL_LN53_ERROR_W" 15926 "GD_ID_EMM_SIGNAL_LN54_ERROR_W_Status" 15926 "GD_ID_EMM_SIGNAL_LN54_ERROR_W" 15927 "GD_ID_EMM_SIGNAL_LN55_ERROR_W_Status" 15927 "GD_ID_EMM_SIGNAL_LN55_ERROR_W" 15928 "GD_ID_EMM_SIGNAL_LN56_ERROR_W_Status" 15928 "GD_ID_EMM_SIGNAL_LN56_ERROR_W" 15929 "GD_ID_EMM_SIGNAL_LN57_ERROR_W_Status" 15929 "GD_ID_EMM_SIGNAL_LN57_ERROR_W" 15930 "GD_ID_EMM_SIGNAL_LN58_ERROR_W_Status" 15930 "GD_ID_EMM_SIGNAL_LN58_ERROR_W" 15931 "GD_ID_EMM_SIGNAL_LN59_ERROR_W_Status" 15931 "GD_ID_EMM_SIGNAL_LN59_ERROR_W" 15932 "GD_ID_EMM_SIGNAL_LN60_ERROR_W_Status" 15932 "GD_ID_EMM_SIGNAL_LN60_ERROR_W" 15933 "GD_ID_EMM_SIGNAL_LN61_ERROR_W_Status" 15933 "GD_ID_EMM_SIGNAL_LN61_ERROR_W" 15934 "GD_ID_EMM_SIGNAL_LN62_ERROR_W_Status" 15934 "GD_ID_EMM_SIGNAL_LN62_ERROR_W" 15935 "GD_ID_EMM_SIGNAL_LN63_ERROR_W_Status" 15935 "GD_ID_EMM_SIGNAL_LN63_ERROR_W" 15938 "GD_ID_EMM_TERMINAL_TRANSFER_R_Status" 15938 "GD_ID_EMM_TERMINAL_TRANSFER_R" 15939 "GD_ID_EMM_ACM_TRANSFER_R_Status" 15939 "GD_ID_EMM_ACM_TRANSFER_R" 15970 "GD_ID_EMM_TERMINAL_ACKNOWLEDGE_W_Status" 15970 "GD_ID_EMM_TERMINAL_ACKNOWLEDGE_W" 16000 "GD_ID_EMM_REQUEST_ENVVAR_W" 16001 "GD_ID_EMM_ENV_VAR_VALUE1" 16002 "GD_ID_EMM_ENV_VAR_VALUE2" 16003 "GD_ID_EMM_ENV_VAR_VALUE3" 16004 "GD_ID_EMM_ENV_VAR_VALUE4" 16005 "GD_ID_EMM_ENV_VAR_VALUE5" 16006 "GD_ID_EMM_ENV_VAR_OPERATING_HOUR" 16007 "GD_ID_EMM_ENV_VAR_ERROR_COUNTER" 16008 "GD_ID_EMM_ENV_VAR_DATE1" 16009 "GD_ID_EMM_ENV_VAR_DATE2" 16010 "GD_ID_EMM_ENV_VAR_TIME1" 16011 "GD_ID_EMM_ENV_VAR_TIME2" 16012 "GD_ID_EMM_ENV_VAR_STATUS" 16127 "GD_ID_EMM_DEBUG_SET_RESET_ERROR" 16128 "GD_ID_EMM_STATUS_R" 16172 "GD_ID_EMM_ERR_LOG_DELETED_Status" 16172 "GD_ID_EMM_ERR_LOG_DELETED" 16222 "GD_ID_EMM_ERR_ACTIVE_Status" 16222 "GD_ID_EMM_ERR_ACTIVE" 16366 "GD_ID_EMM_ErrorManagement_Status" 16366 "GD_ID_EMM_ErrorManagement" 16383 "GD_ID_EMM_LifeMessage" 28161 "GD_ID_4WS_REQUESTED_MODE" 28162 "GD_ID_4WS_CURRENT_MODE" 28166 "GD_ID_4WS_JOG_LEFT_Status" 28166 "GD_ID_4WS_JOG_LEFT" 28167 "GD_ID_4WS_JOG_RIGHT_Status" 28167 "GD_ID_4WS_JOG_RIGHT" 28168 "GD_ID_4WS_JOG_CLEAR_Status" 28168 "GD_ID_4WS_JOG_CLEAR" 28169 "GD_ID_4WS_JOG_ANGLE_Status" 28169 "GD_ID_4WS_JOG_ANGLE" 28175 "GD_ID_4WS_UI_FRONT_ANGLE_Status" 28175 "GD_ID_4WS_UI_FRONT_ANGLE" 28176 "GD_ID_4WS_UI_REAR_ANGLE_Status" 28176 "GD_ID_4WS_UI_REAR_ANGLE" 28178 "GD_ID_4WS_MACHINE_REAR_ANGLE" 28179 "GD_ID_4WS_REAR_ANGLE_SETPOINT" 28180 "GD_ID_4WS_REAR_ANGLE_SENSOR_VALUE" 28183 "GD_ID_4WS_CURRENT_CONTROL_KP_Status" 28183 "GD_ID_4WS_CURRENT_CONTROL_KP" 28184 "GD_ID_4WS_CURRENT_CONTROL_KI_Status" 28184 "GD_ID_4WS_CURRENT_CONTROL_KI" 28185 "GD_ID_4WS_REAR_ANGLE_TARGET_Status" 28185 "GD_ID_4WS_REAR_ANGLE_TARGET" 28186 "GD_ID_4WS_LEFT_PWM_Status" 28186 "GD_ID_4WS_LEFT_PWM" 28187 "GD_ID_4WS_RIGHT_PWM_Status" 28187 "GD_ID_4WS_RIGHT_PWM" 28191 "GD_ID_4WS_RIGHT_VALVE_COIL_CURRENT" 28192 "GD_ID_4WS_LEFT_VALVE_COIL_CURRENT" 28193 "GD_ID_4WS_ANGLE_CONTROL_KP_Status" 28193 "GD_ID_4WS_ANGLE_CONTROL_KP" 28194 "GD_ID_4WS_ANGLE_CONTROL_KI_Status" 28194 "GD_ID_4WS_ANGLE_CONTROL_KI" 28195 "GD_ID_4WS_TARGET_CURRENT_Status" 28195 "GD_ID_4WS_TARGET_CURRENT" 28196 "GD_ID_4WS_CURRENT_CONTROL_KC_Status" 28196 "GD_ID_4WS_CURRENT_CONTROL_KC" 28201 "GD_ID_4WS_COMMAND_CURRENT_Status" 28201 "GD_ID_4WS_COMMAND_CURRENT" 28202 "GD_ID_4WS_ACTIVE_CURRENT_LOOP" 28203 "GD_ID_4WS_UNFILTERED_REAR_ANGLE_Status" 28203 "GD_ID_4WS_UNFILTERED_REAR_ANGLE" 28210 "GD_ID_4WS_START_CURRENT_CALIB_COMMAND" 28211 "GD_ID_4WS_START_CURRENT_CALIB_STATUS" 28260 "GD_ID_4WS_REAR_ANGLE_CALIB_COMMAND" 28261 "GD_ID_4WS_REAR_ANGLE_CALIB_STATUS" 28654 "GD_ID_4WS_ErrorManagement_Status" 28654 "GD_ID_4WS_ErrorManagement" 28671 "GD_ID_4WS_LifeMessage" 6638 "GD_ID_DIAGNOSE_ErrorManagement_Status" 6638 "GD_ID_DIAGNOSE_ErrorManagement" 6655 "GD_ID_DIAGNOSE_LifeMessage" 16384 "GD_ID_CEAG_FIELD_HEADLAND_WIDTH_RW" 16385 "GD_ID_CEAG_FIELD_HEADLAND_DISTANCE_RW" 16400 "GD_ID_CEAG_IMPLEMENT_PATHTOPATHDISTANCE_RW" 16402 "GD_ID_CEAG_IMPLEMENT_LINKAGETYPE_RW" 16403 "GD_ID_CEAG_IMPLEMENT_LINKAGEFRONT_RW" 16404 "GD_ID_CEAG_IMPLEMENT_LINKAGEREAR_RW" 16405 "GD_ID_CEAG_IMPLEMENT_MINIMUMRADIUS_RW" 16406 "GD_ID_CEAG_IMPLEMENT_OFFSET_SETOFFSET_RW" 16407 "GD_ID_CEAG_IMPLEMENT_OFFSET_SETWORKINGWIDTH_RW" 16408 "GD_ID_CEAG_IMPLEMENT_OFFSET_STATUS_RW" 16416 "GD_ID_CEAG_COMMUNICATION_COMMAND_W" 16417 "GD_ID_CEAG_COMMUNICATION_COMMAND_STATUS_R" 16432 "GD_ID_CEAG_PATH_DATA_BLKRW" 16435 "GD_ID_CEAG_PATH_AB_ANGLE_RW" 16436 "GD_ID_CEAG_PATH_AB_DISTANCE_R" 16439 "GD_ID_CEAG_PATH_PIVOT_CENTERPOINT_ACCURACY_R" 16441 "GD_ID_CEAG_PATH_SEGMENT_ACTUAL_R" 16442 "GD_ID_CEAG_PATH_NUMBER_ACTUAL_R" 16443 "GD_ID_CEAG_PATH_LP_SLOPE_RW_Status" 16443 "GD_ID_CEAG_PATH_LP_SLOPE_RW" 16444 "GD_ID_CEAG_PATH_DATA_ACKNOWLEDGE_R_Status" 16444 "GD_ID_CEAG_PATH_DATA_ACKNOWLEDGE_R" 16448 "GD_ID_CEAG_NUDGEOFFSET_MANUAL_RW" 16449 "GD_ID_CEAG_NUDGEOFFSET_TOTAL_R_Status" 16449 "GD_ID_CEAG_NUDGEOFFSET_TOTAL_R" 16450 "GD_ID_CEAG_OFFSET_NORTH" 16451 "GD_ID_CEAG_OFFSET_EAST" 16464 "GD_ID_CEAG_AUTOTURN_SETTINGS_RW" 16465 "GD_ID_CEAG_AUTOTURN_DIMENSIONS_R" 16466 "GD_ID_CEAG_AUTOTURN_STATUS_R" 16471 "GD_ID_CEAG_STATUSPAGE_POSITION_GNSS_R_Status" 16471 "GD_ID_CEAG_STATUSPAGE_POSITION_GNSS_R" 16472 "GD_ID_CEAG_STATUSPAGE_CORRECTION_R_Status" 16472 "GD_ID_CEAG_STATUSPAGE_CORRECTION_R" 16473 "GD_ID_CEAG_STATUSPAGE_INERTIAL_R_Status" 16473 "GD_ID_CEAG_STATUSPAGE_INERTIAL_R" 16474 "GD_ID_CEAG_STATUSPAGE_STEERING_SUBSYSTEM_R_Status" 16474 "GD_ID_CEAG_STATUSPAGE_STEERING_SUBSYSTEM_R" 16475 "GD_ID_CEAG_STATUSPAGE_XTRK_R_Status" 16475 "GD_ID_CEAG_STATUSPAGE_XTRK_R" 16476 "GD_ID_CEAG_STATUSPAGE_HEADINGTOWAYLINE_R_Status" 16476 "GD_ID_CEAG_STATUSPAGE_HEADINGTOWAYLINE_R" 16477 "GD_ID_CEAG_STATUSPAGE_VELOCITY_R_Status" 16477 "GD_ID_CEAG_STATUSPAGE_VELOCITY_R" 16478 "GD_ID_CEAG_STATUSPAGE_CALIBRATION_R_Status" 16478 "GD_ID_CEAG_STATUSPAGE_CALIBRATION_R" 16479 "GD_ID_CEAG_STATUSPAGE_SYSTEM_R_Status" 16479 "GD_ID_CEAG_STATUSPAGE_SYSTEM_R" 16480 "GD_ID_CEAG_STATUS_XTRK_R_Status" 16480 "GD_ID_CEAG_STATUS_XTRK_R" 16481 "GD_ID_CEAG_STATUS_HEADING_R" 16482 "GD_ID_CEAG_STATUS_STEERING_R" 16483 "GD_ID_CEAG_STEERING_SENSITIVITY_LINEACQUISITION_RW" 16484 "GD_ID_CEAG_STEERING_SENSITIVITY_ONLINE_RW" 16485 "GD_ID_CEAG_SYSTEM_STANDBYTIME_RW" 16486 "GD_ID_CEAG_SYSTEM_POWERSUPPLY_INPUT_R" 16487 "GD_ID_CEAG_SYSTEM_POWERSUPPLY_OUTPUT_R" 16488 "GD_ID_CEAG_SYSTEM_ALTITUDE_GEOIDAL_SEPARATION_R" 16489 "GD_ID_CEAG_STEERING_DISENGAGE_REASON_R" 16496 "GD_ID_CEAG_GNSS_GPS_SATVISIBLE_R" 16497 "GD_ID_CEAG_GNSS_GPS_SATUSED_R" 16498 "GD_ID_CEAG_GNSS_GLONASS_SATVISIBLE_R" 16499 "GD_ID_CEAG_GNSS_GLONASS_SATUSED_R" 16500 "GD_ID_CEAG_GNSS_GALILEO_SATVISIBLE_R" 16501 "GD_ID_CEAG_GNSS_GALILEO_SATUSED_R" 16503 "GD_ID_CEAG_GNSS_VALIDPOSITION_R_Status" 16503 "GD_ID_CEAG_GNSS_VALIDPOSITION_R" 16504 "GD_ID_CEAG_GNSS_POSITION_ACTUAL_BLKR" 16505 "GD_ID_CEAG_GNSS_DOP_R" 16506 "GD_ID_CEAG_GNSS_TIME_HOURMINUTE_R" 16507 "GD_ID_CEAG_GNSS_TIME_SECOND_R" 16508 "GD_ID_CEAG_GNSS_ANTENNA_INSTALLATION_RW_Status" 16508 "GD_ID_CEAG_GNSS_ANTENNA_INSTALLATION_RW" 16509 "GD_ID_CEAG_GNSS_VELOCITY_R" 16510 "GD_ID_CEAG_GNSS_DISTANCE_R" 16519 "GD_ID_CEAG_CORRECTIONSIGNAL_RTKNETWORK_ROAMING_RW_Status" 16519 "GD_ID_CEAG_CORRECTIONSIGNAL_RTKNETWORK_ROAMING_RW" 16520 "GD_ID_CEAG_CORRECTIONSIGNAL_RTK_DUHF2_CHANNELSPACING_RW" 16521 "GD_ID_CEAG_CORRECTIONSIGNAL_RTK_DUHF2_PROTOCOL_RW" 16522 "GD_ID_CEAG_CORRECTIONSIGNAL_RTK_DUHF2_ERRORCORRECTION_RW" 16523 "GD_ID_CEAG_CORRECTIONSIGNAL_RTK_FH915_CHANNEL_RW" 16524 "GD_ID_CEAG_CORRECTIONSIGNAL_RTK_FH915_LOCATION_RW" 16525 "GD_ID_CEAG_CORRECTIONSIGNAL_RTK_FH915_NETWORKID_RW" 16526 "GD_ID_CEAG_CORRECTIONSIGNAL_OMNISTAR_FREQUENCY_HIGH_RW" 16527 "GD_ID_CEAG_CORRECTIONSIGNAL_OMNISTAR_FREQUENCY_LOW_RW" 16528 "GD_ID_CEAG_CORRECTIONSIGNAL_TYPE_SELECTED_RW" 16529 "GD_ID_CEAG_CORRECTIONSIGNAL_OMNISTAR_BAUDRATE_RW" 16530 "GD_ID_CEAG_CORRECTIONSIGNAL_VBS_EXPIRYDATE_DAYMONTH_R" 16531 "GD_ID_CEAG_CORRECTIONSIGNAL_BARGRAPH_R" 16532 "GD_ID_CEAG_CORRECTIONSIGNAL_VBS_EXPIRYDATE_YEAR_R" 16533 "GD_ID_CEAG_CORRECTIONSIGNAL_HP_XP_EXPIRYDATE_DAYMONTH_R" 16535 "GD_ID_CEAG_CORRECTIONSIGNAL_HP_XP_EXPIRYDATE_YEAR_R" 16536 "GD_ID_CEAG_CORRECTIONSIGNAL_STATUS_R_Status" 16536 "GD_ID_CEAG_CORRECTIONSIGNAL_STATUS_R" 16537 "GD_ID_CEAG_CORRECTIONSIGNAL_OMNISTAR_SERIALNUMBER_HIGH_R" 16538 "GD_ID_CEAG_CORRECTIONSIGNAL_OMNISTAR_SERIALNUMBER_LOW_R" 16539 "GD_ID_CEAG_CORRECTIONSIGNAL_RTK_AGCO_CHANNEL_RW" 16540 "GD_ID_CEAG_CORRECTIONSIGNAL_RTK_AGCO_FREQUENCY_HIGH_R" 16541 "GD_ID_CEAG_CORRECTIONSIGNAL_RTK_AGCO_FREQUENCY_LOW_R" 16542 "GD_ID_CEAG_CORRECTIONSIGNAL_RTK_AGCO_RADIOTYPE_R" 16543 "GD_ID_CEAG_CORRECTIONSIGNAL_RTK_EXTERNAL_SERIALINTERFACE_RW" 16544 "GD_ID_CEAG_CORRECTIONSIGNAL_RTK_RADIOINSTALLATION_RW_Status" 16544 "GD_ID_CEAG_CORRECTIONSIGNAL_RTK_RADIOINSTALLATION_RW" 16545 "GD_ID_CEAG_CORRECTIONSIGNAL_RTK_AGCO_CORRECTIONFORMAT_RW" 16546 "GD_ID_CEAG_CORRECTIONSIGNAL_RTK_EXTERNAL_CORRECTIONFORMAT_RW" 16547 "GD_ID_CEAG_CORRECTIONSIGNAL_RTK_GPS_SATVISIBLE_R" 16548 "GD_ID_CEAG_CORRECTIONSIGNAL_RTK_GPS_SATUSED_R" 16549 "GD_ID_CEAG_CORRECTIONSIGNAL_RTK_GLONASS_SATVISIBLE_R" 16550 "GD_ID_CEAG_CORRECTIONSIGNAL_RTK_GLONASS_SATUSED_R" 16551 "GD_ID_CEAG_CORRECTIONSIGNAL_RTK_GALILEO_SATVISIBLE_R" 16552 "GD_ID_CEAG_CORRECTIONSIGNAL_RTK_GALILEO_SATUSED_R" 16553 "GD_ID_CEAG_CORRECTIONSIGNAL_RTK_RADIO_CONFIGURABLE_R" 16554 "GD_ID_CEAG_CORRECTIONSIGNAL_RTK_BASELINE_R" 16555 "GD_ID_CEAG_CORRECTIONSIGNAL_SIGNALLAG_R" 16556 "GD_ID_CEAG_CORRECTIONSIGNAL_FALLBACK_RW_Status" 16556 "GD_ID_CEAG_CORRECTIONSIGNAL_FALLBACK_RW" 16557 "GD_ID_CEAG_CORRECTIONSIGNAL_ACCURACY_GNSSANTENNA_R" 16558 "GD_ID_CEAG_CORRECTIONSIGNAL_ACCURACY_VEHICLEREFERENCEPOINT_R" 16559 "GD_ID_CEAG_CORRECTIONSIGNAL_AUTHORISATIONLEVEL_R" 16560 "GD_ID_CEAG_CORRECTIONSIGNAL_RTKNETWORK_GSM_NUMBER_BLKRW" 16561 "GD_ID_CEAG_CORRECTIONSIGNAL_RTKNETWORK_GSM_PIN_BLKRW" 16562 "GD_ID_CEAG_CORRECTIONSIGNAL_RTKNETWORK_CORRECTIONFORMAT_RW_Status" 16562 "GD_ID_CEAG_CORRECTIONSIGNAL_RTKNETWORK_CORRECTIONFORMAT_RW" 16563 "GD_ID_CEAG_CORRECTIONSIGNAL_RTKNETWORK_GPRS_ACCESSPOINT_BLKRW" 16564 "GD_ID_CEAG_CORRECTIONSIGNAL_RTKNETWORK_GPRS_IPADDRESS_BLKRW" 16565 "GD_ID_CEAG_CORRECTIONSIGNAL_RTKNETWORK_GPRS_PORT_BLKRW" 16566 "GD_ID_CEAG_CORRECTIONSIGNAL_RTKNETWORK_GPRS_MOUNTPOINT_BLKRW" 16567 "GD_ID_CEAG_CORRECTIONSIGNAL_RTKNETWORK_GPRS_USERNAME_CONNECTIONPOVIDER_BLKRW" 16568 "GD_ID_CEAG_CORRECTIONSIGNAL_RTKNETWORK_GPRS_PASSWORD_CONNECTIONPROVIDER_BLKRW" 16569 "GD_ID_CEAG_CORRECTIONSIGNAL_RTKNETWORK_NMEA_DATA_RW" 16570 "GD_ID_CEAG_CORRECTIONSIGNAL_TYPE_ACTUAL_R" 16571 "GD_ID_CEAG_CORRECTIONSIGNAL_RTKNETWORK_GPRS_USERNAME_SIGNALPROVIDER_BLKRW" 16572 "GD_ID_CEAG_CORRECTIONSIGNAL_RTKNETWORK_GPRS_PASSWORD_SIGNALPROVIDER_BLKRW" 16573 "GD_ID_CEAG_CORRECTIONSIGNAL_RTKNETWORK_GSM_GPRS_CONNECTION_RW_Status" 16573 "GD_ID_CEAG_CORRECTIONSIGNAL_RTKNETWORK_GSM_GPRS_CONNECTION_RW" 16574 "GD_ID_CEAG_CORRECTIONSIGNAL_RTKNETWORK_GPRS_PIN_BLKRW" 16575 "GD_ID_CEAG_CORRECTIONSIGNAL_RTKNETWORK_MODE_RW_Status" 16575 "GD_ID_CEAG_CORRECTIONSIGNAL_RTKNETWORK_MODE_RW" 16576 "GD_ID_CEAG_NMEA_SERIALINTERFACE_RW" 16579 "GD_ID_CEAG_NMEA_DATA_1_RW" 16580 "GD_ID_CEAG_NMEA_DATA_2_RW" 16581 "GD_ID_CEAG_NMEA_DATA_3_RW" 16582 "GD_ID_CEAG_NMEA_DATA_4_RW" 16583 "GD_ID_CEAG_NMEA_DATA_5_RW" 16584 "GD_ID_CEAG_NMEA_OUTPUT_RW" 16606 "GD_ID_CEAG_SENSOR_IMU_ROLL_R_Status" 16606 "GD_ID_CEAG_SENSOR_IMU_ROLL_R" 16607 "GD_ID_CEAG_SENSOR_IMU_PITCH_R_Status" 16607 "GD_ID_CEAG_SENSOR_IMU_PITCH_R" 16608 "GD_ID_CEAG_SENSOR_IMU_YAW_R_Status" 16608 "GD_ID_CEAG_SENSOR_IMU_YAW_R" 16609 "GD_ID_CEAG_SENSOR_IMU_MOUNTINGBIAS_R_Status" 16609 "GD_ID_CEAG_SENSOR_IMU_MOUNTINGBIAS_R" 16610 "GD_ID_CEAG_SENSOR_IMU_DHEADING_R" 16611 "GD_ID_CEAG_SENSOR_IMU_WARMING_TIME_R_Status" 16611 "GD_ID_CEAG_SENSOR_IMU_WARMING_TIME_R" 16612 "GD_ID_CEAG_SENSOR_IMU_CALIBRATION_TIME_R_Status" 16612 "GD_ID_CEAG_SENSOR_IMU_CALIBRATION_TIME_R" 16613 "GD_ID_CEAG_ID_FA_KALIB_IMU_SET_R" 16614 "GD_ID_CEAG_ID_FA_KALIB_IMU_GET_W" 16639 "GD_ID_CEAG_ID_GNSS_ANTENNA_TYPE_R" 16640 "GD_ID_CEAG_ID_GNSS_ANTENNA_MODEL_BLKR" 16641 "GD_ID_CEAG_ID_GNSS_ANTENNA_PSN_BLKR" 16642 "GD_ID_CEAG_ID_GNSS_ANTENNA_HWVERSION_BLKR" 16643 "GD_ID_CEAG_ID_GNSS_ANTENNA_SWVERSION_BLKR" 16644 "GD_ID_CEAG_ID_GNSS_ANTENNA_BOOTVERSION_BLKR" 16645 "GD_ID_CEAG_ID_GNSS_ANTENNA_COMPILE_DATE_BLKR" 16646 "GD_ID_CEAG_ID_GNSS_ANTENNA_AUTHCODE_BLKW" 16650 "GD_ID_CEAG_ID_CORRECTIONSIGNAL_NTRIP_DELAY_R" 16878 "GD_ID_CEAG_ErrorManagement_Status" 16878 "GD_ID_CEAG_ErrorManagement" 16895 "GD_ID_CEAG_LifeMessage" 27648 "GD_ID_HC_TARGET_STATE_Status" 27648 "GD_ID_HC_TARGET_STATE" 27649 "GD_ID_HC_MACHINE_STATE_Status" 27649 "GD_ID_HC_MACHINE_STATE" 27650 "GD_ID_HC_LEG_STATE_FRONTLEFT" 27651 "GD_ID_HC_LEG_STATE_FRONTRIGHT" 27652 "GD_ID_HC_LEG_STATE_REARLEFT" 27653 "GD_ID_HC_LEG_STATE_REARRIGHT" 27654 "GD_ID_HC_TARGET_CLEARANCE_FL" 27655 "GD_ID_HC_TARGET_CLEARANCE_FR" 27656 "GD_ID_HC_TARGET_CLEARANCE_RL" 27657 "GD_ID_HC_TARGET_CLEARANCE_RR" 27658 "GD_ID_HC_ACTUAL_CLEARANCE_FL_Status" 27658 "GD_ID_HC_ACTUAL_CLEARANCE_FL" 27659 "GD_ID_HC_ACTUAL_CLEARANCE_FR_Status" 27659 "GD_ID_HC_ACTUAL_CLEARANCE_FR" 27660 "GD_ID_HC_ACTUAL_CLEARANCE_RL_Status" 27660 "GD_ID_HC_ACTUAL_CLEARANCE_RL" 27661 "GD_ID_HC_ACTUAL_CLEARANCE_RR_Status" 27661 "GD_ID_HC_ACTUAL_CLEARANCE_RR" 27662 "GD_ID_HC_STROKE_LEGNTH_RAW_FL" 27663 "GD_ID_HC_STROKE_LEGNTH_RAW_FR" 27664 "GD_ID_HC_STROKE_LEGNTH_RAW_RL" 27665 "GD_ID_HC_STROKE_LEGNTH_RAW_RR" 27666 "GD_ID_HC_OKAY_TO_TRANSITION" 27667 "GD_ID_HC_CYLINDER_PWM_EXTEND_FL" 27668 "GD_ID_HC_CYLINDER_PWM_EXTEND_FR" 27669 "GD_ID_HC_CYLINDER_PWM_EXTEND_RL" 27670 "GD_ID_HC_CYLINDER_PWM_EXTEND_RR" 27671 "GD_ID_HC_CYLINDER_PWM_RETRCT_FL" 27672 "GD_ID_HC_CYLINDER_PWM_RETRCT_FR" 27673 "GD_ID_HC_CYLINDER_PWM_RETRCT_RL" 27674 "GD_ID_HC_CYLINDER_PWM_RETRCT_RR" 27675 "GD_ID_HC_LADDER_EXTEND_Status" 27675 "GD_ID_HC_LADDER_EXTEND" 27676 "GD_ID_HC_REQUEST_CCO_OFF_Status" 27676 "GD_ID_HC_REQUEST_CCO_OFF" 27677 "GD_ID_HC_USER_WARNINGS" 27682 "GD_ID_HC_MOVEMENT_ERROR_FL" 27679 "GD_ID_HC_MOVEMENT_ERROR_FR" 27680 "GD_ID_HC_MOVEMENT_ERROR_RL" 27681 "GD_ID_HC_MOVEMENT_ERROR_RR" 27678 "GD_ID_HC_MANUAL_OVERRIDE_Status" 27678 "GD_ID_HC_MANUAL_OVERRIDE" 27683 "GD_ID_HC_CAL_STATE_Status" 27683 "GD_ID_HC_CAL_STATE" 27684 "GD_ID_HC_CAL_CMD" 27685 "GD_ID_HC_SENSOR_RAW_FL" 27686 "GD_ID_HC_SENSOR_RAW_FR" 27687 "GD_ID_HC_SENSOR_RAW_RL" 27688 "GD_ID_HC_SENSOR_RAW_RR" 27689 "GD_ID_HC_COIL_RAW_EXTEND_FL" 27690 "GD_ID_HC_COIL_RAW_RETRCT_FL" 27691 "GD_ID_HC_COIL_RAW_EXTEND_FR" 27692 "GD_ID_HC_COIL_RAW_RETRCT_FR" 27693 "GD_ID_HC_COIL_RAW_EXTEND_RL" 27694 "GD_ID_HC_COIL_RAW_RETRCT_RL" 27695 "GD_ID_HC_COIL_RAW_EXTEND_RR" 27696 "GD_ID_HC_COIL_RAW_RETRCT_RR" 27697 "GD_ID_HC_STROKE_LEGNTH_FILTER_FL_Status" 27697 "GD_ID_HC_STROKE_LEGNTH_FILTER_FL" 27698 "GD_ID_HC_STROKE_LEGNTH_FILTER_FR_Status" 27698 "GD_ID_HC_STROKE_LEGNTH_FILTER_FR" 27699 "GD_ID_HC_STROKE_LEGNTH_FILTER_RL_Status" 27699 "GD_ID_HC_STROKE_LEGNTH_FILTER_RL" 27700 "GD_ID_HC_STROKE_LEGNTH_FILTER_RR_Status" 27700 "GD_ID_HC_STROKE_LEGNTH_FILTER_RR" 28142 "GD_ID_HC_ErrorManagement_Status" 28142 "GD_ID_HC_ErrorManagement" 28159 "GD_ID_HC_LifeMessage" 32480 "GD_ID_ACM_BT_SERVER_ADDR_ROUTER_Status" 32480 "GD_ID_ACM_BT_SERVER_ADDR_ROUTER" 32750 "GD_ID_ACM_ErrorManagement_Status" 32750 "GD_ID_ACM_ErrorManagement" 32767 "GD_ID_ACM_LifeMessage"  ;
VAL_ 1559 DataIndex 1024 "GD_ID_NT01_Date_Year" 1025 "GD_ID_NT01_Date_Month" 1026 "GD_ID_NT01_Date_Day" 1027 "GD_ID_NT01_Date_WeekDay" 1028 "GD_ID_NT01_Time_Hours" 1029 "GD_ID_NT01_Time_Minutes" 1030 "GD_ID_NT01_Time_Seconds" 1045 "GD_ID_NT01_MainBoardTemp" 1056 "GD_ID_NT01_LightSensor_Status" 1056 "GD_ID_NT01_LightSensor" 1281 "GD_ID_NT01_Software_Version" 1282 "GD_ID_NT01_Software_Revision" 1283 "GD_ID_NT01_Build_Date_Day_Month" 1284 "GD_ID_NT01_Build_Date_Year" 1285 "GD_ID_NT01_Build_Time_Hrs_Min" 1286 "GD_ID_NT01_Build_Time_Seconds" 1036 "GD_ID_Time_Seconds" 1037 "GD_ID_Time_Hours_Minutes" 1038 "GD_ID_Date_Month_Day" 1039 "GD_ID_Date_Year" 1518 "GD_ID_NT01_ErrorManagement_Status" 1518 "GD_ID_NT01_ErrorManagement" 1535 "GD_ID_NT01_LifeMessage" 1536 "GD_ID_MFA_A19_Status" 1536 "GD_ID_MFA_A19" 1544 "GD_ID_MFA_A11_Status" 1544 "GD_ID_MFA_A11" 1545 "GD_ID_MFA_A11_LED" 1546 "GD_ID_MFA_A12_Status" 1546 "GD_ID_MFA_A12" 1547 "GD_ID_MFA_A12_LED" 1548 "GD_ID_MFA_A13_Status" 1548 "GD_ID_MFA_A13" 1549 "GD_ID_MFA_A13_LED" 1550 "GD_ID_MFA_A14_Status" 1550 "GD_ID_MFA_A14" 1551 "GD_ID_MFA_A14_LED" 1562 "GD_ID_MFA_A1_Status" 1562 "GD_ID_MFA_A1" 1563 "GD_ID_MFA_A2_Status" 1563 "GD_ID_MFA_A2" 1568 "GD_ID_MFA_A10_Status" 1568 "GD_ID_MFA_A10" 1569 "GD_ID_MFA_A8_Status" 1569 "GD_ID_MFA_A8" 1570 "GD_ID_MFA_A7_Status" 1570 "GD_ID_MFA_A7" 1571 "GD_ID_MFA_A24_Status" 1571 "GD_ID_MFA_A24" 1572 "GD_ID_MFA_A9_Status" 1572 "GD_ID_MFA_A9" 1573 "GD_ID_MFA_A26_Status" 1573 "GD_ID_MFA_A26" 1574 "GD_ID_MFA_A17_Status" 1574 "GD_ID_MFA_A17" 1575 "GD_ID_MFA_A18_Status" 1575 "GD_ID_MFA_A18" 1576 "GD_ID_MFA_A15_Status" 1576 "GD_ID_MFA_A15" 1577 "GD_ID_MFA_A16_Status" 1577 "GD_ID_MFA_A16" 1578 "GD_ID_MFA_A3_Status" 1578 "GD_ID_MFA_A3" 1579 "GD_ID_MFA_A20_Status" 1579 "GD_ID_MFA_A20" 1580 "GD_ID_MFA_A5_Status" 1580 "GD_ID_MFA_A5" 1581 "GD_ID_MFA_A22_Status" 1581 "GD_ID_MFA_A22" 1582 "GD_ID_MFA_A4_Status" 1582 "GD_ID_MFA_A4" 1583 "GD_ID_MFA_A6_Status" 1583 "GD_ID_MFA_A6" 1584 "GD_ID_MFA_E1_Status" 1584 "GD_ID_MFA_E1" 1585 "GD_ID_MFA_E2_Status" 1585 "GD_ID_MFA_E2" 1586 "GD_ID_MFA_E3_Status" 1586 "GD_ID_MFA_E3" 1587 "GD_ID_MFA_E4_Status" 1587 "GD_ID_MFA_E4" 1590 "GD_ID_MFA_ZONE_D_ROCKER_1" 1591 "GD_ID_MFA_ZONE_D_LED_ROCKER_1" 1592 "GD_ID_MFA_ZONE_D_ROCKER_2" 1593 "GD_ID_MFA_ZONE_D_LED_ROCKER_2" 1594 "GD_ID_MFA_ZONE_D_ROCKER_3" 1595 "GD_ID_MFA_ZONE_D_LED_ROCKER_3" 1596 "GD_ID_MFA_ZONE_D_ROCKER_4" 1597 "GD_ID_MFA_ZONE_D_LED_ROCKER_4" 1598 "GD_ID_MFA_ZONE_D_ROCKER_5" 1599 "GD_ID_MFA_ZONE_D_LED_ROCKER_5" 1600 "GD_ID_MFA_B1_Status" 1600 "GD_ID_MFA_B1" 1601 "GD_ID_MFA_F1_Status" 1601 "GD_ID_MFA_F1" 1632 "GD_ID_MFA_C17_Status" 1632 "GD_ID_MFA_C17" 1633 "GD_ID_MFA_C17_LED" 1634 "GD_ID_MFA_C18_Status" 1634 "GD_ID_MFA_C18" 1635 "GD_ID_MFA_C18_LED" 1636 "GD_ID_MFA_C9_Status" 1636 "GD_ID_MFA_C9" 1637 "GD_ID_MFA_C9_LED" 1638 "GD_ID_MFA_C10_Status" 1638 "GD_ID_MFA_C10" 1639 "GD_ID_MFA_C10_LED" 1640 "GD_ID_MFA_C1_Status" 1640 "GD_ID_MFA_C1" 1641 "GD_ID_MFA_C1_LED" 1642 "GD_ID_MFA_C2_Status" 1642 "GD_ID_MFA_C2" 1643 "GD_ID_MFA_C2_LED" 1644 "GD_ID_MFA_ZONE_D_BUTTON_LEFT_INSIDE_Status" 1644 "GD_ID_MFA_ZONE_D_BUTTON_LEFT_INSIDE" 1645 "GD_ID_MFA_ZONE_D_LED_LEFT_INSIDE" 1646 "GD_ID_MFA_ZONE_D_BUTTON_LEFT_OUTSIDE_Status" 1646 "GD_ID_MFA_ZONE_D_BUTTON_LEFT_OUTSIDE" 1647 "GD_ID_MFA_ZONE_D_LED_LEFT_OUTSIDE" 1648 "GD_ID_MFA_C19_Status" 1648 "GD_ID_MFA_C19" 1649 "GD_ID_MFA_C19_LED" 1650 "GD_ID_MFA_C20_Status" 1650 "GD_ID_MFA_C20" 1651 "GD_ID_MFA_C20_LED" 1652 "GD_ID_MFA_C11_Status" 1652 "GD_ID_MFA_C11" 1653 "GD_ID_MFA_C11_LED" 1654 "GD_ID_MFA_C12_Status" 1654 "GD_ID_MFA_C12" 1655 "GD_ID_MFA_C12_LED" 1656 "GD_ID_MFA_C3_Status" 1656 "GD_ID_MFA_C3" 1657 "GD_ID_MFA_C3_LED" 1658 "GD_ID_MFA_C4_Status" 1658 "GD_ID_MFA_C4" 1659 "GD_ID_MFA_C4_LED" 1660 "GD_ID_MFA_ZONE_D_BUTTON_RIGHT_INSIDE_Status" 1660 "GD_ID_MFA_ZONE_D_BUTTON_RIGHT_INSIDE" 1661 "GD_ID_MFA_ZONE_D_LED_RIGHT_INSIDE" 1662 "GD_ID_MFA_ZONE_D_BUTTON_RIGHT_OUTSIDE_Status" 1662 "GD_ID_MFA_ZONE_D_BUTTON_RIGHT_OUTSIDE" 1663 "GD_ID_MFA_ZONE_D_LED_RIGHT_OUTSIDE" 1664 "GD_ID_MFA_C21_Status" 1664 "GD_ID_MFA_C21" 1665 "GD_ID_MFA_C21_LED" 1666 "GD_ID_MFA_C22_Status" 1666 "GD_ID_MFA_C22" 1667 "GD_ID_MFA_C22_LED" 1668 "GD_ID_MFA_C13_Status" 1668 "GD_ID_MFA_C13" 1669 "GD_ID_MFA_C13_LED" 1670 "GD_ID_MFA_C14_Status" 1670 "GD_ID_MFA_C14" 1671 "GD_ID_MFA_C14_LED" 1672 "GD_ID_MFA_C5_Status" 1672 "GD_ID_MFA_C5" 1673 "GD_ID_MFA_C5_LED" 1674 "GD_ID_MFA_C6_Status" 1674 "GD_ID_MFA_C6" 1675 "GD_ID_MFA_C6_LED" 1680 "GD_ID_MFA_C23_Status" 1680 "GD_ID_MFA_C23" 1681 "GD_ID_MFA_C23_LED" 1682 "GD_ID_MFA_C24_Status" 1682 "GD_ID_MFA_C24" 1683 "GD_ID_MFA_C24_LED" 1684 "GD_ID_MFA_C15_Status" 1684 "GD_ID_MFA_C15" 1685 "GD_ID_MFA_C15_LED" 1686 "GD_ID_MFA_C16_Status" 1686 "GD_ID_MFA_C16" 1687 "GD_ID_MFA_C16_LED" 1688 "GD_ID_MFA_C7_Status" 1688 "GD_ID_MFA_C7" 1689 "GD_ID_MFA_C7_LED" 1690 "GD_ID_MFA_C8_Status" 1690 "GD_ID_MFA_C8" 1691 "GD_ID_MFA_C8_LED" 1696 "GD_ID_MFA_FunctionLighting" 1697 "GD_ID_MFA_NightDesign" 1736 "GD_ID_MFA_Throttle_CalibCmd" 1737 "GD_ID_MFA_Throttle_CalibState" 1738 "GD_ID_MFA_UNKNOWN_Calibration_Cmd" 1739 "GD_ID_MFA_UNKNOWN_Calibration_Status" 1740 "GD_ID_LM1_CalibrationCommand" 1741 "GD_ID_LM1_CalibrationStatus" 1742 "GD_ID_MFA_Lever_CalibCmd" 1743 "GD_ID_MFA_Lever_CalibState" 1744 "GD_ID_LM3_CalibrationCommand" 1745 "GD_ID_LM3_CalibrationStatus" 1746 "GD_ID_LM4_CalibrationCommand" 1747 "GD_ID_LM4_CalibrationStatus" 2030 "GD_ID_MFA_ErrorManagement_Status" 2030 "GD_ID_MFA_ErrorManagement" 2032 "GD_ID_HwConfigMFA" 2033 "GD_ID_IdentificationModule" 2036 "GD_ID_MFA_SoftwareVersion" 2037 "GD_ID_SwVersionAJS" 2040 "GD_ID_SerialNumber1st" 2041 "GD_ID_SerialNumber2nd" 2047 "GD_ID_MFA_LifeMessage" 2049 "GD_ID_DRIVE_AIR_PRESSURE" 2050 "GD_ID_DRIVE_HYDRAULICS_ENABLE_Status" 2050 "GD_ID_DRIVE_HYDRAULICS_ENABLE" 2051 "GD_ID_DRIVE_REQUEST_HYD_ENABLE_OFF_Status" 2051 "GD_ID_DRIVE_REQUEST_HYD_ENABLE_OFF" 2052 "GD_ID_DRIVE_BRAKE_PEDAL_POSITION_A" 2053 "GD_ID_DRIVE_BRAKE_PEDAL_POSITION_B" 2054 "GD_ID_DRIVE_BRAKE_PEDAL_POSITION" 2055 "GD_ID_DRIVE_HYD_MOT_RPM_FR" 2056 "GD_ID_DRIVE_HYD_MOT_RPM_RR" 2057 "GD_ID_DRIVE_HYD_MOT_RPM_RL" 2058 "GD_ID_DRIVE_HYD_MOT_RPM_FL" 2061 "GD_ID_DRIVE_FORWARD_SS_DEFAULT_SPEED" 2062 "GD_ID_DRIVE_REVERSE_SS_DEFAULT_SPEED" 2063 "GD_ID_DRIVE_WHEEL_BASED_MACHINE_SPEED" 2064 "GD_ID_DRIVE_DANFOSS_IN_SV_STATE_COMMANDED_Status" 2064 "GD_ID_DRIVE_DANFOSS_IN_SV_STATE_COMMANDED" 2065 "GD_ID_DRIVE_DANFOSS_OUT_SV_STATE_ACTUAL_Status" 2065 "GD_ID_DRIVE_DANFOSS_OUT_SV_STATE_ACTUAL" 2066 "GD_ID_DRIVE_DANFOSS_IN_SV_SPEED" 2067 "GD_ID_DRIVE_DANFOSS_OUT_DRIVE_MODE_ACTUAL_Status" 2067 "GD_ID_DRIVE_DANFOSS_OUT_DRIVE_MODE_ACTUAL" 2068 "GD_ID_DRIVE_DANFOSS_IN_DRIVE_MODE_COMMANDED_Status" 2068 "GD_ID_DRIVE_DANFOSS_IN_DRIVE_MODE_COMMANDED" 2069 "GD_ID_DRIVE_SV_1_Status" 2069 "GD_ID_DRIVE_SV_1" 2070 "GD_ID_DRIVE_SV_2_Status" 2070 "GD_ID_DRIVE_SV_2" 2071 "GD_ID_DRIVE_SV_STATE" 2072 "GD_ID_DRIVE_MAX_ENGINE_DROP" 2076 "GD_ID_DRIVE_CALIB_STATE_BRAKE_PEDAL_Status" 2076 "GD_ID_DRIVE_CALIB_STATE_BRAKE_PEDAL" 2077 "GD_ID_DRIVE_MAX_SV_SPEED" 2078 "GD_ID_DRIVE_PRESSURE_A" 2079 "GD_ID_DRIVE_PRESSURE_B" 2080 "GD_ID_DRIVE_CHARGE_PRESSURE" 2084 "GD_ID_DRIVE_DASH_DISPLAYED_ENGINE_SPEED" 2085 "GD_ID_DRIVE_FRONT_STEER_ANGLE" 2086 "GD_ID_DRIVE_DANFOSS_OUT_PARKBRK_REQUEST_Status" 2086 "GD_ID_DRIVE_DANFOSS_OUT_PARKBRK_REQUEST" 2087 "GD_ID_DRIVE_DANFOSS_OUT_CCO_VALVE_REQUEST_Status" 2087 "GD_ID_DRIVE_DANFOSS_OUT_CCO_VALVE_REQUEST" 2088 "GD_ID_DRIVE_CCO_VALVE_COMMAND_Status" 2088 "GD_ID_DRIVE_CCO_VALVE_COMMAND" 2092 "GD_ID_DRIVE_TIRE_RCI" 2094 "GD_ID_DRIVE_DASH_DISPLAYED_MACHINE_SPEED2" 2095 "GD_ID_DRIVE_CARGO_OVER_WEIGHT_Status" 2095 "GD_ID_DRIVE_CARGO_OVER_WEIGHT" 2096 "GD_ID_DRIVE_ROGATOR_MACHINE_CONFIGURATION" 2097 "GD_ID_DRIVE_TIRE_ROLLING_CIRCUMFERENCE" 2098 "GD_ID_DRIVE_BRAKE_LIGHT_COMMAND_Status" 2098 "GD_ID_DRIVE_BRAKE_LIGHT_COMMAND" 2099 "GD_ID_DRIVE_TARGET_MACHINE_SPEED" 2100 "GD_ID_DRIVE_MAX_MACHINE_SPEED" 2101 "GD_ID_DRIVE_EXPECTED_MACHINE_SPEED" 2111 "GD_ID_DRIVE_CALIB_BRAKE_PEDAL_START_Status" 2111 "GD_ID_DRIVE_CALIB_BRAKE_PEDAL_START" 2112 "GD_ID_DRIVE_CALIB_BRAKE_PEDAL_ACTIVE_Status" 2112 "GD_ID_DRIVE_CALIB_BRAKE_PEDAL_ACTIVE" 2113 "GD_ID_DRIVE_CALIB_BRAKE_PEDAL_DOWN_Status" 2113 "GD_ID_DRIVE_CALIB_BRAKE_PEDAL_DOWN" 2114 "GD_ID_DRIVE_CALIB_BRAKE_PEDAL_DOWN_RET_Status" 2114 "GD_ID_DRIVE_CALIB_BRAKE_PEDAL_DOWN_RET" 2115 "GD_ID_DRIVE_CALIB_BRAKE_PEDAL_UP_Status" 2115 "GD_ID_DRIVE_CALIB_BRAKE_PEDAL_UP" 2116 "GD_ID_DRIVE_CALIB_BRAKE_PEDAL_UP_RET_Status" 2116 "GD_ID_DRIVE_CALIB_BRAKE_PEDAL_UP_RET" 2117 "GD_ID_DRIVE_CALIB_BRAKE_PEDAL_ACCEPT_Status" 2117 "GD_ID_DRIVE_CALIB_BRAKE_PEDAL_ACCEPT" 2118 "GD_ID_DRIVE_CALIB_BRAKE_PEDAL_DECLINE_Status" 2118 "GD_ID_DRIVE_CALIB_BRAKE_PEDAL_DECLINE" 2119 "GD_ID_DRIVE_CALIB_BRAKE_PEDAL_PROCESSED_Status" 2119 "GD_ID_DRIVE_CALIB_BRAKE_PEDAL_PROCESSED" 2120 "GD_ID_DRIVE_CALIB_BRAKE_PEDAL_ERROR_Status" 2120 "GD_ID_DRIVE_CALIB_BRAKE_PEDAL_ERROR" 2121 "GD_ID_DRIVE_FIELD_STREET_STATE" 2122 "GD_ID_DRIVE_DTM_ENALBED_IN_MANUAL_Status" 2122 "GD_ID_DRIVE_DTM_ENALBED_IN_MANUAL" 2123 "GD_ID_DRIVE_STATE" 2124 "GD_ID_DRIVE_DTM_MIN_RPM" 2125 "GD_ID_DRIVE_DTM_MAX_RPM" 2126 "GD_ID_DRIVE_DRIVEPUMP_A_COMCURRENT" 2127 "GD_ID_DRIVE_DRIVEPUMP_B_COMCURRENT" 2128 "GD_ID_DRIVE_HYD_MOT_FR_COMCURRENT" 2129 "GD_ID_DRIVE_HYD_MOT_RR_COMCURRENT" 2130 "GD_ID_DRIVE_HYD_MOT_RL_COMCURRENT" 2131 "GD_ID_DRIVE_HYD_MOT_FL_COMCURRENT" 2133 "GD_ID_DRIVE_HYDRAULIC_OIl_TEMP" 2135 "GD_ID_DRIVE_FUEL_LEVEL" 2137 "GD_ID_DRIVE_PARKBRAKE_COMMAND_Status" 2137 "GD_ID_DRIVE_PARKBRAKE_COMMAND" 2138 "GD_ID_DRIVE_OPERATION_MODE" 2139 "GD_ID_DRIVE_DRIVEPUMP_A_FEEDBACK_CURRENT" 2140 "GD_ID_DRIVE_DRIVEPUMP_B_FEEDBACK_CURRENT" 2141 "GD_ID_DRIVE_HYD_MOT_FR_FEEDBACK_CURRENT" 2142 "GD_ID_DRIVE_HYD_MOT_RR_FEEDBACK_CURRENT" 2143 "GD_ID_DRIVE_HYD_MOT_RL_FEEDBACK_CURRENT" 2144 "GD_ID_DRIVE_HYD_MOT_FL_FEEDBACK_CURRENT" 2150 "GD_ID_DRIVE_RADAR_SPEED" 2175 "GD_ID_DRIVE_DASH_DISPLAYED_PARK_BRAKE_LED_Status" 2175 "GD_ID_DRIVE_DASH_DISPLAYED_PARK_BRAKE_LED" 2192 "GD_ID_DRIVE_CURRENT_GEAR" 2193 "GD_ID_DRIVE_SELECTED_GEAR" 2194 "GD_ID_DRIVE_DRIVE_PEDAL_POSITION" 2207 "GD_ID_DRIVE_DASH_DISPLAYED_MACHINE_SPEED1" 2258 "GD_ID_DRIVE_DTM_COMMANDED_RPM" 2300 "GD_ID_DRIVE_DISPLAY_UNITS_Status" 2300 "GD_ID_DRIVE_DISPLAY_UNITS" 2348 "GD_ID_DRIVE_RESET_DEFAULT_PROFILES_Status" 2348 "GD_ID_DRIVE_RESET_DEFAULT_PROFILES" 2349 "GD_ID_DRIVE_LEVER_ACCEL_PROFILE" 2350 "GD_ID_DRIVE_LEVER_DECEL_PROFILE" 2351 "GD_ID_DRIVE_PEDAL_ACCEL_PROFILE" 2352 "GD_ID_DRIVE_PEDAL_DECEL_PROFILE" 2353 "GD_ID_DRIVE_SV_ACCELDECEL_PROFILE" 2355 "GD_ID_DRIVE_SHUTTLE_ACCELDECEL_PROFILE" 2373 "GD_ID_DRIVE_DANFOSS_IN_OUTFAULTS" 2374 "GD_ID_ASC_RAMP_RL_DECTM" 2375 "GD_ID_ASC_PID_FL_KIUP_ASC" 2376 "GD_ID_ASC_PID_FL_KIDOWN_ASC" 2377 "GD_ID_ASC_PID_FL_KPUP_ASC" 2378 "GD_ID_ASC_PID_FL_KPDOWN_ASC" 2379 "GD_ID_ASC_PID_FL_KDUP_ASC" 2380 "GD_ID_ASC_PID_FL_IRED" 2381 "GD_ID_ASC_INCHING_INCHMODE" 2382 "GD_ID_ASC_INCHING_TVOLINCH" 2383 "GD_ID_ASC_REFSPDDISABLE_ABS_MINREFSPD_MMSEC" 2384 "GD_ID_ASC_REFSPDDISABLE_ASC_MINREFSPD_MMSEC" 2385 "GD_ID_ASC_REFSPDDISABLE_ABS_DECRAMP60K" 2386 "GD_ID_ASC_FFPROFILES_REVBRAKINGFRONT_Y4_PTC2" 2387 "GD_ID_ASC_FFPROFILES_REVBRAKINGFRONT_Y5_PTC2" 2388 "GD_ID_ASC_FFPROFILES_REVBRAKINGFRONT_Y6_PTC2" 2389 "GD_ID_ASC_FFPROFILES_FWDBRAKINGREAR_Y5_PTC2_LD" 2390 "GD_ID_ASC_FFPROFILES_FWDBRAKINGREAR_Y5_PTC2" 2391 "GD_ID_ASC_FFPROFILES_FWDBRAKINGREAR_Y6_PTC2_LD" 2392 "GD_ID_ASC_FFPROFILES_FWDBRAKINGREAR_Y6_PTC2" 2393 "GD_ID_ASC_CORE_ASC_MINTOLERANCE_PCT2" 2394 "GD_ID_ASC_PID_RL_KDUP_ASC" 2395 "GD_ID_ASC_PID_RL_KPUP_ASC" 2396 "GD_ID_ASC_PID_RL_KPDN_ASC" 2397 "GD_ID_ASC_PID_RL_KIUP_ASC" 2398 "GD_ID_ASC_PID_RL_KIDN_ASC" 2399 "GD_ID_ASC_PID_RL_IRED" 2400 "GD_ID_BRK_Y5" 2401 "GD_ID_ENGADJLD_FILTERTM_MS" 2402 "GD_ID_ENGADJLD_Y4" 2403 "GD_ID_MV_I_INT_I_GAIN" 2404 "GD_ID_MISC_PR_PERACT_Y3" 2405 "GD_ID_MISC_PR_PERACT_Y4" 2406 "GD_ID_MISC_PR_PERACT_Y5" 2407 "GD_ID_ASC_Core_ABS_Ang_Y1_ptc2" 2408 "GD_ID_ASC_Core_ABS_Ang_Y2_ptc2" 2409 "GD_ID_ASC_Core_ABS_Ang_Y3_ptc2" 2410 "GD_ID_ASC_Core_ABS_Ang_Y4_ptc2" 2411 "GD_ID_ASC_Core_ABS_Ang_Y5_ptc2" 2412 "GD_ID_ASC_Core_ABS_MinTolerance_pct2" 2413 "GD_ID_ASC_Core_ASC_Ang_Y1_ptc2" 2414 "GD_ID_ASC_Core_ASC_Ang_Y2_ptc2" 2415 "GD_ID_ASC_Core_ASC_Ang_Y3_ptc2" 2416 "GD_ID_ASC_Core_ASC_Ang_Y4_ptc2" 2417 "GD_ID_ASC_Core_ASC_Ang_Y5_ptc2" 2458 "GD_ID_DRIVE_PEDAL_CAL_COMMAND_Status" 2458 "GD_ID_DRIVE_PEDAL_CAL_COMMAND" 2459 "GD_ID_DRIVE_PEDAL_CAL_STATE_Status" 2459 "GD_ID_DRIVE_PEDAL_CAL_STATE" 2460 "GD_ID_DRIVE_BRAKE_PEDAL_CAL_COMMAND_Status" 2460 "GD_ID_DRIVE_BRAKE_PEDAL_CAL_COMMAND" 2461 "GD_ID_DRIVE_BRAKE_PEDAL_CAL_STATE_Status" 2461 "GD_ID_DRIVE_BRAKE_PEDAL_CAL_STATE" 2462 "GD_ID_DRIVE_WAS_CAL_COMMAND_Status" 2462 "GD_ID_DRIVE_WAS_CAL_COMMAND" 2463 "GD_ID_DRIVE_WAS_CAL_STATE_Status" 2463 "GD_ID_DRIVE_WAS_CAL_STATE" 2464 "GD_ID_DRIVE_HYDRO_CAL_COMMAND_Status" 2464 "GD_ID_DRIVE_HYDRO_CAL_COMMAND" 2465 "GD_ID_DRIVE_HYDRO_CAL_STATE_Status" 2465 "GD_ID_DRIVE_HYDRO_CAL_STATE" 2468 "GD_ID_DRIVE_WHEEL_SPEED_CALIBRATION_COMMAND_Status" 2468 "GD_ID_DRIVE_WHEEL_SPEED_CALIBRATION_COMMAND" 2469 "GD_ID_DRIVE_WHEEL_SPEED_CALIBRATION_STATE_Status" 2469 "GD_ID_DRIVE_WHEEL_SPEED_CALIBRATION_STATE" 2470 "GD_ID_DRIVE_WHEEL_SPEED_CALIBRATION_USER_DISTANCE_Status" 2470 "GD_ID_DRIVE_WHEEL_SPEED_CALIBRATION_USER_DISTANCE" 2471 "GD_ID_DRIVE_RADAR_CALIBRATION_COMMAND_Status" 2471 "GD_ID_DRIVE_RADAR_CALIBRATION_COMMAND" 2472 "GD_ID_DRIVE_RADAR_CALIBRATION_STATE_Status" 2472 "GD_ID_DRIVE_RADAR_CALIBRATION_STATE" 2473 "GD_ID_DRIVE_RADAR_CALIBRATION_USER_DISTANCE_Status" 2473 "GD_ID_DRIVE_RADAR_CALIBRATION_USER_DISTANCE" 2474 "GD_ID_DRIVE_COMBO_CALIBRATION_COMMAND_Status" 2474 "GD_ID_DRIVE_COMBO_CALIBRATION_COMMAND" 2475 "GD_ID_DRIVE_COMBO_CALIBRATION_STATE_Status" 2475 "GD_ID_DRIVE_COMBO_CALIBRATION_STATE" 2476 "GD_ID_DRIVE_COMBO_CALIBRATION_USER_DISTANCE_Status" 2476 "GD_ID_DRIVE_COMBO_CALIBRATION_USER_DISTANCE" 2498 "GD_ID_DRIVE_DRIVEPUMP_A_START_CAL_CURRENT_STORED" 2499 "GD_ID_DRIVE_DRIVEPUMP_A_END_CAL_CURRENT_STORED" 2500 "GD_ID_DRIVE_DRIVEPUMP_B_START_CAL_CURRENT_STORED" 2501 "GD_ID_DRIVE_DRIVEPUMP_B_END_CAL_CURRENT_STORED" 2502 "GD_ID_DRIVE_MOTOR_FL_START_CAL_CURRENT_STORED" 2503 "GD_ID_DRIVE_MOTOR_FL_END_CAL_CURRENT_STORED" 2504 "GD_ID_DRIVE_MOTOR_FR_START_CAL_CURRENT_STORED" 2505 "GD_ID_DRIVE_MOTOR_FR_END_CAL_CURRENT_STORED" 2506 "GD_ID_DRIVE_MOTOR_RL_START_CAL_CURRENT_STORED" 2507 "GD_ID_DRIVE_MOTOR_RL_END_CAL_CURRENT_STORED" 2508 "GD_ID_DRIVE_MOTOR_RR_START_CAL_CURRENT_STORED" 2509 "GD_ID_DRIVE_MOTOR_RR_END_CAL_CURRENT_STORED" 2510 "GD_ID_DRIVE_DRIVEPUMP_A_START_CAL_CURRENT_NEW" 2511 "GD_ID_DRIVE_DRIVEPUMP_A_END_CAL_CURRENT_NEW" 2512 "GD_ID_DRIVE_DRIVEPUMP_B_START_CAL_CURRENT_NEW" 2513 "GD_ID_DRIVE_DRIVEPUMP_B_END_CAL_CURRENT_NEW" 2514 "GD_ID_DRIVE_MOTOR_FL_START_CAL_CURRENT_NEW" 2515 "GD_ID_DRIVE_MOTOR_FL_END_CAL_CURRENT_NEW" 2516 "GD_ID_DRIVE_MOTOR_FR_START_CAL_CURRENT_NEW" 2517 "GD_ID_DRIVE_MOTOR_FR_END_CAL_CURRENT_NEW" 2518 "GD_ID_DRIVE_MOTOR_RL_START_CAL_CURRENT_NEW" 2519 "GD_ID_DRIVE_MOTOR_RL_END_CAL_CURRENT_NEW" 2520 "GD_ID_DRIVE_MOTOR_RR_START_CAL_CURRENT_NEW" 2521 "GD_ID_DRIVE_MOTOR_RR_END_CAL_CURRENT_NEW" 2523 "GD_ID_DRIVE_DANFOSS_CAL_REQUEST" 2525 "GD_ID_DRIVE_WHEEL_BASED_MACHINE_SPEED_KPH" 2526 "GD_ID_DRIVE_NORMALIZED_WHEEL_SPEED_FL" 2527 "GD_ID_DRIVE_NORMALIZED_WHEEL_SPEED_FR" 2528 "GD_ID_DRIVE_NORMALIZED_WHEEL_SPEED_RL" 2529 "GD_ID_DRIVE_NORMALIZED_WHEEL_SPEED_RR" 2530 "GD_ID_DRIVE_AIRBAG_DEFLATE_Status" 2530 "GD_ID_DRIVE_AIRBAG_DEFLATE" 2542 "GD_ID_DRIVE_ERRORMANAGEMENT_Status" 2542 "GD_ID_DRIVE_ERRORMANAGEMENT" 2559 "GD_ID_DRIVE_LIFEMESSAGE" 12288 "GD_ID_SCT_ENABLE" 12289 "GD_ID_SCT_MODUL_OUT_STATUS" 12290 "GD_ID_SCT_MODUL_IN_STATUS" 12298 "GD_ID_SCT_STATUSDISPLAY_TERMINAL" 12303 "GD_ID_SCT_TURNING_OFF_REASON" 12304 "GD_ID_SCT_STATE" 12305 "GD_ID_SCT_VOTED_ACTIVE_CLASS_1" 12306 "GD_ID_SCT_VOTED_ACTIVE_CLASS_2" 12312 "GD_ID_SCT_SETPOINT_Status" 12312 "GD_ID_SCT_SETPOINT" 12313 "GD_ID_SCT_SETPOINT_FEELER_GUIDANCE_Status" 12313 "GD_ID_SCT_SETPOINT_FEELER_GUIDANCE" 12314 "GD_ID_SCT_SETPOINT_CURVATURE_Status" 12314 "GD_ID_SCT_SETPOINT_CURVATURE" 12315 "GD_ID_SCT_SETPOINT_CURVATURE_TIM_Status" 12315 "GD_ID_SCT_SETPOINT_CURVATURE_TIM" 12316 "GD_ID_SCT_SETPOINT_CURVATURE_FEELER_GUIDANCE_Status" 12316 "GD_ID_SCT_SETPOINT_CURVATURE_FEELER_GUIDANCE" 12320 "GD_ID_SCT_WAS_RAW_VALUE" 12321 "GD_ID_SCT_WAS_SCALED_VALUE" 12322 "GD_ID_SCT_WAS_SENSOR_ANGLE" 12323 "GD_ID_SCT_WAS_MEDIAN_ANGLE" 12324 "GD_ID_SCT_WAS_MEDIAN_ANGLE_MAX" 12325 "GD_ID_SCT_WAS_VIRTUAL_ANGLE" 12328 "GD_ID_SCT_WAS_MEDIAN_CURVATURE" 12329 "GD_ID_SCT_WAS_MEDIAN_CURVATURE_MAX" 12334 "GD_ID_SCT_WAS_CALIB_COMMAND" 12335 "GD_ID_SCT_WAS_CALIB_STATUS" 12336 "GD_ID_SCT_SWS_RAW_VALUE_Status" 12336 "GD_ID_SCT_SWS_RAW_VALUE" 12338 "GD_ID_SCT_SWS_LIMITED_ANGLE_Status" 12338 "GD_ID_SCT_SWS_LIMITED_ANGLE" 12339 "GD_ID_SCT_SWS_CONTINUED_ANGLE_Status" 12339 "GD_ID_SCT_SWS_CONTINUED_ANGLE" 12340 "GD_ID_SCT_SWS_ROTATIONAL_SPEED" 12352 "GD_ID_SCT_VALVE_SETPOINT" 12353 "GD_ID_SCT_VALVE_POSITION" 12366 "GD_ID_SCT_VALVE_CALIB_COMMAND" 12367 "GD_ID_SCT_VALVE_CALIB_STATUS" 12368 "GD_ID_SCT_PILOTVALVE_STATUS_Status" 12368 "GD_ID_SCT_PILOTVALVE_STATUS" 12388 "GD_ID_SCT_OLAY_STEER_FACTOR" 12416 "GD_ID_SCT_HEADLAND_CMD_Status" 12416 "GD_ID_SCT_HEADLAND_CMD" 12417 "GD_ID_SCT_3RDPARTY_READY_STATUS_Status" 12417 "GD_ID_SCT_3RDPARTY_READY_STATUS" 12418 "GD_ID_SCT_3RDPARTY_POSITION_STATUS_Status" 12418 "GD_ID_SCT_3RDPARTY_POSITION_STATUS" 12419 "GD_ID_SCT_3RDPARTY_CANCEL_REQUEST_Status" 12419 "GD_ID_SCT_3RDPARTY_CANCEL_REQUEST" 12420 "GD_ID_SCT_3RDPARTY_COMMAND_GUIDANCE_Status" 12420 "GD_ID_SCT_3RDPARTY_COMMAND_GUIDANCE" 12544 "GD_ID_SCT_TSD_MIN_SPEED_FORWARD" 12545 "GD_ID_SCT_TSD_MAX_SPEED_FORWARD" 12546 "GD_ID_SCT_TSD_MIN_MACHINE_RADIUS" 12547 "GD_ID_SCT_TSD_MAX_ACQUISITION_ANGLE" 12560 "GD_ID_SCT_GUIDANCE_CONFIGURATION_DATA_Status" 12560 "GD_ID_SCT_GUIDANCE_CONFIGURATION_DATA" 12568 "GD_ID_SCT_STEERING_MODE_Status" 12568 "GD_ID_SCT_STEERING_MODE" 12569 "GD_ID_SCT_SECONDARY_WAS_RAW_VALUE_Status" 12569 "GD_ID_SCT_SECONDARY_WAS_RAW_VALUE" 12570 "GD_ID_SCT_SECONDARY_WAS_SENSOR_ANGLE_Status" 12570 "GD_ID_SCT_SECONDARY_WAS_SENSOR_ANGLE" 12571 "GD_ID_SCT_SECONDARY_WAS_MEDIAN_ANGLE_Status" 12571 "GD_ID_SCT_SECONDARY_WAS_MEDIAN_ANGLE" 12572 "GD_ID_SCT_SECONDARY_WAS_MEDIAN_ANGLE_MAX_Status" 12572 "GD_ID_SCT_SECONDARY_WAS_MEDIAN_ANGLE_MAX" 12573 "GD_ID_SCT_ALS_X_OFFSET_Status" 12573 "GD_ID_SCT_ALS_X_OFFSET" 12574 "GD_ID_SCT_ALS_Y_OFFSET_Status" 12574 "GD_ID_SCT_ALS_Y_OFFSET" 12575 "GD_ID_SCT_ADDITIONAL_WORKING_HEIGHT" 12576 "GD_ID_SCT_VEHICLE_CURRENT_PAYLOAD_Status" 12576 "GD_ID_SCT_VEHICLE_CURRENT_PAYLOAD" 12598 "GD_ID_SCT_ISO_STATE" 12599 "GD_ID_SCT_VEHICLE_SPEED_Status" 12599 "GD_ID_SCT_VEHICLE_SPEED" 12600 "GD_ID_SCT_VEHICLE_MOVEMENT_Status" 12600 "GD_ID_SCT_VEHICLE_MOVEMENT" 12601 "GD_ID_SCT_PARKING_BRAKE_Status" 12601 "GD_ID_SCT_PARKING_BRAKE" 12608 "GD_ID_SCT_CONTROL_MSG_TERMINAL" 12609 "GD_ID_SCT_CONTROL_MSG_GUIDEANCE" 12610 "GD_ID_SCT_MODIFIED_REFERENCE_POINT_HEIGHT" 12611 "GD_ID_SCT_MODIFIED_GNSS_ANTENNA_X_OFFSET" 12612 "GD_ID_SCT_MODIFIED_GNSS_ANTENNA_Y_OFFSET" 12613 "GD_ID_SCT_MODIFIED_GNSS_ANTENNA_Z_OFFSET" 12614 "GD_ID_SCT_MODIFIED_TRACK_WIDTH" 12615 "GD_ID_SCT_MODIFIED_MOUNTING_ERROR_Y_OFFSET" 12736 "GD_ID_SCT_TRACTOR_SN_TYPE" 12737 "GD_ID_SCT_TRACTOR_SN_GROUP" 12738 "GD_ID_SCT_TRACTOR_SN_NUMBER" 12782 "GD_ID_SCT_ERROR_ACKNOWLEDGE_Status" 12782 "GD_ID_SCT_ERROR_ACKNOWLEDGE" 12784 "GD_ID_SCT_ACTIVATE_DIAGNOSTICS" 12788 "GD_ID_SCT_SAFETY_VERSION_Status" 12788 "GD_ID_SCT_SAFETY_VERSION" 12789 "GD_ID_SCT_LIB_SAFETY_VERSION" 12792 "GD_ID_SCT_RECIPE_ACCESS_SETPOINT" 12793 "GD_ID_SCT_TI_ACCESS_SETPOINT" 12794 "GD_ID_SCT_TI_ACCESS_STATE" 12795 "GD_ID_SCT_TI_ACCESS_STATE_KL15" 12797 "GD_ID_SCT_TI_SUB_STATE" 12782 "GD_ID_SCT_ErrorManagement_Status" 12782 "GD_ID_SCT_ErrorManagement" 12799 "GD_ID_SCT_LifeMessage" 12800 "GD_ID_Engine_Rpm" 12801 "GD_ID_Engine_Load" 12802 "GD_ID_Engine_Coolant_Temp_Status" 12802 "GD_ID_Engine_Coolant_Temp" 12803 "GD_ID_Engine_Air_Intake_Temp" 12804 "GD_ID_Engine_Battery_Power_Status" 12804 "GD_ID_Engine_Battery_Power" 12805 "GD_ID_Engine_Air_Intake_Pressure" 12806 "GD_ID_Engine_Oil_Pressure" 12807 "GD_ID_Engine_Rpm_Setpoint_Status" 12807 "GD_ID_Engine_Rpm_Setpoint" 12808 "GD_ID_Engine_Standing_Still_Status" 12808 "GD_ID_Engine_Standing_Still" 12809 "GD_ID_Engine_Oil_Pressure_Low_Status" 12809 "GD_ID_Engine_Oil_Pressure_Low" 12810 "GD_ID_Engine_Oil_Service_Interval_Status" 12810 "GD_ID_Engine_Oil_Service_Interval" 12811 "GD_ID_Engine_Hours" 12812 "GD_ID_Engine_Amber_Warning_Lamp_Status" 12812 "GD_ID_Engine_Amber_Warning_Lamp" 12813 "GD_ID_Engine_Red_Stop_Lamp_Status" 12813 "GD_ID_Engine_Red_Stop_Lamp" 12814 "GD_ID_Alt_Low_Idle" 12815 "GD_ID_Engine_Audible_Warning_Status" 12815 "GD_ID_Engine_Audible_Warning" 12816 "GD_ID_Ambient_Temp" 12817 "GD_ID_Ecu_Temp" 12820 "GD_ID_Fuel_Rate" 12821 "GD_ID_Trip_Fuel" 12822 "GD_ID_Trip_DEF" 12823 "GD_ID_DEF_Level" 12824 "GD_ID_Water_In_Fuel_Status" 12824 "GD_ID_Water_In_Fuel" 12825 "GD_ID_Engine_Malfunction_Lamp_Status" 12825 "GD_ID_Engine_Malfunction_Lamp" 12826 "GD_ID_DEF_Level_Warning_Status" 12826 "GD_ID_DEF_Level_Warning" 12827 "GD_ID_Engine_WaitToStart_Status" 12827 "GD_ID_Engine_WaitToStart" 12828 "GD_ID_Engine_Operating_State" 12829 "GD_ID_Engine_Start_Enable_Status" 12829 "GD_ID_Engine_Start_Enable" 12830 "GD_ID_Implement_Transport_State_Status" 12830 "GD_ID_Implement_Transport_State" 12831 "GD_ID_Implement_Work_State_Status" 12831 "GD_ID_Implement_Work_State" 12832 "GD_ID_Implement_Actual_Working_Width" 12833 "GD_ID_Implement_Actual_Flow" 12834 "GD_ID_Implement_ReadyForFieldWork_Status" 12834 "GD_ID_Implement_ReadyForFieldWork" 12840 "GD_ID_WheelBasedDistance_km" 12841 "GD_ID_WheelBasedDistance_m" 12842 "GD_ID_GroundBasedDistance_km" 12843 "GD_ID_GroundBasedDistance_m" 12844 "GD_ID_SelectedSpeedDistance_km" 12845 "GD_ID_SelectedSpeedDistance_m" 12846 "GD_ID_MachineSelectedSpeed" 12847 "GD_ID_WBZ_MACHINE_SELECTED_SOURCE" 12848 "GD_ID_WBZ_MAX_ENG_RPM" 12850 "GD_ID_Working_Time_SecMin_VD" 12851 "GD_ID_Working_Time_Hours_VD" 12852 "GD_ID_Worked_Area_Ha_VD" 12853 "GD_ID_Worked_Area_0001Ha_VD" 12854 "GD_ID_Used_Fuel_VD" 12855 "GD_ID_Remaining_Time_SecMin_VD" 12856 "GD_ID_Remaining_Time_Hours_VD" 12857 "GD_ID_Remaining_Area_Ha_VD" 12858 "GD_ID_Remaining_Area_0001Ha_VD" 12859 "GD_ID_Required_Fuel_VD" 12860 "GD_ID_Field_Size_Ha_VD" 12861 "GD_ID_Field_Size_0001Ha_VD" 12862 "GD_ID_Reset_VD_Status" 12862 "GD_ID_Reset_VD" 12870 "GD_Iso_IsoState_state_RW" 12871 "GD_ID_WBZ_TERMINAL_PAGE_SIZE" 12878 "GD_ID_WBZ_ENG_DEF_LVL_LAMP_Status" 12878 "GD_ID_WBZ_ENG_DEF_LVL_LAMP" 12879 "GD_ID_WBZ_ENG_DEF_MIL_LAMP_Status" 12879 "GD_ID_WBZ_ENG_DEF_MIL_LAMP" 12880 "GD_ID_IgnitionState_Status" 12880 "GD_ID_IgnitionState" 12881 "GD_ID_WBZ_ENG_FAN_RPM" 12882 "GD_ID_WBZ_ENG_FUEL_TEMP" 12883 "GD_ID_WBZ_ENG_AUXIO1_01" 12884 "GD_ID_WBZ_ENG_FAN_DUTY_CYCLE" 12885 "GD_ID_WBZ_DEF_TEMP" 12886 "GD_ID_WBZ_EXHAUST_TEMP" 12887 "GD_ID_WBZ_FUEL_PRESSURE" 12888 "GD_ID_WBZ_CURVATURE_SETPOINT" 12889 "GD_ID_WBZ_CURVATURE_ENABLE_Status" 12889 "GD_ID_WBZ_CURVATURE_ENABLE" 12890 "GD_ID_WBZ_ENG_START_CMD_Status" 12890 "GD_ID_WBZ_ENG_START_CMD" 12891 "GD_ID_WBZ_THIRD_PARTY_MANUS_Status" 12891 "GD_ID_WBZ_THIRD_PARTY_MANUS" 12892 "GD_ID_WBZ_NEW_LEADER_ACL_Status" 12892 "GD_ID_WBZ_NEW_LEADER_ACL" 12901 "GD_ID_WBZ_AUXIO1_01_FI02" 12902 "GD_ID_WBZ_AUXIO1_02_FI02" 12903 "GD_ID_WBZ_AUXIO1_03_FI02" 12904 "GD_ID_WBZ_AUXIO1_04_FI02" 12905 "GD_ID_WBZ_AUXIO1_05_FI02" 12906 "GD_ID_WBZ_AUXIO1_06_FI02" 12907 "GD_ID_WBZ_AUXIO1_07_FI02" 12908 "GD_ID_WBZ_AUXIO1_08_FI02" 12909 "GD_ID_WBZ_AUXIO1_09_FI02" 12910 "GD_ID_WBZ_AUXIO1_10_FI02" 12911 "GD_ID_WBZ_AUXIO1_11_FI02" 12912 "GD_ID_WBZ_AUXIO1_12_FI02" 12917 "GD_ID_WBZ_AUXIO2_17_FI02" 12918 "GD_ID_WBZ_AUXIO2_18_FI02" 12919 "GD_ID_WBZ_AUXIO1_01_FI00" 12920 "GD_ID_WBZ_AUXIO1_02_FI00" 12921 "GD_ID_WBZ_AUXIO1_03_FI00" 12922 "GD_ID_WBZ_AUXIO1_04_FI00" 12923 "GD_ID_WBZ_AUXIO1_05_FI00" 12924 "GD_ID_WBZ_AUXIO1_06_FI00" 12925 "GD_ID_WBZ_AUXIO1_07_FI00" 12926 "GD_ID_WBZ_AUXIO1_08_FI00" 12927 "GD_ID_WBZ_AUXIO1_09_FI00" 12928 "GD_ID_WBZ_AUXIO1_10_FI00" 12929 "GD_ID_WBZ_AUXIO1_11_FI00" 12930 "GD_ID_WBZ_AUXIO1_12_FI00" 12931 "GD_ID_WBZ_AUXIO1_13_FI00" 12932 "GD_ID_WBZ_AUXIO1_14_FI00" 12933 "GD_ID_WBZ_AUXIO1_15_FI00" 12934 "GD_ID_WBZ_AUXIO1_16_FI00" 12935 "GD_ID_WBZ_AUXIO1_CH2" 12936 "GD_ID_WBZ_AUXIO2_17_FI00" 12937 "GD_ID_WBZ_AUXIO2_18_FI00" 12940 "GD_ID_WBZ_AUXIO2_21_FI00" 12941 "GD_ID_WBZ_AUXIO2_22_FI00" 12945 "GD_ID_WBZ_AUXIO2_26_FI00" 12946 "GD_ID_WBZ_AUXIO2_27_FI00" 12947 "GD_ID_WBZ_AUXIO2_28_FI00" 12948 "GD_ID_WBZ_AUXIO2_29_FI00" 12949 "GD_ID_WBZ_AUXIO2_30_FI00" 12950 "GD_ID_WBZ_AUXIO2_31_FI00" 12951 "GD_ID_WBZ_AUXIO2_32_FI00" 12952 "GD_ID_WBZ_AUXIO1_01_FI01" 12953 "GD_ID_WBZ_AUXIO1_02_FI01" 12954 "GD_ID_WBZ_AUXIO1_03_FI01" 12955 "GD_ID_WBZ_AUXIO1_04_FI01" 12956 "GD_ID_WBZ_AUXIO1_05_FI01" 12957 "GD_ID_WBZ_AUXIO1_06_FI01" 12958 "GD_ID_WBZ_AUXIO1_07_FI01" 12959 "GD_ID_WBZ_AUXIO1_08_FI01" 12960 "GD_ID_WBZ_AUXIO1_09_FI01" 12961 "GD_ID_WBZ_AUXIO1_10_FI01" 12962 "GD_ID_WBZ_AUXIO1_11_FI01" 12963 "GD_ID_WBZ_AUXIO1_12_FI01" 12964 "GD_ID_WBZ_AUXIO1_13_FI01" 12965 "GD_ID_WBZ_AUXIO1_14_FI01" 12966 "GD_ID_WBZ_AUXIO1_15_FI01" 12967 "GD_ID_WBZ_AUXIO1_16_FI01" 12969 "GD_ID_WBZ_AUXIO2_17_FI01" 12970 "GD_ID_WBZ_AUXIO2_18_FI01" 12973 "GD_ID_WBZ_AUXIO2_21_FI01" 12974 "GD_ID_WBZ_AUXIO2_22_FI01" 12978 "GD_ID_WBZ_AUXIO2_26_FI01" 12979 "GD_ID_WBZ_AUXIO2_27_FI01" 12980 "GD_ID_WBZ_AUXIO2_28_FI01" 12981 "GD_ID_WBZ_AUXIO2_29_FI01" 12982 "GD_ID_WBZ_AUXIO2_30_FI01" 12983 "GD_ID_WBZ_AUXIO2_31_FI01" 12984 "GD_ID_WBZ_AUXIO2_32_FI01" 12985 "GD_ID_WBZ_AUXIO2_21_FI02" 12986 "GD_ID_WBZ_AUXIO2_22_FI02" 13000 "GD_ID_WBZ_TI_ACCESS" 13052 "GD_ID_Unknown_Engine_Error_Part1" 13053 "GD_ID_Unknown_Engine_Error_Part2" 13120 "GD_ID_WBZ_DPF_WARNING_LAMP_Status" 13120 "GD_ID_WBZ_DPF_WARNING_LAMP" 13121 "GD_ID_WBZ_DPF_HEST_LAMP_Status" 13121 "GD_ID_WBZ_DPF_HEST_LAMP" 13123 "GD_ID_WBZ_DPF_SOOT_ASH" 13124 "GD_ID_WBZ_DPF_HOURS_SINCE_REGEN" 13125 "GD_ID_WBZ_DPF_MINUTES_SINCE_REGEN" 13126 "GD_ID_WBZ_DPF_STATI" 13128 "GD_ID_WBZ_DPF_INHIBITED_STATI" 13129 "GD_ID_WBZ_DPF_CONTROL_REGEN" 13130 "GD_ID_WBZ_DPF_ENABLE_REGEN_Status" 13130 "GD_ID_WBZ_DPF_ENABLE_REGEN" 13294 "GD_ID_WBZ_ErrorManagement_Status" 13294 "GD_ID_WBZ_ErrorManagement" 13311 "GD_ID_WBZ_LifeMessage" 13824 "GD_ID_Current_Track_Width" 13825 "GD_ID_TA_Min_Track_Width" 13826 "GD_ID_Max_Track_Width" 13827 "GD_ID_Calib_State_Track_Width_Status" 13827 "GD_ID_Calib_State_Track_Width" 13828 "GD_ID_TA_Front_Axle_Width" 13829 "GD_ID_TA_Front_Track_Width" 13830 "GD_ID_TA_Rear_Axle_Width" 13831 "GD_ID_TA_Rear_Track_Width" 13832 "GD_ID_Track_Adjust_Errors_Status" 13832 "GD_ID_Track_Adjust_Errors" 13833 "GD_ID_TA_Calibration_Command" 13834 "GD_ID_TA_Calibration_State" 13835 "GD_ID_TA_MANUAL_IN_Status" 13835 "GD_ID_TA_MANUAL_IN" 13836 "GD_ID_TA_MANUAL_OUT_Status" 13836 "GD_ID_TA_MANUAL_OUT" 13839 "GD_ID_TA_Actual_Front_In_R_Status" 13839 "GD_ID_TA_Actual_Front_In_R" 13840 "GD_ID_TA_Actual_Front_Out_R_Status" 13840 "GD_ID_TA_Actual_Front_Out_R" 13841 "GD_ID_TA_Actual_Rear_In_R_Status" 13841 "GD_ID_TA_Actual_Rear_In_R" 13842 "GD_ID_TA_Actual_Rear_Out_R_Status" 13842 "GD_ID_TA_Actual_Rear_Out_R" 13843 "GD_ID_TA_Actual_Front_In_Status" 13843 "GD_ID_TA_Actual_Front_In" 13844 "GD_ID_TA_Actual_Front_Out_Status" 13844 "GD_ID_TA_Actual_Front_Out" 13845 "GD_ID_TA_Actual_Rear_In_Status" 13845 "GD_ID_TA_Actual_Rear_In" 13846 "GD_ID_TA_Actual_Rear_Out_Status" 13846 "GD_ID_TA_Actual_Rear_Out" 13847 "GD_ID_Track_Adjust_Equipped_Status" 13847 "GD_ID_Track_Adjust_Equipped" 13848 "GD_ID_TA_Min_Tire_Track_Width" 13849 "GD_ID_Current_Axle_Width" 13850 "GD_ID_TA_Operation_State_Status" 13850 "GD_ID_TA_Operation_State" 13851 "GD_ID_TA_In_Tolerance_Status" 13851 "GD_ID_TA_In_Tolerance" 13852 "GD_ID_TA_Auto_Enable_A_Status" 13852 "GD_ID_TA_Auto_Enable_A" 13853 "GD_ID_TA_Auto_Enable_B_Status" 13853 "GD_ID_TA_Auto_Enable_B" 13854 "GD_ID_TA_Auto_Enable_Dual_Status" 13854 "GD_ID_TA_Auto_Enable_Dual" 13855 "GD_ID_TA_Setpoint_A" 13856 "GD_ID_TA_Setpoint_B" 13857 "GD_ID_TA_Setpoint_Dual_Front" 13858 "GD_ID_TA_Setpoint_Dual_Rear" 13864 "GD_ID_TA_Equipped_Status" 13864 "GD_ID_TA_Equipped" 13874 "GD_ID_TA_FL_POSITION" 13875 "GD_ID_TA_FR_POSITION" 13876 "GD_ID_TA_RL_POSITION" 13877 "GD_ID_TA_RR_POSITION" 13878 "GD_ID_TA_Setpoint_A_Rear_Status" 13878 "GD_ID_TA_Setpoint_A_Rear" 13879 "GD_ID_TA_Setpoint_B_Rear_Status" 13879 "GD_ID_TA_Setpoint_B_Rear" 13880 "GD_ID_TA_TARGET_TRACKWIDTH_FL" 13881 "GD_ID_TA_TARGET_TRACKWIDTH_FR" 13882 "GD_ID_TA_TARGET_TRACKWIDTH_RL" 13883 "GD_ID_TA_TARGET_TRACKWIDTH_RR" 13884 "GD_ID_TA_ADDITIONAL_WIDTH_FL" 13885 "GD_ID_TA_ADDITIONAL_WIDTH_FR" 13886 "GD_ID_TA_ADDITIONAL_WIDTH_RL" 13887 "GD_ID_TA_ADDITIONAL_WIDTH_RR" 14318 "GD_ID_TA_ErrorManagement_Status" 14318 "GD_ID_TA_ErrorManagement" 14335 "GD_ID_TA_LifeMessage" 15872 "GD_ID_EMM_SIGNAL_LN00_ERROR_W_Status" 15872 "GD_ID_EMM_SIGNAL_LN00_ERROR_W" 15873 "GD_ID_EMM_SIGNAL_LN01_ERROR_W_Status" 15873 "GD_ID_EMM_SIGNAL_LN01_ERROR_W" 15874 "GD_ID_EMM_SIGNAL_LN02_ERROR_W_Status" 15874 "GD_ID_EMM_SIGNAL_LN02_ERROR_W" 15875 "GD_ID_EMM_SIGNAL_LN03_ERROR_W_Status" 15875 "GD_ID_EMM_SIGNAL_LN03_ERROR_W" 15876 "GD_ID_EMM_SIGNAL_LN04_ERROR_W_Status" 15876 "GD_ID_EMM_SIGNAL_LN04_ERROR_W" 15877 "GD_ID_EMM_SIGNAL_LN05_ERROR_W_Status" 15877 "GD_ID_EMM_SIGNAL_LN05_ERROR_W" 15878 "GD_ID_EMM_SIGNAL_LN06_ERROR_W_Status" 15878 "GD_ID_EMM_SIGNAL_LN06_ERROR_W" 15879 "GD_ID_EMM_SIGNAL_LN07_ERROR_W_Status" 15879 "GD_ID_EMM_SIGNAL_LN07_ERROR_W" 15880 "GD_ID_EMM_SIGNAL_LN08_ERROR_W_Status" 15880 "GD_ID_EMM_SIGNAL_LN08_ERROR_W" 15881 "GD_ID_EMM_SIGNAL_LN09_ERROR_W_Status" 15881 "GD_ID_EMM_SIGNAL_LN09_ERROR_W" 15882 "GD_ID_EMM_SIGNAL_LN10_ERROR_W_Status" 15882 "GD_ID_EMM_SIGNAL_LN10_ERROR_W" 15883 "GD_ID_EMM_SIGNAL_LN11_ERROR_W_Status" 15883 "GD_ID_EMM_SIGNAL_LN11_ERROR_W" 15884 "GD_ID_EMM_SIGNAL_LN12_ERROR_W_Status" 15884 "GD_ID_EMM_SIGNAL_LN12_ERROR_W" 15885 "GD_ID_EMM_SIGNAL_LN13_ERROR_W_Status" 15885 "GD_ID_EMM_SIGNAL_LN13_ERROR_W" 15886 "GD_ID_EMM_SIGNAL_LN14_ERROR_W_Status" 15886 "GD_ID_EMM_SIGNAL_LN14_ERROR_W" 15887 "GD_ID_EMM_SIGNAL_LN15_ERROR_W_Status" 15887 "GD_ID_EMM_SIGNAL_LN15_ERROR_W" 15888 "GD_ID_EMM_SIGNAL_LN16_ERROR_W_Status" 15888 "GD_ID_EMM_SIGNAL_LN16_ERROR_W" 15889 "GD_ID_EMM_SIGNAL_LN17_ERROR_W_Status" 15889 "GD_ID_EMM_SIGNAL_LN17_ERROR_W" 15890 "GD_ID_EMM_SIGNAL_LN18_ERROR_W_Status" 15890 "GD_ID_EMM_SIGNAL_LN18_ERROR_W" 15891 "GD_ID_EMM_SIGNAL_LN19_ERROR_W_Status" 15891 "GD_ID_EMM_SIGNAL_LN19_ERROR_W" 15892 "GD_ID_EMM_SIGNAL_LN20_ERROR_W_Status" 15892 "GD_ID_EMM_SIGNAL_LN20_ERROR_W" 15893 "GD_ID_EMM_SIGNAL_LN21_ERROR_W_Status" 15893 "GD_ID_EMM_SIGNAL_LN21_ERROR_W" 15894 "GD_ID_EMM_SIGNAL_LN22_ERROR_W_Status" 15894 "GD_ID_EMM_SIGNAL_LN22_ERROR_W" 15895 "GD_ID_EMM_SIGNAL_LN23_ERROR_W_Status" 15895 "GD_ID_EMM_SIGNAL_LN23_ERROR_W" 15896 "GD_ID_EMM_SIGNAL_LN24_ERROR_W_Status" 15896 "GD_ID_EMM_SIGNAL_LN24_ERROR_W" 15897 "GD_ID_EMM_SIGNAL_LN25_ERROR_W_Status" 15897 "GD_ID_EMM_SIGNAL_LN25_ERROR_W" 15898 "GD_ID_EMM_SIGNAL_LN26_ERROR_W_Status" 15898 "GD_ID_EMM_SIGNAL_LN26_ERROR_W" 15899 "GD_ID_EMM_SIGNAL_LN27_ERROR_W_Status" 15899 "GD_ID_EMM_SIGNAL_LN27_ERROR_W" 15900 "GD_ID_EMM_SIGNAL_LN28_ERROR_W_Status" 15900 "GD_ID_EMM_SIGNAL_LN28_ERROR_W" 15901 "GD_ID_EMM_SIGNAL_LN29_ERROR_W_Status" 15901 "GD_ID_EMM_SIGNAL_LN29_ERROR_W" 15902 "GD_ID_EMM_SIGNAL_LN30_ERROR_W_Status" 15902 "GD_ID_EMM_SIGNAL_LN30_ERROR_W" 15903 "GD_ID_EMM_SIGNAL_LN31_ERROR_W_Status" 15903 "GD_ID_EMM_SIGNAL_LN31_ERROR_W" 15904 "GD_ID_EMM_SIGNAL_LN32_ERROR_W_Status" 15904 "GD_ID_EMM_SIGNAL_LN32_ERROR_W" 15905 "GD_ID_EMM_SIGNAL_LN33_ERROR_W_Status" 15905 "GD_ID_EMM_SIGNAL_LN33_ERROR_W" 15906 "GD_ID_EMM_SIGNAL_LN34_ERROR_W_Status" 15906 "GD_ID_EMM_SIGNAL_LN34_ERROR_W" 15907 "GD_ID_EMM_SIGNAL_LN35_ERROR_W_Status" 15907 "GD_ID_EMM_SIGNAL_LN35_ERROR_W" 15908 "GD_ID_EMM_SIGNAL_LN36_ERROR_W_Status" 15908 "GD_ID_EMM_SIGNAL_LN36_ERROR_W" 15909 "GD_ID_EMM_SIGNAL_LN37_ERROR_W_Status" 15909 "GD_ID_EMM_SIGNAL_LN37_ERROR_W" 15910 "GD_ID_EMM_SIGNAL_LN38_ERROR_W_Status" 15910 "GD_ID_EMM_SIGNAL_LN38_ERROR_W" 15911 "GD_ID_EMM_SIGNAL_LN39_ERROR_W_Status" 15911 "GD_ID_EMM_SIGNAL_LN39_ERROR_W" 15912 "GD_ID_EMM_SIGNAL_LN40_ERROR_W_Status" 15912 "GD_ID_EMM_SIGNAL_LN40_ERROR_W" 15913 "GD_ID_EMM_SIGNAL_LN41_ERROR_W_Status" 15913 "GD_ID_EMM_SIGNAL_LN41_ERROR_W" 15914 "GD_ID_EMM_SIGNAL_LN42_ERROR_W_Status" 15914 "GD_ID_EMM_SIGNAL_LN42_ERROR_W" 15915 "GD_ID_EMM_SIGNAL_LN43_ERROR_W_Status" 15915 "GD_ID_EMM_SIGNAL_LN43_ERROR_W" 15916 "GD_ID_EMM_SIGNAL_LN44_ERROR_W_Status" 15916 "GD_ID_EMM_SIGNAL_LN44_ERROR_W" 15917 "GD_ID_EMM_SIGNAL_LN45_ERROR_W_Status" 15917 "GD_ID_EMM_SIGNAL_LN45_ERROR_W" 15918 "GD_ID_EMM_SIGNAL_LN46_ERROR_W_Status" 15918 "GD_ID_EMM_SIGNAL_LN46_ERROR_W" 15919 "GD_ID_EMM_SIGNAL_LN47_ERROR_W_Status" 15919 "GD_ID_EMM_SIGNAL_LN47_ERROR_W" 15920 "GD_ID_EMM_SIGNAL_LN48_ERROR_W_Status" 15920 "GD_ID_EMM_SIGNAL_LN48_ERROR_W" 15921 "GD_ID_EMM_SIGNAL_LN49_ERROR_W_Status" 15921 "GD_ID_EMM_SIGNAL_LN49_ERROR_W" 15922 "GD_ID_EMM_SIGNAL_LN50_ERROR_W_Status" 15922 "GD_ID_EMM_SIGNAL_LN50_ERROR_W" 15923 "GD_ID_EMM_SIGNAL_LN51_ERROR_W_Status" 15923 "GD_ID_EMM_SIGNAL_LN51_ERROR_W" 15924 "GD_ID_EMM_SIGNAL_LN52_ERROR_W_Status" 15924 "GD_ID_EMM_SIGNAL_LN52_ERROR_W" 15925 "GD_ID_EMM_SIGNAL_LN53_ERROR_W_Status" 15925 "GD_ID_EMM_SIGNAL_LN53_ERROR_W" 15926 "GD_ID_EMM_SIGNAL_LN54_ERROR_W_Status" 15926 "GD_ID_EMM_SIGNAL_LN54_ERROR_W" 15927 "GD_ID_EMM_SIGNAL_LN55_ERROR_W_Status" 15927 "GD_ID_EMM_SIGNAL_LN55_ERROR_W" 15928 "GD_ID_EMM_SIGNAL_LN56_ERROR_W_Status" 15928 "GD_ID_EMM_SIGNAL_LN56_ERROR_W" 15929 "GD_ID_EMM_SIGNAL_LN57_ERROR_W_Status" 15929 "GD_ID_EMM_SIGNAL_LN57_ERROR_W" 15930 "GD_ID_EMM_SIGNAL_LN58_ERROR_W_Status" 15930 "GD_ID_EMM_SIGNAL_LN58_ERROR_W" 15931 "GD_ID_EMM_SIGNAL_LN59_ERROR_W_Status" 15931 "GD_ID_EMM_SIGNAL_LN59_ERROR_W" 15932 "GD_ID_EMM_SIGNAL_LN60_ERROR_W_Status" 15932 "GD_ID_EMM_SIGNAL_LN60_ERROR_W" 15933 "GD_ID_EMM_SIGNAL_LN61_ERROR_W_Status" 15933 "GD_ID_EMM_SIGNAL_LN61_ERROR_W" 15934 "GD_ID_EMM_SIGNAL_LN62_ERROR_W_Status" 15934 "GD_ID_EMM_SIGNAL_LN62_ERROR_W" 15935 "GD_ID_EMM_SIGNAL_LN63_ERROR_W_Status" 15935 "GD_ID_EMM_SIGNAL_LN63_ERROR_W" 15938 "GD_ID_EMM_TERMINAL_TRANSFER_R_Status" 15938 "GD_ID_EMM_TERMINAL_TRANSFER_R" 15939 "GD_ID_EMM_ACM_TRANSFER_R_Status" 15939 "GD_ID_EMM_ACM_TRANSFER_R" 15970 "GD_ID_EMM_TERMINAL_ACKNOWLEDGE_W_Status" 15970 "GD_ID_EMM_TERMINAL_ACKNOWLEDGE_W" 16000 "GD_ID_EMM_REQUEST_ENVVAR_W" 16001 "GD_ID_EMM_ENV_VAR_VALUE1" 16002 "GD_ID_EMM_ENV_VAR_VALUE2" 16003 "GD_ID_EMM_ENV_VAR_VALUE3" 16004 "GD_ID_EMM_ENV_VAR_VALUE4" 16005 "GD_ID_EMM_ENV_VAR_VALUE5" 16006 "GD_ID_EMM_ENV_VAR_OPERATING_HOUR" 16007 "GD_ID_EMM_ENV_VAR_ERROR_COUNTER" 16008 "GD_ID_EMM_ENV_VAR_DATE1" 16009 "GD_ID_EMM_ENV_VAR_DATE2" 16010 "GD_ID_EMM_ENV_VAR_TIME1" 16011 "GD_ID_EMM_ENV_VAR_TIME2" 16012 "GD_ID_EMM_ENV_VAR_STATUS" 16127 "GD_ID_EMM_DEBUG_SET_RESET_ERROR" 16128 "GD_ID_EMM_STATUS_R" 16172 "GD_ID_EMM_ERR_LOG_DELETED_Status" 16172 "GD_ID_EMM_ERR_LOG_DELETED" 16222 "GD_ID_EMM_ERR_ACTIVE_Status" 16222 "GD_ID_EMM_ERR_ACTIVE" 16366 "GD_ID_EMM_ErrorManagement_Status" 16366 "GD_ID_EMM_ErrorManagement" 16383 "GD_ID_EMM_LifeMessage" 28161 "GD_ID_4WS_REQUESTED_MODE" 28162 "GD_ID_4WS_CURRENT_MODE" 28166 "GD_ID_4WS_JOG_LEFT_Status" 28166 "GD_ID_4WS_JOG_LEFT" 28167 "GD_ID_4WS_JOG_RIGHT_Status" 28167 "GD_ID_4WS_JOG_RIGHT" 28168 "GD_ID_4WS_JOG_CLEAR_Status" 28168 "GD_ID_4WS_JOG_CLEAR" 28169 "GD_ID_4WS_JOG_ANGLE_Status" 28169 "GD_ID_4WS_JOG_ANGLE" 28175 "GD_ID_4WS_UI_FRONT_ANGLE_Status" 28175 "GD_ID_4WS_UI_FRONT_ANGLE" 28176 "GD_ID_4WS_UI_REAR_ANGLE_Status" 28176 "GD_ID_4WS_UI_REAR_ANGLE" 28178 "GD_ID_4WS_MACHINE_REAR_ANGLE" 28179 "GD_ID_4WS_REAR_ANGLE_SETPOINT" 28180 "GD_ID_4WS_REAR_ANGLE_SENSOR_VALUE" 28183 "GD_ID_4WS_CURRENT_CONTROL_KP_Status" 28183 "GD_ID_4WS_CURRENT_CONTROL_KP" 28184 "GD_ID_4WS_CURRENT_CONTROL_KI_Status" 28184 "GD_ID_4WS_CURRENT_CONTROL_KI" 28185 "GD_ID_4WS_REAR_ANGLE_TARGET_Status" 28185 "GD_ID_4WS_REAR_ANGLE_TARGET" 28186 "GD_ID_4WS_LEFT_PWM_Status" 28186 "GD_ID_4WS_LEFT_PWM" 28187 "GD_ID_4WS_RIGHT_PWM_Status" 28187 "GD_ID_4WS_RIGHT_PWM" 28191 "GD_ID_4WS_RIGHT_VALVE_COIL_CURRENT" 28192 "GD_ID_4WS_LEFT_VALVE_COIL_CURRENT" 28193 "GD_ID_4WS_ANGLE_CONTROL_KP_Status" 28193 "GD_ID_4WS_ANGLE_CONTROL_KP" 28194 "GD_ID_4WS_ANGLE_CONTROL_KI_Status" 28194 "GD_ID_4WS_ANGLE_CONTROL_KI" 28195 "GD_ID_4WS_TARGET_CURRENT_Status" 28195 "GD_ID_4WS_TARGET_CURRENT" 28196 "GD_ID_4WS_CURRENT_CONTROL_KC_Status" 28196 "GD_ID_4WS_CURRENT_CONTROL_KC" 28201 "GD_ID_4WS_COMMAND_CURRENT_Status" 28201 "GD_ID_4WS_COMMAND_CURRENT" 28202 "GD_ID_4WS_ACTIVE_CURRENT_LOOP" 28203 "GD_ID_4WS_UNFILTERED_REAR_ANGLE_Status" 28203 "GD_ID_4WS_UNFILTERED_REAR_ANGLE" 28210 "GD_ID_4WS_START_CURRENT_CALIB_COMMAND" 28211 "GD_ID_4WS_START_CURRENT_CALIB_STATUS" 28260 "GD_ID_4WS_REAR_ANGLE_CALIB_COMMAND" 28261 "GD_ID_4WS_REAR_ANGLE_CALIB_STATUS" 28654 "GD_ID_4WS_ErrorManagement_Status" 28654 "GD_ID_4WS_ErrorManagement" 28671 "GD_ID_4WS_LifeMessage" 6638 "GD_ID_DIAGNOSE_ErrorManagement_Status" 6638 "GD_ID_DIAGNOSE_ErrorManagement" 6655 "GD_ID_DIAGNOSE_LifeMessage" 16384 "GD_ID_CEAG_FIELD_HEADLAND_WIDTH_RW" 16385 "GD_ID_CEAG_FIELD_HEADLAND_DISTANCE_RW" 16400 "GD_ID_CEAG_IMPLEMENT_PATHTOPATHDISTANCE_RW" 16402 "GD_ID_CEAG_IMPLEMENT_LINKAGETYPE_RW" 16403 "GD_ID_CEAG_IMPLEMENT_LINKAGEFRONT_RW" 16404 "GD_ID_CEAG_IMPLEMENT_LINKAGEREAR_RW" 16405 "GD_ID_CEAG_IMPLEMENT_MINIMUMRADIUS_RW" 16406 "GD_ID_CEAG_IMPLEMENT_OFFSET_SETOFFSET_RW" 16407 "GD_ID_CEAG_IMPLEMENT_OFFSET_SETWORKINGWIDTH_RW" 16408 "GD_ID_CEAG_IMPLEMENT_OFFSET_STATUS_RW" 16416 "GD_ID_CEAG_COMMUNICATION_COMMAND_W" 16417 "GD_ID_CEAG_COMMUNICATION_COMMAND_STATUS_R" 16432 "GD_ID_CEAG_PATH_DATA_BLKRW" 16435 "GD_ID_CEAG_PATH_AB_ANGLE_RW" 16436 "GD_ID_CEAG_PATH_AB_DISTANCE_R" 16439 "GD_ID_CEAG_PATH_PIVOT_CENTERPOINT_ACCURACY_R" 16441 "GD_ID_CEAG_PATH_SEGMENT_ACTUAL_R" 16442 "GD_ID_CEAG_PATH_NUMBER_ACTUAL_R" 16443 "GD_ID_CEAG_PATH_LP_SLOPE_RW_Status" 16443 "GD_ID_CEAG_PATH_LP_SLOPE_RW" 16444 "GD_ID_CEAG_PATH_DATA_ACKNOWLEDGE_R_Status" 16444 "GD_ID_CEAG_PATH_DATA_ACKNOWLEDGE_R" 16448 "GD_ID_CEAG_NUDGEOFFSET_MANUAL_RW" 16449 "GD_ID_CEAG_NUDGEOFFSET_TOTAL_R_Status" 16449 "GD_ID_CEAG_NUDGEOFFSET_TOTAL_R" 16450 "GD_ID_CEAG_OFFSET_NORTH" 16451 "GD_ID_CEAG_OFFSET_EAST" 16464 "GD_ID_CEAG_AUTOTURN_SETTINGS_RW" 16465 "GD_ID_CEAG_AUTOTURN_DIMENSIONS_R" 16466 "GD_ID_CEAG_AUTOTURN_STATUS_R" 16471 "GD_ID_CEAG_STATUSPAGE_POSITION_GNSS_R_Status" 16471 "GD_ID_CEAG_STATUSPAGE_POSITION_GNSS_R" 16472 "GD_ID_CEAG_STATUSPAGE_CORRECTION_R_Status" 16472 "GD_ID_CEAG_STATUSPAGE_CORRECTION_R" 16473 "GD_ID_CEAG_STATUSPAGE_INERTIAL_R_Status" 16473 "GD_ID_CEAG_STATUSPAGE_INERTIAL_R" 16474 "GD_ID_CEAG_STATUSPAGE_STEERING_SUBSYSTEM_R_Status" 16474 "GD_ID_CEAG_STATUSPAGE_STEERING_SUBSYSTEM_R" 16475 "GD_ID_CEAG_STATUSPAGE_XTRK_R_Status" 16475 "GD_ID_CEAG_STATUSPAGE_XTRK_R" 16476 "GD_ID_CEAG_STATUSPAGE_HEADINGTOWAYLINE_R_Status" 16476 "GD_ID_CEAG_STATUSPAGE_HEADINGTOWAYLINE_R" 16477 "GD_ID_CEAG_STATUSPAGE_VELOCITY_R_Status" 16477 "GD_ID_CEAG_STATUSPAGE_VELOCITY_R" 16478 "GD_ID_CEAG_STATUSPAGE_CALIBRATION_R_Status" 16478 "GD_ID_CEAG_STATUSPAGE_CALIBRATION_R" 16479 "GD_ID_CEAG_STATUSPAGE_SYSTEM_R_Status" 16479 "GD_ID_CEAG_STATUSPAGE_SYSTEM_R" 16480 "GD_ID_CEAG_STATUS_XTRK_R_Status" 16480 "GD_ID_CEAG_STATUS_XTRK_R" 16481 "GD_ID_CEAG_STATUS_HEADING_R" 16482 "GD_ID_CEAG_STATUS_STEERING_R" 16483 "GD_ID_CEAG_STEERING_SENSITIVITY_LINEACQUISITION_RW" 16484 "GD_ID_CEAG_STEERING_SENSITIVITY_ONLINE_RW" 16485 "GD_ID_CEAG_SYSTEM_STANDBYTIME_RW" 16486 "GD_ID_CEAG_SYSTEM_POWERSUPPLY_INPUT_R" 16487 "GD_ID_CEAG_SYSTEM_POWERSUPPLY_OUTPUT_R" 16488 "GD_ID_CEAG_SYSTEM_ALTITUDE_GEOIDAL_SEPARATION_R" 16489 "GD_ID_CEAG_STEERING_DISENGAGE_REASON_R" 16496 "GD_ID_CEAG_GNSS_GPS_SATVISIBLE_R" 16497 "GD_ID_CEAG_GNSS_GPS_SATUSED_R" 16498 "GD_ID_CEAG_GNSS_GLONASS_SATVISIBLE_R" 16499 "GD_ID_CEAG_GNSS_GLONASS_SATUSED_R" 16500 "GD_ID_CEAG_GNSS_GALILEO_SATVISIBLE_R" 16501 "GD_ID_CEAG_GNSS_GALILEO_SATUSED_R" 16503 "GD_ID_CEAG_GNSS_VALIDPOSITION_R_Status" 16503 "GD_ID_CEAG_GNSS_VALIDPOSITION_R" 16504 "GD_ID_CEAG_GNSS_POSITION_ACTUAL_BLKR" 16505 "GD_ID_CEAG_GNSS_DOP_R" 16506 "GD_ID_CEAG_GNSS_TIME_HOURMINUTE_R" 16507 "GD_ID_CEAG_GNSS_TIME_SECOND_R" 16508 "GD_ID_CEAG_GNSS_ANTENNA_INSTALLATION_RW_Status" 16508 "GD_ID_CEAG_GNSS_ANTENNA_INSTALLATION_RW" 16509 "GD_ID_CEAG_GNSS_VELOCITY_R" 16510 "GD_ID_CEAG_GNSS_DISTANCE_R" 16519 "GD_ID_CEAG_CORRECTIONSIGNAL_RTKNETWORK_ROAMING_RW_Status" 16519 "GD_ID_CEAG_CORRECTIONSIGNAL_RTKNETWORK_ROAMING_RW" 16520 "GD_ID_CEAG_CORRECTIONSIGNAL_RTK_DUHF2_CHANNELSPACING_RW" 16521 "GD_ID_CEAG_CORRECTIONSIGNAL_RTK_DUHF2_PROTOCOL_RW" 16522 "GD_ID_CEAG_CORRECTIONSIGNAL_RTK_DUHF2_ERRORCORRECTION_RW" 16523 "GD_ID_CEAG_CORRECTIONSIGNAL_RTK_FH915_CHANNEL_RW" 16524 "GD_ID_CEAG_CORRECTIONSIGNAL_RTK_FH915_LOCATION_RW" 16525 "GD_ID_CEAG_CORRECTIONSIGNAL_RTK_FH915_NETWORKID_RW" 16526 "GD_ID_CEAG_CORRECTIONSIGNAL_OMNISTAR_FREQUENCY_HIGH_RW" 16527 "GD_ID_CEAG_CORRECTIONSIGNAL_OMNISTAR_FREQUENCY_LOW_RW" 16528 "GD_ID_CEAG_CORRECTIONSIGNAL_TYPE_SELECTED_RW" 16529 "GD_ID_CEAG_CORRECTIONSIGNAL_OMNISTAR_BAUDRATE_RW" 16530 "GD_ID_CEAG_CORRECTIONSIGNAL_VBS_EXPIRYDATE_DAYMONTH_R" 16531 "GD_ID_CEAG_CORRECTIONSIGNAL_BARGRAPH_R" 16532 "GD_ID_CEAG_CORRECTIONSIGNAL_VBS_EXPIRYDATE_YEAR_R" 16533 "GD_ID_CEAG_CORRECTIONSIGNAL_HP_XP_EXPIRYDATE_DAYMONTH_R" 16535 "GD_ID_CEAG_CORRECTIONSIGNAL_HP_XP_EXPIRYDATE_YEAR_R" 16536 "GD_ID_CEAG_CORRECTIONSIGNAL_STATUS_R_Status" 16536 "GD_ID_CEAG_CORRECTIONSIGNAL_STATUS_R" 16537 "GD_ID_CEAG_CORRECTIONSIGNAL_OMNISTAR_SERIALNUMBER_HIGH_R" 16538 "GD_ID_CEAG_CORRECTIONSIGNAL_OMNISTAR_SERIALNUMBER_LOW_R" 16539 "GD_ID_CEAG_CORRECTIONSIGNAL_RTK_AGCO_CHANNEL_RW" 16540 "GD_ID_CEAG_CORRECTIONSIGNAL_RTK_AGCO_FREQUENCY_HIGH_R" 16541 "GD_ID_CEAG_CORRECTIONSIGNAL_RTK_AGCO_FREQUENCY_LOW_R" 16542 "GD_ID_CEAG_CORRECTIONSIGNAL_RTK_AGCO_RADIOTYPE_R" 16543 "GD_ID_CEAG_CORRECTIONSIGNAL_RTK_EXTERNAL_SERIALINTERFACE_RW" 16544 "GD_ID_CEAG_CORRECTIONSIGNAL_RTK_RADIOINSTALLATION_RW_Status" 16544 "GD_ID_CEAG_CORRECTIONSIGNAL_RTK_RADIOINSTALLATION_RW" 16545 "GD_ID_CEAG_CORRECTIONSIGNAL_RTK_AGCO_CORRECTIONFORMAT_RW" 16546 "GD_ID_CEAG_CORRECTIONSIGNAL_RTK_EXTERNAL_CORRECTIONFORMAT_RW" 16547 "GD_ID_CEAG_CORRECTIONSIGNAL_RTK_GPS_SATVISIBLE_R" 16548 "GD_ID_CEAG_CORRECTIONSIGNAL_RTK_GPS_SATUSED_R" 16549 "GD_ID_CEAG_CORRECTIONSIGNAL_RTK_GLONASS_SATVISIBLE_R" 16550 "GD_ID_CEAG_CORRECTIONSIGNAL_RTK_GLONASS_SATUSED_R" 16551 "GD_ID_CEAG_CORRECTIONSIGNAL_RTK_GALILEO_SATVISIBLE_R" 16552 "GD_ID_CEAG_CORRECTIONSIGNAL_RTK_GALILEO_SATUSED_R" 16553 "GD_ID_CEAG_CORRECTIONSIGNAL_RTK_RADIO_CONFIGURABLE_R" 16554 "GD_ID_CEAG_CORRECTIONSIGNAL_RTK_BASELINE_R" 16555 "GD_ID_CEAG_CORRECTIONSIGNAL_SIGNALLAG_R" 16556 "GD_ID_CEAG_CORRECTIONSIGNAL_FALLBACK_RW_Status" 16556 "GD_ID_CEAG_CORRECTIONSIGNAL_FALLBACK_RW" 16557 "GD_ID_CEAG_CORRECTIONSIGNAL_ACCURACY_GNSSANTENNA_R" 16558 "GD_ID_CEAG_CORRECTIONSIGNAL_ACCURACY_VEHICLEREFERENCEPOINT_R" 16559 "GD_ID_CEAG_CORRECTIONSIGNAL_AUTHORISATIONLEVEL_R" 16560 "GD_ID_CEAG_CORRECTIONSIGNAL_RTKNETWORK_GSM_NUMBER_BLKRW" 16561 "GD_ID_CEAG_CORRECTIONSIGNAL_RTKNETWORK_GSM_PIN_BLKRW" 16562 "GD_ID_CEAG_CORRECTIONSIGNAL_RTKNETWORK_CORRECTIONFORMAT_RW_Status" 16562 "GD_ID_CEAG_CORRECTIONSIGNAL_RTKNETWORK_CORRECTIONFORMAT_RW" 16563 "GD_ID_CEAG_CORRECTIONSIGNAL_RTKNETWORK_GPRS_ACCESSPOINT_BLKRW" 16564 "GD_ID_CEAG_CORRECTIONSIGNAL_RTKNETWORK_GPRS_IPADDRESS_BLKRW" 16565 "GD_ID_CEAG_CORRECTIONSIGNAL_RTKNETWORK_GPRS_PORT_BLKRW" 16566 "GD_ID_CEAG_CORRECTIONSIGNAL_RTKNETWORK_GPRS_MOUNTPOINT_BLKRW" 16567 "GD_ID_CEAG_CORRECTIONSIGNAL_RTKNETWORK_GPRS_USERNAME_CONNECTIONPOVIDER_BLKRW" 16568 "GD_ID_CEAG_CORRECTIONSIGNAL_RTKNETWORK_GPRS_PASSWORD_CONNECTIONPROVIDER_BLKRW" 16569 "GD_ID_CEAG_CORRECTIONSIGNAL_RTKNETWORK_NMEA_DATA_RW" 16570 "GD_ID_CEAG_CORRECTIONSIGNAL_TYPE_ACTUAL_R" 16571 "GD_ID_CEAG_CORRECTIONSIGNAL_RTKNETWORK_GPRS_USERNAME_SIGNALPROVIDER_BLKRW" 16572 "GD_ID_CEAG_CORRECTIONSIGNAL_RTKNETWORK_GPRS_PASSWORD_SIGNALPROVIDER_BLKRW" 16573 "GD_ID_CEAG_CORRECTIONSIGNAL_RTKNETWORK_GSM_GPRS_CONNECTION_RW_Status" 16573 "GD_ID_CEAG_CORRECTIONSIGNAL_RTKNETWORK_GSM_GPRS_CONNECTION_RW" 16574 "GD_ID_CEAG_CORRECTIONSIGNAL_RTKNETWORK_GPRS_PIN_BLKRW" 16575 "GD_ID_CEAG_CORRECTIONSIGNAL_RTKNETWORK_MODE_RW_Status" 16575 "GD_ID_CEAG_CORRECTIONSIGNAL_RTKNETWORK_MODE_RW" 16576 "GD_ID_CEAG_NMEA_SERIALINTERFACE_RW" 16579 "GD_ID_CEAG_NMEA_DATA_1_RW" 16580 "GD_ID_CEAG_NMEA_DATA_2_RW" 16581 "GD_ID_CEAG_NMEA_DATA_3_RW" 16582 "GD_ID_CEAG_NMEA_DATA_4_RW" 16583 "GD_ID_CEAG_NMEA_DATA_5_RW" 16584 "GD_ID_CEAG_NMEA_OUTPUT_RW" 16606 "GD_ID_CEAG_SENSOR_IMU_ROLL_R_Status" 16606 "GD_ID_CEAG_SENSOR_IMU_ROLL_R" 16607 "GD_ID_CEAG_SENSOR_IMU_PITCH_R_Status" 16607 "GD_ID_CEAG_SENSOR_IMU_PITCH_R" 16608 "GD_ID_CEAG_SENSOR_IMU_YAW_R_Status" 16608 "GD_ID_CEAG_SENSOR_IMU_YAW_R" 16609 "GD_ID_CEAG_SENSOR_IMU_MOUNTINGBIAS_R_Status" 16609 "GD_ID_CEAG_SENSOR_IMU_MOUNTINGBIAS_R" 16610 "GD_ID_CEAG_SENSOR_IMU_DHEADING_R" 16611 "GD_ID_CEAG_SENSOR_IMU_WARMING_TIME_R_Status" 16611 "GD_ID_CEAG_SENSOR_IMU_WARMING_TIME_R" 16612 "GD_ID_CEAG_SENSOR_IMU_CALIBRATION_TIME_R_Status" 16612 "GD_ID_CEAG_SENSOR_IMU_CALIBRATION_TIME_R" 16613 "GD_ID_CEAG_ID_FA_KALIB_IMU_SET_R" 16614 "GD_ID_CEAG_ID_FA_KALIB_IMU_GET_W" 16639 "GD_ID_CEAG_ID_GNSS_ANTENNA_TYPE_R" 16640 "GD_ID_CEAG_ID_GNSS_ANTENNA_MODEL_BLKR" 16641 "GD_ID_CEAG_ID_GNSS_ANTENNA_PSN_BLKR" 16642 "GD_ID_CEAG_ID_GNSS_ANTENNA_HWVERSION_BLKR" 16643 "GD_ID_CEAG_ID_GNSS_ANTENNA_SWVERSION_BLKR" 16644 "GD_ID_CEAG_ID_GNSS_ANTENNA_BOOTVERSION_BLKR" 16645 "GD_ID_CEAG_ID_GNSS_ANTENNA_COMPILE_DATE_BLKR" 16646 "GD_ID_CEAG_ID_GNSS_ANTENNA_AUTHCODE_BLKW" 16650 "GD_ID_CEAG_ID_CORRECTIONSIGNAL_NTRIP_DELAY_R" 16878 "GD_ID_CEAG_ErrorManagement_Status" 16878 "GD_ID_CEAG_ErrorManagement" 16895 "GD_ID_CEAG_LifeMessage" 27648 "GD_ID_HC_TARGET_STATE_Status" 27648 "GD_ID_HC_TARGET_STATE" 27649 "GD_ID_HC_MACHINE_STATE_Status" 27649 "GD_ID_HC_MACHINE_STATE" 27650 "GD_ID_HC_LEG_STATE_FRONTLEFT" 27651 "GD_ID_HC_LEG_STATE_FRONTRIGHT" 27652 "GD_ID_HC_LEG_STATE_REARLEFT" 27653 "GD_ID_HC_LEG_STATE_REARRIGHT" 27654 "GD_ID_HC_TARGET_CLEARANCE_FL" 27655 "GD_ID_HC_TARGET_CLEARANCE_FR" 27656 "GD_ID_HC_TARGET_CLEARANCE_RL" 27657 "GD_ID_HC_TARGET_CLEARANCE_RR" 27658 "GD_ID_HC_ACTUAL_CLEARANCE_FL_Status" 27658 "GD_ID_HC_ACTUAL_CLEARANCE_FL" 27659 "GD_ID_HC_ACTUAL_CLEARANCE_FR_Status" 27659 "GD_ID_HC_ACTUAL_CLEARANCE_FR" 27660 "GD_ID_HC_ACTUAL_CLEARANCE_RL_Status" 27660 "GD_ID_HC_ACTUAL_CLEARANCE_RL" 27661 "GD_ID_HC_ACTUAL_CLEARANCE_RR_Status" 27661 "GD_ID_HC_ACTUAL_CLEARANCE_RR" 27662 "GD_ID_HC_STROKE_LEGNTH_RAW_FL" 27663 "GD_ID_HC_STROKE_LEGNTH_RAW_FR" 27664 "GD_ID_HC_STROKE_LEGNTH_RAW_RL" 27665 "GD_ID_HC_STROKE_LEGNTH_RAW_RR" 27666 "GD_ID_HC_OKAY_TO_TRANSITION" 27667 "GD_ID_HC_CYLINDER_PWM_EXTEND_FL" 27668 "GD_ID_HC_CYLINDER_PWM_EXTEND_FR" 27669 "GD_ID_HC_CYLINDER_PWM_EXTEND_RL" 27670 "GD_ID_HC_CYLINDER_PWM_EXTEND_RR" 27671 "GD_ID_HC_CYLINDER_PWM_RETRCT_FL" 27672 "GD_ID_HC_CYLINDER_PWM_RETRCT_FR" 27673 "GD_ID_HC_CYLINDER_PWM_RETRCT_RL" 27674 "GD_ID_HC_CYLINDER_PWM_RETRCT_RR" 27675 "GD_ID_HC_LADDER_EXTEND_Status" 27675 "GD_ID_HC_LADDER_EXTEND" 27676 "GD_ID_HC_REQUEST_CCO_OFF_Status" 27676 "GD_ID_HC_REQUEST_CCO_OFF" 27677 "GD_ID_HC_USER_WARNINGS" 27682 "GD_ID_HC_MOVEMENT_ERROR_FL" 27679 "GD_ID_HC_MOVEMENT_ERROR_FR" 27680 "GD_ID_HC_MOVEMENT_ERROR_RL" 27681 "GD_ID_HC_MOVEMENT_ERROR_RR" 27678 "GD_ID_HC_MANUAL_OVERRIDE_Status" 27678 "GD_ID_HC_MANUAL_OVERRIDE" 27683 "GD_ID_HC_CAL_STATE_Status" 27683 "GD_ID_HC_CAL_STATE" 27684 "GD_ID_HC_CAL_CMD" 27685 "GD_ID_HC_SENSOR_RAW_FL" 27686 "GD_ID_HC_SENSOR_RAW_FR" 27687 "GD_ID_HC_SENSOR_RAW_RL" 27688 "GD_ID_HC_SENSOR_RAW_RR" 27689 "GD_ID_HC_COIL_RAW_EXTEND_FL" 27690 "GD_ID_HC_COIL_RAW_RETRCT_FL" 27691 "GD_ID_HC_COIL_RAW_EXTEND_FR" 27692 "GD_ID_HC_COIL_RAW_RETRCT_FR" 27693 "GD_ID_HC_COIL_RAW_EXTEND_RL" 27694 "GD_ID_HC_COIL_RAW_RETRCT_RL" 27695 "GD_ID_HC_COIL_RAW_EXTEND_RR" 27696 "GD_ID_HC_COIL_RAW_RETRCT_RR" 27697 "GD_ID_HC_STROKE_LEGNTH_FILTER_FL_Status" 27697 "GD_ID_HC_STROKE_LEGNTH_FILTER_FL" 27698 "GD_ID_HC_STROKE_LEGNTH_FILTER_FR_Status" 27698 "GD_ID_HC_STROKE_LEGNTH_FILTER_FR" 27699 "GD_ID_HC_STROKE_LEGNTH_FILTER_RL_Status" 27699 "GD_ID_HC_STROKE_LEGNTH_FILTER_RL" 27700 "GD_ID_HC_STROKE_LEGNTH_FILTER_RR_Status" 27700 "GD_ID_HC_STROKE_LEGNTH_FILTER_RR" 28142 "GD_ID_HC_ErrorManagement_Status" 28142 "GD_ID_HC_ErrorManagement" 28159 "GD_ID_HC_LifeMessage" 32480 "GD_ID_ACM_BT_SERVER_ADDR_ROUTER_Status" 32480 "GD_ID_ACM_BT_SERVER_ADDR_ROUTER" 32750 "GD_ID_ACM_ErrorManagement_Status" 32750 "GD_ID_ACM_ErrorManagement" 32767 "GD_ID_ACM_LifeMessage"  ;
